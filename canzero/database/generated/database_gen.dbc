VERSION ""

NS_ :

BS_:

BU_: TelemetryNode Master SENSOR PDU CLU BRAKE MLU_1 MLU_2 MLU_3 MLU_4 MLU_5 MLU_6

BO_ 1925 MLU_1_BTL_RX: 8 TelemetryNode

BO_ 134 MLU_2_EMCY: 4 MLU_2
 SG_ MLU_2_E0_OtherError : 12|1@1+ (1,0) [0|0] ""  Master,TelemetryNode
 SG_ MLU_2_W0_OtherWarning : 0|1@1+ (1,0) [0|0] ""  Master,TelemetryNode

BO_ 390 MLU_2_TX_PDO1: 0 MLU_2

BO_ 454 MLU_2_RX_PDO1: 0 Vector__XXX

BO_ 518 MLU_2_TX_PDO2: 0 MLU_2

BO_ 582 MLU_2_RX_PDO2: 0 Vector__XXX

BO_ 646 MLU_2_TX_PDO3: 0 MLU_2

BO_ 710 MLU_2_RX_PDO3: 0 Vector__XXX

BO_ 774 MLU_2_TX_PDO4: 0 MLU_2

BO_ 838 MLU_2_RX_PDO4: 0 Vector__XXX

BO_ 902 MLU_2_TX_PDO5: 0 MLU_2

BO_ 966 MLU_2_TX_PDO6: 0 MLU_2

BO_ 1030 MLU_2_TX_PDO7: 0 MLU_2

BO_ 1094 MLU_2_TX_PDO8: 0 MLU_2

BO_ 1158 MLU_2_TX_PDO9: 0 MLU_2

BO_ 1222 MLU_2_TX_PDO10: 0 MLU_2

BO_ 1286 MLU_2_TX_PDO11: 0 MLU_2

BO_ 1350 MLU_2_TX_PDO12: 0 MLU_2

BO_ 1414 MLU_2_SDO_Resp: 8 MLU_2
 SG_ MLU_2_OD_CAN2_DelayedTxMessages m1129 : 16|24@1+ (1,0) [0|16777215] ""  TelemetryNode
 SG_ MLU_2_OD_CAN2_ErrorStatus m1128 : 16|8@1+ (1,0) [0|255] ""  TelemetryNode
 SG_ MLU_2_OD_CAN2_DiscardedTxMessage m1127 : 16|24@1+ (1,0) [0|16777215] ""  TelemetryNode
 SG_ MLU_2_OD_CAN2_Status m1126 : 16|8@1+ (1,0) [0|255] ""  TelemetryNode
 SG_ MLU_2_OD_CAN2_Baudrate m1124 : 16|16@1+ (1,0) [125|1000] "kbps"  TelemetryNode
 SG_ MLU_2_OD_CAN2_autoErrorReset m1123 : 16|8@1+ (1,0) [0|255] ""  TelemetryNode
 SG_ MLU_2_OD_CAN2_lastErrorCode m1122 : 16|32@1+ (1,0) [0|4294967295] ""  TelemetryNode
 SG_ MLU_2_OD_CAN2_RxErrCnt m1121 : 16|8@1+ (1,0) [0|255] ""  TelemetryNode
 SG_ MLU_2_OD_CAN2_TxErrCnt m1120 : 16|8@1+ (1,0) [0|255] ""  TelemetryNode
 SG_ MLU_2_OD_CAN1_DelayedTxMessages m1113 : 16|24@1+ (1,0) [0|16777215] ""  TelemetryNode
 SG_ MLU_2_OD_CAN1_ErrorStatus m1112 : 16|8@1+ (1,0) [0|255] ""  TelemetryNode
 SG_ MLU_2_OD_CAN1_DiscardedTxMessage m1111 : 16|24@1+ (1,0) [0|16777215] ""  TelemetryNode
 SG_ MLU_2_OD_CAN1_Status m1110 : 16|8@1+ (1,0) [0|255] ""  TelemetryNode
 SG_ MLU_2_OD_CAN1_Baudrate m1108 : 16|16@1+ (1,0) [125|1000] "kbps"  TelemetryNode
 SG_ MLU_2_OD_CAN1_autoErrorReset m1107 : 16|8@1+ (1,0) [0|255] ""  TelemetryNode
 SG_ MLU_2_OD_CAN1_lastErrorCode m1106 : 16|32@1+ (1,0) [0|4294967295] ""  TelemetryNode
 SG_ MLU_2_OD_CAN1_RxErrCnt m1105 : 16|8@1+ (1,0) [0|255] ""  TelemetryNode
 SG_ MLU_2_OD_CAN1_TxErrCnt m1104 : 16|8@1+ (1,0) [0|255] ""  TelemetryNode
 SG_ MLU_2_OD_BuildTime m1073 : 16|24@1+ (1,0) [0|16777215] ""  TelemetryNode
 SG_ MLU_2_OD_BuildDate m1072 : 16|32@1+ (1,0) [0|4294967295] ""  TelemetryNode
 SG_ MLU_2_OD_ChipUID2 m1057 : 16|48@1+ (1,0) [0|281474976710655] ""  TelemetryNode
 SG_ MLU_2_OD_ChipUID1 m1056 : 16|48@1+ (1,0) [0|281474976710655] ""  TelemetryNode
 SG_ MLU_2_OD_SdcOut m1046 : 16|8@1+ (1,0) [0|255] ""  TelemetryNode
 SG_ MLU_2_OD_SdcIn m1045 : 16|8@1+ (1,0) [0|255] ""  TelemetryNode
 SG_ MLU_2_OD_runtime m1044 : 16|24@1+ (1,0) [0|16777215] "ms"  TelemetryNode
 SG_ MLU_2_OD_InputVoltage m1043 : 16|16@1+ (0.001,0) [0|65.535] "V"  TelemetryNode
 SG_ MLU_2_OD_BoardTemp m1042 : 16|16@1+ (0.01,-30) [-30|625.35] "°C"  TelemetryNode
 SG_ MLU_2_OD_MemFree m1041 : 16|16@1+ (4,0) [0|262140] "bytes"  TelemetryNode
 SG_ MLU_2_OD_CpuUsage m1040 : 16|8@1+ (0.5,0) [0|100] "%"  TelemetryNode
 SG_ MLU_2_OD_OdEntrySendInterval m33 : 16|16@1+ (1,0) [0|65535] "ms"  TelemetryNode
 SG_ MLU_2_OD_SendOdOnBootup m32 : 16|8@1+ (1,0) [0|255] ""  TelemetryNode
 SG_ MLU_2_OD_HeartbeatInterval m16 : 16|16@1+ (1,0) [0|65535] "ms"  TelemetryNode
 SG_ MLU_2_OD_DbcVersion m5 : 16|16@1+ (1,0) [0|65535] ""  TelemetryNode
 SG_ MLU_2_OD_StackVersion m4 : 16|16@1+ (1,0) [0|65535] ""  TelemetryNode
 SG_ MLU_2_OD_ProtocolVersion m3 : 16|16@1+ (1,0) [0|65535] ""  TelemetryNode
 SG_ MLU_2_OD_NodeStatus m2 : 16|8@1+ (1,0) [0|255] ""  TelemetryNode
 SG_ MLU_2_OD_NodeID m1 : 16|8@1+ (1,0) [0|255] ""  TelemetryNode
 SG_ MLU_2_SDO_RespCode : 12|4@1+ (1,0) [0|0] ""  TelemetryNode
 SG_ MLU_2_SDO_ID M : 0|12@1+ (1,0) [0|4095] ""  TelemetryNode

BO_ 1478 MLU_2_SDO_Req_Up: 8 TelemetryNode
 SG_ MLU_2_OD_CAN2_DelayedTxMessages m1129 : 16|24@1+ (1,0) [0|16777215] ""  MLU_2
 SG_ MLU_2_OD_CAN2_ErrorStatus m1128 : 16|8@1+ (1,0) [0|255] ""  MLU_2
 SG_ MLU_2_OD_CAN2_DiscardedTxMe_0000 m1127 : 16|24@1+ (1,0) [0|16777215] ""  MLU_2
 SG_ MLU_2_OD_CAN2_Status m1126 : 16|8@1+ (1,0) [0|255] ""  MLU_2
 SG_ MLU_2_OD_CAN2_Baudrate m1124 : 16|16@1+ (1,0) [125|1000] "kbps"  MLU_2
 SG_ MLU_2_OD_CAN2_autoErrorReset m1123 : 16|8@1+ (1,0) [0|255] ""  MLU_2
 SG_ MLU_2_OD_CAN2_lastErrorCode m1122 : 16|32@1+ (1,0) [0|4294967295] ""  MLU_2
 SG_ MLU_2_OD_CAN2_RxErrCnt m1121 : 16|8@1+ (1,0) [0|255] ""  MLU_2
 SG_ MLU_2_OD_CAN2_TxErrCnt m1120 : 16|8@1+ (1,0) [0|255] ""  MLU_2
 SG_ MLU_2_OD_CAN1_DelayedTxMessages m1113 : 16|24@1+ (1,0) [0|16777215] ""  MLU_2
 SG_ MLU_2_OD_CAN1_ErrorStatus m1112 : 16|8@1+ (1,0) [0|255] ""  MLU_2
 SG_ MLU_2_OD_CAN1_DiscardedTxMe_0000 m1111 : 16|24@1+ (1,0) [0|16777215] ""  MLU_2
 SG_ MLU_2_OD_CAN1_Status m1110 : 16|8@1+ (1,0) [0|255] ""  MLU_2
 SG_ MLU_2_OD_CAN1_Baudrate m1108 : 16|16@1+ (1,0) [125|1000] "kbps"  MLU_2
 SG_ MLU_2_OD_CAN1_autoErrorReset m1107 : 16|8@1+ (1,0) [0|255] ""  MLU_2
 SG_ MLU_2_OD_CAN1_lastErrorCode m1106 : 16|32@1+ (1,0) [0|4294967295] ""  MLU_2
 SG_ MLU_2_OD_CAN1_RxErrCnt m1105 : 16|8@1+ (1,0) [0|255] ""  MLU_2
 SG_ MLU_2_OD_CAN1_TxErrCnt m1104 : 16|8@1+ (1,0) [0|255] ""  MLU_2
 SG_ MLU_2_OD_BuildTime m1073 : 16|24@1+ (1,0) [0|16777215] ""  MLU_2
 SG_ MLU_2_OD_BuildDate m1072 : 16|32@1+ (1,0) [0|4294967295] ""  MLU_2
 SG_ MLU_2_OD_ChipUID2 m1057 : 16|48@1+ (1,0) [0|281474976710655] ""  MLU_2
 SG_ MLU_2_OD_ChipUID1 m1056 : 16|48@1+ (1,0) [0|281474976710655] ""  MLU_2
 SG_ MLU_2_OD_SdcOut m1046 : 16|8@1+ (1,0) [0|255] ""  MLU_2
 SG_ MLU_2_OD_SdcIn m1045 : 16|8@1+ (1,0) [0|255] ""  MLU_2
 SG_ MLU_2_OD_runtime m1044 : 16|24@1+ (1,0) [0|16777215] "ms"  MLU_2
 SG_ MLU_2_OD_InputVoltage m1043 : 16|16@1+ (0.001,0) [0|65.535] "V"  MLU_2
 SG_ MLU_2_OD_BoardTemp m1042 : 16|16@1+ (0.01,-30) [-30|625.35] "°C"  MLU_2
 SG_ MLU_2_OD_MemFree m1041 : 16|16@1+ (4,0) [0|262140] "bytes"  MLU_2
 SG_ MLU_2_OD_CpuUsage m1040 : 16|8@1+ (0.5,0) [0|100] "%"  MLU_2
 SG_ MLU_2_OD_OdEntrySendInterval m33 : 16|16@1+ (1,0) [0|65535] "ms"  MLU_2
 SG_ MLU_2_OD_SendOdOnBootup m32 : 16|8@1+ (1,0) [0|255] ""  MLU_2
 SG_ MLU_2_OD_HeartbeatInterval m16 : 16|16@1+ (1,0) [0|65535] "ms"  MLU_2
 SG_ MLU_2_OD_DbcVersion m5 : 16|16@1+ (1,0) [0|65535] ""  MLU_2
 SG_ MLU_2_OD_StackVersion m4 : 16|16@1+ (1,0) [0|65535] ""  MLU_2
 SG_ MLU_2_OD_ProtocolVersion m3 : 16|16@1+ (1,0) [0|65535] ""  MLU_2
 SG_ MLU_2_OD_NodeStatus m2 : 16|8@1+ (1,0) [0|255] ""  MLU_2
 SG_ MLU_2_OD_NodeID m1 : 16|8@1+ (1,0) [0|255] ""  MLU_2
 SG_ MLU_2_SDO_ID M : 0|12@1+ (1,0) [0|4095] ""  MLU_2

BO_ 1542 MLU_2_SDO_Req_Down: 2 TelemetryNode
 SG_ MLU_2_SDO_ID M : 0|12@1+ (1,0) [0|4095] ""  MLU_2

BO_ 1798 MLU_2_Heartbeat: 1 MLU_2
 SG_ MLU_2_NodeState : 0|8@1+ (1,0) [0|0] ""  Master,TelemetryNode

BO_ 1862 MLU_2_BTL_TX: 8 MLU_2

BO_ 1926 MLU_2_BTL_RX: 8 TelemetryNode

BO_ 135 MLU_3_EMCY: 4 MLU_3
 SG_ MLU_3_E0_OtherError : 12|1@1+ (1,0) [0|0] ""  Master,TelemetryNode
 SG_ MLU_3_W0_OtherWarning : 0|1@1+ (1,0) [0|0] ""  Master,TelemetryNode

BO_ 391 MLU_3_TX_PDO1: 0 MLU_3

BO_ 455 MLU_3_RX_PDO1: 0 Vector__XXX

BO_ 519 MLU_3_TX_PDO2: 0 MLU_3

BO_ 583 MLU_3_RX_PDO2: 0 Vector__XXX

BO_ 647 MLU_3_TX_PDO3: 0 MLU_3

BO_ 711 MLU_3_RX_PDO3: 0 Vector__XXX

BO_ 775 MLU_3_TX_PDO4: 0 MLU_3

BO_ 839 MLU_3_RX_PDO4: 0 Vector__XXX

BO_ 903 MLU_3_TX_PDO5: 0 MLU_3

BO_ 967 MLU_3_TX_PDO6: 0 MLU_3

BO_ 1031 MLU_3_TX_PDO7: 0 MLU_3

BO_ 1095 MLU_3_TX_PDO8: 0 MLU_3

BO_ 1159 MLU_3_TX_PDO9: 0 MLU_3

BO_ 1223 MLU_3_TX_PDO10: 0 MLU_3

BO_ 1287 MLU_3_TX_PDO11: 0 MLU_3

BO_ 1351 MLU_3_TX_PDO12: 0 MLU_3

BO_ 1415 MLU_3_SDO_Resp: 8 MLU_3
 SG_ MLU_3_OD_CAN2_DelayedTxMessages m1129 : 16|24@1+ (1,0) [0|16777215] ""  TelemetryNode
 SG_ MLU_3_OD_CAN2_ErrorStatus m1128 : 16|8@1+ (1,0) [0|255] ""  TelemetryNode
 SG_ MLU_3_OD_CAN2_DiscardedTxMessage m1127 : 16|24@1+ (1,0) [0|16777215] ""  TelemetryNode
 SG_ MLU_3_OD_CAN2_Status m1126 : 16|8@1+ (1,0) [0|255] ""  TelemetryNode
 SG_ MLU_3_OD_CAN2_Baudrate m1124 : 16|16@1+ (1,0) [125|1000] "kbps"  TelemetryNode
 SG_ MLU_3_OD_CAN2_autoErrorReset m1123 : 16|8@1+ (1,0) [0|255] ""  TelemetryNode
 SG_ MLU_3_OD_CAN2_lastErrorCode m1122 : 16|32@1+ (1,0) [0|4294967295] ""  TelemetryNode
 SG_ MLU_3_OD_CAN2_RxErrCnt m1121 : 16|8@1+ (1,0) [0|255] ""  TelemetryNode
 SG_ MLU_3_OD_CAN2_TxErrCnt m1120 : 16|8@1+ (1,0) [0|255] ""  TelemetryNode
 SG_ MLU_3_OD_CAN1_DelayedTxMessages m1113 : 16|24@1+ (1,0) [0|16777215] ""  TelemetryNode
 SG_ MLU_3_OD_CAN1_ErrorStatus m1112 : 16|8@1+ (1,0) [0|255] ""  TelemetryNode
 SG_ MLU_3_OD_CAN1_DiscardedTxMessage m1111 : 16|24@1+ (1,0) [0|16777215] ""  TelemetryNode
 SG_ MLU_3_OD_CAN1_Status m1110 : 16|8@1+ (1,0) [0|255] ""  TelemetryNode
 SG_ MLU_3_OD_CAN1_Baudrate m1108 : 16|16@1+ (1,0) [125|1000] "kbps"  TelemetryNode
 SG_ MLU_3_OD_CAN1_autoErrorReset m1107 : 16|8@1+ (1,0) [0|255] ""  TelemetryNode
 SG_ MLU_3_OD_CAN1_lastErrorCode m1106 : 16|32@1+ (1,0) [0|4294967295] ""  TelemetryNode
 SG_ MLU_3_OD_CAN1_RxErrCnt m1105 : 16|8@1+ (1,0) [0|255] ""  TelemetryNode
 SG_ MLU_3_OD_CAN1_TxErrCnt m1104 : 16|8@1+ (1,0) [0|255] ""  TelemetryNode
 SG_ MLU_3_OD_BuildTime m1073 : 16|24@1+ (1,0) [0|16777215] ""  TelemetryNode
 SG_ MLU_3_OD_BuildDate m1072 : 16|32@1+ (1,0) [0|4294967295] ""  TelemetryNode
 SG_ MLU_3_OD_ChipUID2 m1057 : 16|48@1+ (1,0) [0|281474976710655] ""  TelemetryNode
 SG_ MLU_3_OD_ChipUID1 m1056 : 16|48@1+ (1,0) [0|281474976710655] ""  TelemetryNode
 SG_ MLU_3_OD_SdcOut m1046 : 16|8@1+ (1,0) [0|255] ""  TelemetryNode
 SG_ MLU_3_OD_SdcIn m1045 : 16|8@1+ (1,0) [0|255] ""  TelemetryNode
 SG_ MLU_3_OD_runtime m1044 : 16|24@1+ (1,0) [0|16777215] "ms"  TelemetryNode
 SG_ MLU_3_OD_InputVoltage m1043 : 16|16@1+ (0.001,0) [0|65.535] "V"  TelemetryNode
 SG_ MLU_3_OD_BoardTemp m1042 : 16|16@1+ (0.01,-30) [-30|625.35] "°C"  TelemetryNode
 SG_ MLU_3_OD_MemFree m1041 : 16|16@1+ (4,0) [0|262140] "bytes"  TelemetryNode
 SG_ MLU_3_OD_CpuUsage m1040 : 16|8@1+ (0.5,0) [0|100] "%"  TelemetryNode
 SG_ MLU_3_OD_OdEntrySendInterval m33 : 16|16@1+ (1,0) [0|65535] "ms"  TelemetryNode
 SG_ MLU_3_OD_SendOdOnBootup m32 : 16|8@1+ (1,0) [0|255] ""  TelemetryNode
 SG_ MLU_3_OD_HeartbeatInterval m16 : 16|16@1+ (1,0) [0|65535] "ms"  TelemetryNode
 SG_ MLU_3_OD_DbcVersion m5 : 16|16@1+ (1,0) [0|65535] ""  TelemetryNode
 SG_ MLU_3_OD_StackVersion m4 : 16|16@1+ (1,0) [0|65535] ""  TelemetryNode
 SG_ MLU_3_OD_ProtocolVersion m3 : 16|16@1+ (1,0) [0|65535] ""  TelemetryNode
 SG_ MLU_3_OD_NodeStatus m2 : 16|8@1+ (1,0) [0|255] ""  TelemetryNode
 SG_ MLU_3_OD_NodeID m1 : 16|8@1+ (1,0) [0|255] ""  TelemetryNode
 SG_ MLU_3_SDO_RespCode : 12|4@1+ (1,0) [0|0] ""  TelemetryNode
 SG_ MLU_3_SDO_ID M : 0|12@1+ (1,0) [0|4095] ""  TelemetryNode

BO_ 1479 MLU_3_SDO_Req_Up: 8 TelemetryNode
 SG_ MLU_3_OD_CAN2_DelayedTxMessages m1129 : 16|24@1+ (1,0) [0|16777215] ""  MLU_3
 SG_ MLU_3_OD_CAN2_ErrorStatus m1128 : 16|8@1+ (1,0) [0|255] ""  MLU_3
 SG_ MLU_3_OD_CAN2_DiscardedTxMe_0000 m1127 : 16|24@1+ (1,0) [0|16777215] ""  MLU_3
 SG_ MLU_3_OD_CAN2_Status m1126 : 16|8@1+ (1,0) [0|255] ""  MLU_3
 SG_ MLU_3_OD_CAN2_Baudrate m1124 : 16|16@1+ (1,0) [125|1000] "kbps"  MLU_3
 SG_ MLU_3_OD_CAN2_autoErrorReset m1123 : 16|8@1+ (1,0) [0|255] ""  MLU_3
 SG_ MLU_3_OD_CAN2_lastErrorCode m1122 : 16|32@1+ (1,0) [0|4294967295] ""  MLU_3
 SG_ MLU_3_OD_CAN2_RxErrCnt m1121 : 16|8@1+ (1,0) [0|255] ""  MLU_3
 SG_ MLU_3_OD_CAN2_TxErrCnt m1120 : 16|8@1+ (1,0) [0|255] ""  MLU_3
 SG_ MLU_3_OD_CAN1_DelayedTxMessages m1113 : 16|24@1+ (1,0) [0|16777215] ""  MLU_3
 SG_ MLU_3_OD_CAN1_ErrorStatus m1112 : 16|8@1+ (1,0) [0|255] ""  MLU_3
 SG_ MLU_3_OD_CAN1_DiscardedTxMe_0000 m1111 : 16|24@1+ (1,0) [0|16777215] ""  MLU_3
 SG_ MLU_3_OD_CAN1_Status m1110 : 16|8@1+ (1,0) [0|255] ""  MLU_3
 SG_ MLU_3_OD_CAN1_Baudrate m1108 : 16|16@1+ (1,0) [125|1000] "kbps"  MLU_3
 SG_ MLU_3_OD_CAN1_autoErrorReset m1107 : 16|8@1+ (1,0) [0|255] ""  MLU_3
 SG_ MLU_3_OD_CAN1_lastErrorCode m1106 : 16|32@1+ (1,0) [0|4294967295] ""  MLU_3
 SG_ MLU_3_OD_CAN1_RxErrCnt m1105 : 16|8@1+ (1,0) [0|255] ""  MLU_3
 SG_ MLU_3_OD_CAN1_TxErrCnt m1104 : 16|8@1+ (1,0) [0|255] ""  MLU_3
 SG_ MLU_3_OD_BuildTime m1073 : 16|24@1+ (1,0) [0|16777215] ""  MLU_3
 SG_ MLU_3_OD_BuildDate m1072 : 16|32@1+ (1,0) [0|4294967295] ""  MLU_3
 SG_ MLU_3_OD_ChipUID2 m1057 : 16|48@1+ (1,0) [0|281474976710655] ""  MLU_3
 SG_ MLU_3_OD_ChipUID1 m1056 : 16|48@1+ (1,0) [0|281474976710655] ""  MLU_3
 SG_ MLU_3_OD_SdcOut m1046 : 16|8@1+ (1,0) [0|255] ""  MLU_3
 SG_ MLU_3_OD_SdcIn m1045 : 16|8@1+ (1,0) [0|255] ""  MLU_3
 SG_ MLU_3_OD_runtime m1044 : 16|24@1+ (1,0) [0|16777215] "ms"  MLU_3
 SG_ MLU_3_OD_InputVoltage m1043 : 16|16@1+ (0.001,0) [0|65.535] "V"  MLU_3
 SG_ MLU_3_OD_BoardTemp m1042 : 16|16@1+ (0.01,-30) [-30|625.35] "°C"  MLU_3
 SG_ MLU_3_OD_MemFree m1041 : 16|16@1+ (4,0) [0|262140] "bytes"  MLU_3
 SG_ MLU_3_OD_CpuUsage m1040 : 16|8@1+ (0.5,0) [0|100] "%"  MLU_3
 SG_ MLU_3_OD_OdEntrySendInterval m33 : 16|16@1+ (1,0) [0|65535] "ms"  MLU_3
 SG_ MLU_3_OD_SendOdOnBootup m32 : 16|8@1+ (1,0) [0|255] ""  MLU_3
 SG_ MLU_3_OD_HeartbeatInterval m16 : 16|16@1+ (1,0) [0|65535] "ms"  MLU_3
 SG_ MLU_3_OD_DbcVersion m5 : 16|16@1+ (1,0) [0|65535] ""  MLU_3
 SG_ MLU_3_OD_StackVersion m4 : 16|16@1+ (1,0) [0|65535] ""  MLU_3
 SG_ MLU_3_OD_ProtocolVersion m3 : 16|16@1+ (1,0) [0|65535] ""  MLU_3
 SG_ MLU_3_OD_NodeStatus m2 : 16|8@1+ (1,0) [0|255] ""  MLU_3
 SG_ MLU_3_OD_NodeID m1 : 16|8@1+ (1,0) [0|255] ""  MLU_3
 SG_ MLU_3_SDO_ID M : 0|12@1+ (1,0) [0|4095] ""  MLU_3

BO_ 1543 MLU_3_SDO_Req_Down: 2 TelemetryNode
 SG_ MLU_3_SDO_ID M : 0|12@1+ (1,0) [0|4095] ""  MLU_3

BO_ 1799 MLU_3_Heartbeat: 1 MLU_3
 SG_ MLU_3_NodeState : 0|8@1+ (1,0) [0|0] ""  Master,TelemetryNode

BO_ 1863 MLU_3_BTL_TX: 8 MLU_3

BO_ 1927 MLU_3_BTL_RX: 8 TelemetryNode

BO_ 136 MLU_4_EMCY: 4 MLU_4
 SG_ MLU_4_E0_OtherError : 12|1@1+ (1,0) [0|0] ""  Master,TelemetryNode
 SG_ MLU_4_W0_OtherWarning : 0|1@1+ (1,0) [0|0] ""  Master,TelemetryNode

BO_ 392 MLU_4_TX_PDO1: 0 MLU_4

BO_ 456 MLU_4_RX_PDO1: 0 Vector__XXX

BO_ 520 MLU_4_TX_PDO2: 0 MLU_4

BO_ 584 MLU_4_RX_PDO2: 0 Vector__XXX

BO_ 648 MLU_4_TX_PDO3: 0 MLU_4

BO_ 712 MLU_4_RX_PDO3: 0 Vector__XXX

BO_ 776 MLU_4_TX_PDO4: 0 MLU_4

BO_ 840 MLU_4_RX_PDO4: 0 Vector__XXX

BO_ 904 MLU_4_TX_PDO5: 0 MLU_4

BO_ 968 MLU_4_TX_PDO6: 0 MLU_4

BO_ 1032 MLU_4_TX_PDO7: 0 MLU_4

BO_ 1096 MLU_4_TX_PDO8: 0 MLU_4

BO_ 1160 MLU_4_TX_PDO9: 0 MLU_4

BO_ 1224 MLU_4_TX_PDO10: 0 MLU_4

BO_ 1288 MLU_4_TX_PDO11: 0 MLU_4

BO_ 1352 MLU_4_TX_PDO12: 0 MLU_4

BO_ 1416 MLU_4_SDO_Resp: 8 MLU_4
 SG_ MLU_4_OD_CAN2_DelayedTxMessages m1129 : 16|24@1+ (1,0) [0|16777215] ""  TelemetryNode
 SG_ MLU_4_OD_CAN2_ErrorStatus m1128 : 16|8@1+ (1,0) [0|255] ""  TelemetryNode
 SG_ MLU_4_OD_CAN2_DiscardedTxMessage m1127 : 16|24@1+ (1,0) [0|16777215] ""  TelemetryNode
 SG_ MLU_4_OD_CAN2_Status m1126 : 16|8@1+ (1,0) [0|255] ""  TelemetryNode
 SG_ MLU_4_OD_CAN2_Baudrate m1124 : 16|16@1+ (1,0) [125|1000] "kbps"  TelemetryNode
 SG_ MLU_4_OD_CAN2_autoErrorReset m1123 : 16|8@1+ (1,0) [0|255] ""  TelemetryNode
 SG_ MLU_4_OD_CAN2_lastErrorCode m1122 : 16|32@1+ (1,0) [0|4294967295] ""  TelemetryNode
 SG_ MLU_4_OD_CAN2_RxErrCnt m1121 : 16|8@1+ (1,0) [0|255] ""  TelemetryNode
 SG_ MLU_4_OD_CAN2_TxErrCnt m1120 : 16|8@1+ (1,0) [0|255] ""  TelemetryNode
 SG_ MLU_4_OD_CAN1_DelayedTxMessages m1113 : 16|24@1+ (1,0) [0|16777215] ""  TelemetryNode
 SG_ MLU_4_OD_CAN1_ErrorStatus m1112 : 16|8@1+ (1,0) [0|255] ""  TelemetryNode
 SG_ MLU_4_OD_CAN1_DiscardedTxMessage m1111 : 16|24@1+ (1,0) [0|16777215] ""  TelemetryNode
 SG_ MLU_4_OD_CAN1_Status m1110 : 16|8@1+ (1,0) [0|255] ""  TelemetryNode
 SG_ MLU_4_OD_CAN1_Baudrate m1108 : 16|16@1+ (1,0) [125|1000] "kbps"  TelemetryNode
 SG_ MLU_4_OD_CAN1_autoErrorReset m1107 : 16|8@1+ (1,0) [0|255] ""  TelemetryNode
 SG_ MLU_4_OD_CAN1_lastErrorCode m1106 : 16|32@1+ (1,0) [0|4294967295] ""  TelemetryNode
 SG_ MLU_4_OD_CAN1_RxErrCnt m1105 : 16|8@1+ (1,0) [0|255] ""  TelemetryNode
 SG_ MLU_4_OD_CAN1_TxErrCnt m1104 : 16|8@1+ (1,0) [0|255] ""  TelemetryNode
 SG_ MLU_4_OD_BuildTime m1073 : 16|24@1+ (1,0) [0|16777215] ""  TelemetryNode
 SG_ MLU_4_OD_BuildDate m1072 : 16|32@1+ (1,0) [0|4294967295] ""  TelemetryNode
 SG_ MLU_4_OD_ChipUID2 m1057 : 16|48@1+ (1,0) [0|281474976710655] ""  TelemetryNode
 SG_ MLU_4_OD_ChipUID1 m1056 : 16|48@1+ (1,0) [0|281474976710655] ""  TelemetryNode
 SG_ MLU_4_OD_SdcOut m1046 : 16|8@1+ (1,0) [0|255] ""  TelemetryNode
 SG_ MLU_4_OD_SdcIn m1045 : 16|8@1+ (1,0) [0|255] ""  TelemetryNode
 SG_ MLU_4_OD_runtime m1044 : 16|24@1+ (1,0) [0|16777215] "ms"  TelemetryNode
 SG_ MLU_4_OD_InputVoltage m1043 : 16|16@1+ (0.001,0) [0|65.535] "V"  TelemetryNode
 SG_ MLU_4_OD_BoardTemp m1042 : 16|16@1+ (0.01,-30) [-30|625.35] "°C"  TelemetryNode
 SG_ MLU_4_OD_MemFree m1041 : 16|16@1+ (4,0) [0|262140] "bytes"  TelemetryNode
 SG_ MLU_4_OD_CpuUsage m1040 : 16|8@1+ (0.5,0) [0|100] "%"  TelemetryNode
 SG_ MLU_4_OD_OdEntrySendInterval m33 : 16|16@1+ (1,0) [0|65535] "ms"  TelemetryNode
 SG_ MLU_4_OD_SendOdOnBootup m32 : 16|8@1+ (1,0) [0|255] ""  TelemetryNode
 SG_ MLU_4_OD_HeartbeatInterval m16 : 16|16@1+ (1,0) [0|65535] "ms"  TelemetryNode
 SG_ MLU_4_OD_DbcVersion m5 : 16|16@1+ (1,0) [0|65535] ""  TelemetryNode
 SG_ MLU_4_OD_StackVersion m4 : 16|16@1+ (1,0) [0|65535] ""  TelemetryNode
 SG_ MLU_4_OD_ProtocolVersion m3 : 16|16@1+ (1,0) [0|65535] ""  TelemetryNode
 SG_ MLU_4_OD_NodeStatus m2 : 16|8@1+ (1,0) [0|255] ""  TelemetryNode
 SG_ MLU_4_OD_NodeID m1 : 16|8@1+ (1,0) [0|255] ""  TelemetryNode
 SG_ MLU_4_SDO_RespCode : 12|4@1+ (1,0) [0|0] ""  TelemetryNode
 SG_ MLU_4_SDO_ID M : 0|12@1+ (1,0) [0|4095] ""  TelemetryNode

BO_ 1480 MLU_4_SDO_Req_Up: 8 TelemetryNode
 SG_ MLU_4_OD_CAN2_DelayedTxMessages m1129 : 16|24@1+ (1,0) [0|16777215] ""  MLU_4
 SG_ MLU_4_OD_CAN2_ErrorStatus m1128 : 16|8@1+ (1,0) [0|255] ""  MLU_4
 SG_ MLU_4_OD_CAN2_DiscardedTxMe_0000 m1127 : 16|24@1+ (1,0) [0|16777215] ""  MLU_4
 SG_ MLU_4_OD_CAN2_Status m1126 : 16|8@1+ (1,0) [0|255] ""  MLU_4
 SG_ MLU_4_OD_CAN2_Baudrate m1124 : 16|16@1+ (1,0) [125|1000] "kbps"  MLU_4
 SG_ MLU_4_OD_CAN2_autoErrorReset m1123 : 16|8@1+ (1,0) [0|255] ""  MLU_4
 SG_ MLU_4_OD_CAN2_lastErrorCode m1122 : 16|32@1+ (1,0) [0|4294967295] ""  MLU_4
 SG_ MLU_4_OD_CAN2_RxErrCnt m1121 : 16|8@1+ (1,0) [0|255] ""  MLU_4
 SG_ MLU_4_OD_CAN2_TxErrCnt m1120 : 16|8@1+ (1,0) [0|255] ""  MLU_4
 SG_ MLU_4_OD_CAN1_DelayedTxMessages m1113 : 16|24@1+ (1,0) [0|16777215] ""  MLU_4
 SG_ MLU_4_OD_CAN1_ErrorStatus m1112 : 16|8@1+ (1,0) [0|255] ""  MLU_4
 SG_ MLU_4_OD_CAN1_DiscardedTxMe_0000 m1111 : 16|24@1+ (1,0) [0|16777215] ""  MLU_4
 SG_ MLU_4_OD_CAN1_Status m1110 : 16|8@1+ (1,0) [0|255] ""  MLU_4
 SG_ MLU_4_OD_CAN1_Baudrate m1108 : 16|16@1+ (1,0) [125|1000] "kbps"  MLU_4
 SG_ MLU_4_OD_CAN1_autoErrorReset m1107 : 16|8@1+ (1,0) [0|255] ""  MLU_4
 SG_ MLU_4_OD_CAN1_lastErrorCode m1106 : 16|32@1+ (1,0) [0|4294967295] ""  MLU_4
 SG_ MLU_4_OD_CAN1_RxErrCnt m1105 : 16|8@1+ (1,0) [0|255] ""  MLU_4
 SG_ MLU_4_OD_CAN1_TxErrCnt m1104 : 16|8@1+ (1,0) [0|255] ""  MLU_4
 SG_ MLU_4_OD_BuildTime m1073 : 16|24@1+ (1,0) [0|16777215] ""  MLU_4
 SG_ MLU_4_OD_BuildDate m1072 : 16|32@1+ (1,0) [0|4294967295] ""  MLU_4
 SG_ MLU_4_OD_ChipUID2 m1057 : 16|48@1+ (1,0) [0|281474976710655] ""  MLU_4
 SG_ MLU_4_OD_ChipUID1 m1056 : 16|48@1+ (1,0) [0|281474976710655] ""  MLU_4
 SG_ MLU_4_OD_SdcOut m1046 : 16|8@1+ (1,0) [0|255] ""  MLU_4
 SG_ MLU_4_OD_SdcIn m1045 : 16|8@1+ (1,0) [0|255] ""  MLU_4
 SG_ MLU_4_OD_runtime m1044 : 16|24@1+ (1,0) [0|16777215] "ms"  MLU_4
 SG_ MLU_4_OD_InputVoltage m1043 : 16|16@1+ (0.001,0) [0|65.535] "V"  MLU_4
 SG_ MLU_4_OD_BoardTemp m1042 : 16|16@1+ (0.01,-30) [-30|625.35] "°C"  MLU_4
 SG_ MLU_4_OD_MemFree m1041 : 16|16@1+ (4,0) [0|262140] "bytes"  MLU_4
 SG_ MLU_4_OD_CpuUsage m1040 : 16|8@1+ (0.5,0) [0|100] "%"  MLU_4
 SG_ MLU_4_OD_OdEntrySendInterval m33 : 16|16@1+ (1,0) [0|65535] "ms"  MLU_4
 SG_ MLU_4_OD_SendOdOnBootup m32 : 16|8@1+ (1,0) [0|255] ""  MLU_4
 SG_ MLU_4_OD_HeartbeatInterval m16 : 16|16@1+ (1,0) [0|65535] "ms"  MLU_4
 SG_ MLU_4_OD_DbcVersion m5 : 16|16@1+ (1,0) [0|65535] ""  MLU_4
 SG_ MLU_4_OD_StackVersion m4 : 16|16@1+ (1,0) [0|65535] ""  MLU_4
 SG_ MLU_4_OD_ProtocolVersion m3 : 16|16@1+ (1,0) [0|65535] ""  MLU_4
 SG_ MLU_4_OD_NodeStatus m2 : 16|8@1+ (1,0) [0|255] ""  MLU_4
 SG_ MLU_4_OD_NodeID m1 : 16|8@1+ (1,0) [0|255] ""  MLU_4
 SG_ MLU_4_SDO_ID M : 0|12@1+ (1,0) [0|4095] ""  MLU_4

BO_ 1544 MLU_4_SDO_Req_Down: 2 TelemetryNode
 SG_ MLU_4_SDO_ID M : 0|12@1+ (1,0) [0|4095] ""  MLU_4

BO_ 1800 MLU_4_Heartbeat: 1 MLU_4
 SG_ MLU_4_NodeState : 0|8@1+ (1,0) [0|0] ""  Master,TelemetryNode

BO_ 1864 MLU_4_BTL_TX: 8 MLU_4

BO_ 1928 MLU_4_BTL_RX: 8 TelemetryNode

BO_ 137 MLU_5_EMCY: 4 MLU_5
 SG_ MLU_5_E0_OtherError : 12|1@1+ (1,0) [0|0] ""  Master,TelemetryNode
 SG_ MLU_5_W0_OtherWarning : 0|1@1+ (1,0) [0|0] ""  Master,TelemetryNode

BO_ 393 MLU_5_TX_PDO1: 0 MLU_5

BO_ 457 MLU_5_RX_PDO1: 0 Vector__XXX

BO_ 521 MLU_5_TX_PDO2: 0 MLU_5

BO_ 585 MLU_5_RX_PDO2: 0 Vector__XXX

BO_ 649 MLU_5_TX_PDO3: 0 MLU_5

BO_ 713 MLU_5_RX_PDO3: 0 Vector__XXX

BO_ 777 MLU_5_TX_PDO4: 0 MLU_5

BO_ 841 MLU_5_RX_PDO4: 0 Vector__XXX

BO_ 905 MLU_5_TX_PDO5: 0 MLU_5

BO_ 969 MLU_5_TX_PDO6: 0 MLU_5

BO_ 1033 MLU_5_TX_PDO7: 0 MLU_5

BO_ 1097 MLU_5_TX_PDO8: 0 MLU_5

BO_ 1161 MLU_5_TX_PDO9: 0 MLU_5

BO_ 1225 MLU_5_TX_PDO10: 0 MLU_5

BO_ 1289 MLU_5_TX_PDO11: 0 MLU_5

BO_ 1353 MLU_5_TX_PDO12: 0 MLU_5

BO_ 1417 MLU_5_SDO_Resp: 8 MLU_5
 SG_ MLU_5_OD_CAN2_DelayedTxMessages m1129 : 16|24@1+ (1,0) [0|16777215] ""  TelemetryNode
 SG_ MLU_5_OD_CAN2_ErrorStatus m1128 : 16|8@1+ (1,0) [0|255] ""  TelemetryNode
 SG_ MLU_5_OD_CAN2_DiscardedTxMessage m1127 : 16|24@1+ (1,0) [0|16777215] ""  TelemetryNode
 SG_ MLU_5_OD_CAN2_Status m1126 : 16|8@1+ (1,0) [0|255] ""  TelemetryNode
 SG_ MLU_5_OD_CAN2_Baudrate m1124 : 16|16@1+ (1,0) [125|1000] "kbps"  TelemetryNode
 SG_ MLU_5_OD_CAN2_autoErrorReset m1123 : 16|8@1+ (1,0) [0|255] ""  TelemetryNode
 SG_ MLU_5_OD_CAN2_lastErrorCode m1122 : 16|32@1+ (1,0) [0|4294967295] ""  TelemetryNode
 SG_ MLU_5_OD_CAN2_RxErrCnt m1121 : 16|8@1+ (1,0) [0|255] ""  TelemetryNode
 SG_ MLU_5_OD_CAN2_TxErrCnt m1120 : 16|8@1+ (1,0) [0|255] ""  TelemetryNode
 SG_ MLU_5_OD_CAN1_DelayedTxMessages m1113 : 16|24@1+ (1,0) [0|16777215] ""  TelemetryNode
 SG_ MLU_5_OD_CAN1_ErrorStatus m1112 : 16|8@1+ (1,0) [0|255] ""  TelemetryNode
 SG_ MLU_5_OD_CAN1_DiscardedTxMessage m1111 : 16|24@1+ (1,0) [0|16777215] ""  TelemetryNode
 SG_ MLU_5_OD_CAN1_Status m1110 : 16|8@1+ (1,0) [0|255] ""  TelemetryNode
 SG_ MLU_5_OD_CAN1_Baudrate m1108 : 16|16@1+ (1,0) [125|1000] "kbps"  TelemetryNode
 SG_ MLU_5_OD_CAN1_autoErrorReset m1107 : 16|8@1+ (1,0) [0|255] ""  TelemetryNode
 SG_ MLU_5_OD_CAN1_lastErrorCode m1106 : 16|32@1+ (1,0) [0|4294967295] ""  TelemetryNode
 SG_ MLU_5_OD_CAN1_RxErrCnt m1105 : 16|8@1+ (1,0) [0|255] ""  TelemetryNode
 SG_ MLU_5_OD_CAN1_TxErrCnt m1104 : 16|8@1+ (1,0) [0|255] ""  TelemetryNode
 SG_ MLU_5_OD_BuildTime m1073 : 16|24@1+ (1,0) [0|16777215] ""  TelemetryNode
 SG_ MLU_5_OD_BuildDate m1072 : 16|32@1+ (1,0) [0|4294967295] ""  TelemetryNode
 SG_ MLU_5_OD_ChipUID2 m1057 : 16|48@1+ (1,0) [0|281474976710655] ""  TelemetryNode
 SG_ MLU_5_OD_ChipUID1 m1056 : 16|48@1+ (1,0) [0|281474976710655] ""  TelemetryNode
 SG_ MLU_5_OD_SdcOut m1046 : 16|8@1+ (1,0) [0|255] ""  TelemetryNode
 SG_ MLU_5_OD_SdcIn m1045 : 16|8@1+ (1,0) [0|255] ""  TelemetryNode
 SG_ MLU_5_OD_runtime m1044 : 16|24@1+ (1,0) [0|16777215] "ms"  TelemetryNode
 SG_ MLU_5_OD_InputVoltage m1043 : 16|16@1+ (0.001,0) [0|65.535] "V"  TelemetryNode
 SG_ MLU_5_OD_BoardTemp m1042 : 16|16@1+ (0.01,-30) [-30|625.35] "°C"  TelemetryNode
 SG_ MLU_5_OD_MemFree m1041 : 16|16@1+ (4,0) [0|262140] "bytes"  TelemetryNode
 SG_ MLU_5_OD_CpuUsage m1040 : 16|8@1+ (0.5,0) [0|100] "%"  TelemetryNode
 SG_ MLU_5_OD_OdEntrySendInterval m33 : 16|16@1+ (1,0) [0|65535] "ms"  TelemetryNode
 SG_ MLU_5_OD_SendOdOnBootup m32 : 16|8@1+ (1,0) [0|255] ""  TelemetryNode
 SG_ MLU_5_OD_HeartbeatInterval m16 : 16|16@1+ (1,0) [0|65535] "ms"  TelemetryNode
 SG_ MLU_5_OD_DbcVersion m5 : 16|16@1+ (1,0) [0|65535] ""  TelemetryNode
 SG_ MLU_5_OD_StackVersion m4 : 16|16@1+ (1,0) [0|65535] ""  TelemetryNode
 SG_ MLU_5_OD_ProtocolVersion m3 : 16|16@1+ (1,0) [0|65535] ""  TelemetryNode
 SG_ MLU_5_OD_NodeStatus m2 : 16|8@1+ (1,0) [0|255] ""  TelemetryNode
 SG_ MLU_5_OD_NodeID m1 : 16|8@1+ (1,0) [0|255] ""  TelemetryNode
 SG_ MLU_5_SDO_RespCode : 12|4@1+ (1,0) [0|0] ""  TelemetryNode
 SG_ MLU_5_SDO_ID M : 0|12@1+ (1,0) [0|4095] ""  TelemetryNode

BO_ 1481 MLU_5_SDO_Req_Up: 8 TelemetryNode
 SG_ MLU_5_OD_CAN2_DelayedTxMessages m1129 : 16|24@1+ (1,0) [0|16777215] ""  MLU_5
 SG_ MLU_5_OD_CAN2_ErrorStatus m1128 : 16|8@1+ (1,0) [0|255] ""  MLU_5
 SG_ MLU_5_OD_CAN2_DiscardedTxMe_0000 m1127 : 16|24@1+ (1,0) [0|16777215] ""  MLU_5
 SG_ MLU_5_OD_CAN2_Status m1126 : 16|8@1+ (1,0) [0|255] ""  MLU_5
 SG_ MLU_5_OD_CAN2_Baudrate m1124 : 16|16@1+ (1,0) [125|1000] "kbps"  MLU_5
 SG_ MLU_5_OD_CAN2_autoErrorReset m1123 : 16|8@1+ (1,0) [0|255] ""  MLU_5
 SG_ MLU_5_OD_CAN2_lastErrorCode m1122 : 16|32@1+ (1,0) [0|4294967295] ""  MLU_5
 SG_ MLU_5_OD_CAN2_RxErrCnt m1121 : 16|8@1+ (1,0) [0|255] ""  MLU_5
 SG_ MLU_5_OD_CAN2_TxErrCnt m1120 : 16|8@1+ (1,0) [0|255] ""  MLU_5
 SG_ MLU_5_OD_CAN1_DelayedTxMessages m1113 : 16|24@1+ (1,0) [0|16777215] ""  MLU_5
 SG_ MLU_5_OD_CAN1_ErrorStatus m1112 : 16|8@1+ (1,0) [0|255] ""  MLU_5
 SG_ MLU_5_OD_CAN1_DiscardedTxMe_0000 m1111 : 16|24@1+ (1,0) [0|16777215] ""  MLU_5
 SG_ MLU_5_OD_CAN1_Status m1110 : 16|8@1+ (1,0) [0|255] ""  MLU_5
 SG_ MLU_5_OD_CAN1_Baudrate m1108 : 16|16@1+ (1,0) [125|1000] "kbps"  MLU_5
 SG_ MLU_5_OD_CAN1_autoErrorReset m1107 : 16|8@1+ (1,0) [0|255] ""  MLU_5
 SG_ MLU_5_OD_CAN1_lastErrorCode m1106 : 16|32@1+ (1,0) [0|4294967295] ""  MLU_5
 SG_ MLU_5_OD_CAN1_RxErrCnt m1105 : 16|8@1+ (1,0) [0|255] ""  MLU_5
 SG_ MLU_5_OD_CAN1_TxErrCnt m1104 : 16|8@1+ (1,0) [0|255] ""  MLU_5
 SG_ MLU_5_OD_BuildTime m1073 : 16|24@1+ (1,0) [0|16777215] ""  MLU_5
 SG_ MLU_5_OD_BuildDate m1072 : 16|32@1+ (1,0) [0|4294967295] ""  MLU_5
 SG_ MLU_5_OD_ChipUID2 m1057 : 16|48@1+ (1,0) [0|281474976710655] ""  MLU_5
 SG_ MLU_5_OD_ChipUID1 m1056 : 16|48@1+ (1,0) [0|281474976710655] ""  MLU_5
 SG_ MLU_5_OD_SdcOut m1046 : 16|8@1+ (1,0) [0|255] ""  MLU_5
 SG_ MLU_5_OD_SdcIn m1045 : 16|8@1+ (1,0) [0|255] ""  MLU_5
 SG_ MLU_5_OD_runtime m1044 : 16|24@1+ (1,0) [0|16777215] "ms"  MLU_5
 SG_ MLU_5_OD_InputVoltage m1043 : 16|16@1+ (0.001,0) [0|65.535] "V"  MLU_5
 SG_ MLU_5_OD_BoardTemp m1042 : 16|16@1+ (0.01,-30) [-30|625.35] "°C"  MLU_5
 SG_ MLU_5_OD_MemFree m1041 : 16|16@1+ (4,0) [0|262140] "bytes"  MLU_5
 SG_ MLU_5_OD_CpuUsage m1040 : 16|8@1+ (0.5,0) [0|100] "%"  MLU_5
 SG_ MLU_5_OD_OdEntrySendInterval m33 : 16|16@1+ (1,0) [0|65535] "ms"  MLU_5
 SG_ MLU_5_OD_SendOdOnBootup m32 : 16|8@1+ (1,0) [0|255] ""  MLU_5
 SG_ MLU_5_OD_HeartbeatInterval m16 : 16|16@1+ (1,0) [0|65535] "ms"  MLU_5
 SG_ MLU_5_OD_DbcVersion m5 : 16|16@1+ (1,0) [0|65535] ""  MLU_5
 SG_ MLU_5_OD_StackVersion m4 : 16|16@1+ (1,0) [0|65535] ""  MLU_5
 SG_ MLU_5_OD_ProtocolVersion m3 : 16|16@1+ (1,0) [0|65535] ""  MLU_5
 SG_ MLU_5_OD_NodeStatus m2 : 16|8@1+ (1,0) [0|255] ""  MLU_5
 SG_ MLU_5_OD_NodeID m1 : 16|8@1+ (1,0) [0|255] ""  MLU_5
 SG_ MLU_5_SDO_ID M : 0|12@1+ (1,0) [0|4095] ""  MLU_5

BO_ 1545 MLU_5_SDO_Req_Down: 2 TelemetryNode
 SG_ MLU_5_SDO_ID M : 0|12@1+ (1,0) [0|4095] ""  MLU_5

BO_ 1801 MLU_5_Heartbeat: 1 MLU_5
 SG_ MLU_5_NodeState : 0|8@1+ (1,0) [0|0] ""  Master,TelemetryNode

BO_ 1865 MLU_5_BTL_TX: 8 MLU_5

BO_ 1929 MLU_5_BTL_RX: 8 TelemetryNode

BO_ 144 MLU_6_EMCY: 4 MLU_6
 SG_ MLU_6_E0_OtherError : 12|1@1+ (1,0) [0|0] ""  Master,TelemetryNode
 SG_ MLU_6_W0_OtherWarning : 0|1@1+ (1,0) [0|0] ""  Master,TelemetryNode

BO_ 400 MLU_6_TX_PDO1: 0 MLU_6

BO_ 464 MLU_6_RX_PDO1: 0 Vector__XXX

BO_ 528 MLU_6_TX_PDO2: 0 MLU_6

BO_ 592 MLU_6_RX_PDO2: 0 Vector__XXX

BO_ 656 MLU_6_TX_PDO3: 0 MLU_6

BO_ 720 MLU_6_RX_PDO3: 0 Vector__XXX

BO_ 784 MLU_6_TX_PDO4: 0 MLU_6

BO_ 848 MLU_6_RX_PDO4: 0 Vector__XXX

BO_ 912 MLU_6_TX_PDO5: 0 MLU_6

BO_ 976 MLU_6_TX_PDO6: 0 MLU_6

BO_ 1040 MLU_6_TX_PDO7: 0 MLU_6

BO_ 1104 MLU_6_TX_PDO8: 0 MLU_6

BO_ 1168 MLU_6_TX_PDO9: 0 MLU_6

BO_ 1232 MLU_6_TX_PDO10: 0 MLU_6

BO_ 1296 MLU_6_TX_PDO11: 0 MLU_6

BO_ 1360 MLU_6_TX_PDO12: 0 MLU_6

BO_ 1424 MLU_6_SDO_Resp: 8 MLU_6
 SG_ MLU_6_OD_CAN2_DelayedTxMessages m1129 : 16|24@1+ (1,0) [0|16777215] ""  TelemetryNode
 SG_ MLU_6_OD_CAN2_ErrorStatus m1128 : 16|8@1+ (1,0) [0|255] ""  TelemetryNode
 SG_ MLU_6_OD_CAN2_DiscardedTxMessage m1127 : 16|24@1+ (1,0) [0|16777215] ""  TelemetryNode
 SG_ MLU_6_OD_CAN2_Status m1126 : 16|8@1+ (1,0) [0|255] ""  TelemetryNode
 SG_ MLU_6_OD_CAN2_Baudrate m1124 : 16|16@1+ (1,0) [125|1000] "kbps"  TelemetryNode
 SG_ MLU_6_OD_CAN2_autoErrorReset m1123 : 16|8@1+ (1,0) [0|255] ""  TelemetryNode
 SG_ MLU_6_OD_CAN2_lastErrorCode m1122 : 16|32@1+ (1,0) [0|4294967295] ""  TelemetryNode
 SG_ MLU_6_OD_CAN2_RxErrCnt m1121 : 16|8@1+ (1,0) [0|255] ""  TelemetryNode
 SG_ MLU_6_OD_CAN2_TxErrCnt m1120 : 16|8@1+ (1,0) [0|255] ""  TelemetryNode
 SG_ MLU_6_OD_CAN1_DelayedTxMessages m1113 : 16|24@1+ (1,0) [0|16777215] ""  TelemetryNode
 SG_ MLU_6_OD_CAN1_ErrorStatus m1112 : 16|8@1+ (1,0) [0|255] ""  TelemetryNode
 SG_ MLU_6_OD_CAN1_DiscardedTxMessage m1111 : 16|24@1+ (1,0) [0|16777215] ""  TelemetryNode
 SG_ MLU_6_OD_CAN1_Status m1110 : 16|8@1+ (1,0) [0|255] ""  TelemetryNode
 SG_ MLU_6_OD_CAN1_Baudrate m1108 : 16|16@1+ (1,0) [125|1000] "kbps"  TelemetryNode
 SG_ MLU_6_OD_CAN1_autoErrorReset m1107 : 16|8@1+ (1,0) [0|255] ""  TelemetryNode
 SG_ MLU_6_OD_CAN1_lastErrorCode m1106 : 16|32@1+ (1,0) [0|4294967295] ""  TelemetryNode
 SG_ MLU_6_OD_CAN1_RxErrCnt m1105 : 16|8@1+ (1,0) [0|255] ""  TelemetryNode
 SG_ MLU_6_OD_CAN1_TxErrCnt m1104 : 16|8@1+ (1,0) [0|255] ""  TelemetryNode
 SG_ MLU_6_OD_BuildTime m1073 : 16|24@1+ (1,0) [0|16777215] ""  TelemetryNode
 SG_ MLU_6_OD_BuildDate m1072 : 16|32@1+ (1,0) [0|4294967295] ""  TelemetryNode
 SG_ MLU_6_OD_ChipUID2 m1057 : 16|48@1+ (1,0) [0|281474976710655] ""  TelemetryNode
 SG_ MLU_6_OD_ChipUID1 m1056 : 16|48@1+ (1,0) [0|281474976710655] ""  TelemetryNode
 SG_ MLU_6_OD_SdcOut m1046 : 16|8@1+ (1,0) [0|255] ""  TelemetryNode
 SG_ MLU_6_OD_SdcIn m1045 : 16|8@1+ (1,0) [0|255] ""  TelemetryNode
 SG_ MLU_6_OD_runtime m1044 : 16|24@1+ (1,0) [0|16777215] "ms"  TelemetryNode
 SG_ MLU_6_OD_InputVoltage m1043 : 16|16@1+ (0.001,0) [0|65.535] "V"  TelemetryNode
 SG_ MLU_6_OD_BoardTemp m1042 : 16|16@1+ (0.01,-30) [-30|625.35] "°C"  TelemetryNode
 SG_ MLU_6_OD_MemFree m1041 : 16|16@1+ (4,0) [0|262140] "bytes"  TelemetryNode
 SG_ MLU_6_OD_CpuUsage m1040 : 16|8@1+ (0.5,0) [0|100] "%"  TelemetryNode
 SG_ MLU_6_OD_OdEntrySendInterval m33 : 16|16@1+ (1,0) [0|65535] "ms"  TelemetryNode
 SG_ MLU_6_OD_SendOdOnBootup m32 : 16|8@1+ (1,0) [0|255] ""  TelemetryNode
 SG_ MLU_6_OD_HeartbeatInterval m16 : 16|16@1+ (1,0) [0|65535] "ms"  TelemetryNode
 SG_ MLU_6_OD_DbcVersion m5 : 16|16@1+ (1,0) [0|65535] ""  TelemetryNode
 SG_ MLU_6_OD_StackVersion m4 : 16|16@1+ (1,0) [0|65535] ""  TelemetryNode
 SG_ MLU_6_OD_ProtocolVersion m3 : 16|16@1+ (1,0) [0|65535] ""  TelemetryNode
 SG_ MLU_6_OD_NodeStatus m2 : 16|8@1+ (1,0) [0|255] ""  TelemetryNode
 SG_ MLU_6_OD_NodeID m1 : 16|8@1+ (1,0) [0|255] ""  TelemetryNode
 SG_ MLU_6_SDO_RespCode : 12|4@1+ (1,0) [0|0] ""  TelemetryNode
 SG_ MLU_6_SDO_ID M : 0|12@1+ (1,0) [0|4095] ""  TelemetryNode

BO_ 1488 MLU_6_SDO_Req_Up: 8 TelemetryNode
 SG_ MLU_6_OD_CAN2_DelayedTxMessages m1129 : 16|24@1+ (1,0) [0|16777215] ""  MLU_6
 SG_ MLU_6_OD_CAN2_ErrorStatus m1128 : 16|8@1+ (1,0) [0|255] ""  MLU_6
 SG_ MLU_6_OD_CAN2_DiscardedTxMe_0000 m1127 : 16|24@1+ (1,0) [0|16777215] ""  MLU_6
 SG_ MLU_6_OD_CAN2_Status m1126 : 16|8@1+ (1,0) [0|255] ""  MLU_6
 SG_ MLU_6_OD_CAN2_Baudrate m1124 : 16|16@1+ (1,0) [125|1000] "kbps"  MLU_6
 SG_ MLU_6_OD_CAN2_autoErrorReset m1123 : 16|8@1+ (1,0) [0|255] ""  MLU_6
 SG_ MLU_6_OD_CAN2_lastErrorCode m1122 : 16|32@1+ (1,0) [0|4294967295] ""  MLU_6
 SG_ MLU_6_OD_CAN2_RxErrCnt m1121 : 16|8@1+ (1,0) [0|255] ""  MLU_6
 SG_ MLU_6_OD_CAN2_TxErrCnt m1120 : 16|8@1+ (1,0) [0|255] ""  MLU_6
 SG_ MLU_6_OD_CAN1_DelayedTxMessages m1113 : 16|24@1+ (1,0) [0|16777215] ""  MLU_6
 SG_ MLU_6_OD_CAN1_ErrorStatus m1112 : 16|8@1+ (1,0) [0|255] ""  MLU_6
 SG_ MLU_6_OD_CAN1_DiscardedTxMe_0000 m1111 : 16|24@1+ (1,0) [0|16777215] ""  MLU_6
 SG_ MLU_6_OD_CAN1_Status m1110 : 16|8@1+ (1,0) [0|255] ""  MLU_6
 SG_ MLU_6_OD_CAN1_Baudrate m1108 : 16|16@1+ (1,0) [125|1000] "kbps"  MLU_6
 SG_ MLU_6_OD_CAN1_autoErrorReset m1107 : 16|8@1+ (1,0) [0|255] ""  MLU_6
 SG_ MLU_6_OD_CAN1_lastErrorCode m1106 : 16|32@1+ (1,0) [0|4294967295] ""  MLU_6
 SG_ MLU_6_OD_CAN1_RxErrCnt m1105 : 16|8@1+ (1,0) [0|255] ""  MLU_6
 SG_ MLU_6_OD_CAN1_TxErrCnt m1104 : 16|8@1+ (1,0) [0|255] ""  MLU_6
 SG_ MLU_6_OD_BuildTime m1073 : 16|24@1+ (1,0) [0|16777215] ""  MLU_6
 SG_ MLU_6_OD_BuildDate m1072 : 16|32@1+ (1,0) [0|4294967295] ""  MLU_6
 SG_ MLU_6_OD_ChipUID2 m1057 : 16|48@1+ (1,0) [0|281474976710655] ""  MLU_6
 SG_ MLU_6_OD_ChipUID1 m1056 : 16|48@1+ (1,0) [0|281474976710655] ""  MLU_6
 SG_ MLU_6_OD_SdcOut m1046 : 16|8@1+ (1,0) [0|255] ""  MLU_6
 SG_ MLU_6_OD_SdcIn m1045 : 16|8@1+ (1,0) [0|255] ""  MLU_6
 SG_ MLU_6_OD_runtime m1044 : 16|24@1+ (1,0) [0|16777215] "ms"  MLU_6
 SG_ MLU_6_OD_InputVoltage m1043 : 16|16@1+ (0.001,0) [0|65.535] "V"  MLU_6
 SG_ MLU_6_OD_BoardTemp m1042 : 16|16@1+ (0.01,-30) [-30|625.35] "°C"  MLU_6
 SG_ MLU_6_OD_MemFree m1041 : 16|16@1+ (4,0) [0|262140] "bytes"  MLU_6
 SG_ MLU_6_OD_CpuUsage m1040 : 16|8@1+ (0.5,0) [0|100] "%"  MLU_6
 SG_ MLU_6_OD_OdEntrySendInterval m33 : 16|16@1+ (1,0) [0|65535] "ms"  MLU_6
 SG_ MLU_6_OD_SendOdOnBootup m32 : 16|8@1+ (1,0) [0|255] ""  MLU_6
 SG_ MLU_6_OD_HeartbeatInterval m16 : 16|16@1+ (1,0) [0|65535] "ms"  MLU_6
 SG_ MLU_6_OD_DbcVersion m5 : 16|16@1+ (1,0) [0|65535] ""  MLU_6
 SG_ MLU_6_OD_StackVersion m4 : 16|16@1+ (1,0) [0|65535] ""  MLU_6
 SG_ MLU_6_OD_ProtocolVersion m3 : 16|16@1+ (1,0) [0|65535] ""  MLU_6
 SG_ MLU_6_OD_NodeStatus m2 : 16|8@1+ (1,0) [0|255] ""  MLU_6
 SG_ MLU_6_OD_NodeID m1 : 16|8@1+ (1,0) [0|255] ""  MLU_6
 SG_ MLU_6_SDO_ID M : 0|12@1+ (1,0) [0|4095] ""  MLU_6

BO_ 1552 MLU_6_SDO_Req_Down: 2 TelemetryNode
 SG_ MLU_6_SDO_ID M : 0|12@1+ (1,0) [0|4095] ""  MLU_6

BO_ 1808 MLU_6_Heartbeat: 1 MLU_6
 SG_ MLU_6_NodeState : 0|8@1+ (1,0) [0|0] ""  Master,TelemetryNode

BO_ 1872 MLU_6_BTL_TX: 8 MLU_6

BO_ 1936 MLU_6_BTL_RX: 8 TelemetryNode

CM_ BO_ 1925 "Bootloader receive by node MLU_1 with Node-ID 0x5";
CM_ BO_ 134 "Emergency message of node MLU_2 with Node-ID 0x6";
CM_ SG_ 134 MLU_2_E0_OtherError "Other error.";
CM_ SG_ 134 MLU_2_W0_OtherWarning "Other warning.";
CM_ BO_ 390 "Transmit PDO 1 of node MLU_2 with Node-ID 0x6";
CM_ BO_ 454 "Receive PDO 1 of node MLU_2 with Node-ID 0x6";
CM_ BO_ 518 "Transmit PDO 2 of node MLU_2 with Node-ID 0x6";
CM_ BO_ 582 "Receive PDO 2 of node MLU_2 with Node-ID 0x6";
CM_ BO_ 646 "Transmit PDO 3 of node MLU_2 with Node-ID 0x6";
CM_ BO_ 710 "Receive PDO 3 of node MLU_2 with Node-ID 0x6";
CM_ BO_ 774 "Transmit PDO 4 of node MLU_2 with Node-ID 0x6";
CM_ BO_ 838 "Receive PDO 4 of node MLU_2 with Node-ID 0x6";
CM_ BO_ 902 "Transmit PDO 5 of node MLU_2 with Node-ID 0x6";
CM_ BO_ 966 "Transmit PDO 6 of node MLU_2 with Node-ID 0x6";
CM_ BO_ 1030 "Transmit PDO 7 of node MLU_2 with Node-ID 0x6";
CM_ BO_ 1094 "Transmit PDO 8 of node MLU_2 with Node-ID 0x6";
CM_ BO_ 1158 "Transmit PDO 9 of node MLU_2 with Node-ID 0x6";
CM_ BO_ 1222 "Transmit PDO 10 of node MLU_2 with Node-ID 0x6";
CM_ BO_ 1286 "Transmit PDO 11 of node MLU_2 with Node-ID 0x6";
CM_ BO_ 1350 "Transmit PDO 12 of node MLU_2 with Node-ID 0x6";
CM_ BO_ 1414 "DO NOT CHANGE ANYTHING HERE!
SDO Response of node MLU_2 with Node-ID 0x6";
CM_ SG_ 1414 MLU_2_OD_CAN2_DelayedTxMessages "Number of delayed TX messages on CAN2 because no messagebox was free.";
CM_ SG_ 1414 MLU_2_OD_CAN2_ErrorStatus "Internal error status (e.g. Error active, Error passive, Bus Off)";
CM_ SG_ 1414 MLU_2_OD_CAN2_DiscardedTxMessage "Number of discarded TX messages on CAN2 because all messageboxes were full";
CM_ SG_ 1414 MLU_2_OD_CAN2_Status "Status of CAN2.";
CM_ SG_ 1414 MLU_2_OD_CAN2_Baudrate "Baudrate of CAN.";
CM_ SG_ 1414 MLU_2_OD_CAN2_autoErrorReset "Automatic reset of errors.";
CM_ SG_ 1414 MLU_2_OD_CAN2_lastErrorCode "Last error code.";
CM_ SG_ 1414 MLU_2_OD_CAN2_RxErrCnt "Receive error count of CAN1.";
CM_ SG_ 1414 MLU_2_OD_CAN2_TxErrCnt "Transmit error count of CAN1.";
CM_ SG_ 1414 MLU_2_OD_CAN1_DelayedTxMessages "Number of delayed TX messages on CAN1 because no messagebox was free.";
CM_ SG_ 1414 MLU_2_OD_CAN1_ErrorStatus "Internal error status (e.g. Error active, Error passive, Bus Off)";
CM_ SG_ 1414 MLU_2_OD_CAN1_DiscardedTxMessage "Number of discarded TX messages on CAN1 because all messageboxes were full";
CM_ SG_ 1414 MLU_2_OD_CAN1_Status "Status of CAN1.";
CM_ SG_ 1414 MLU_2_OD_CAN1_Baudrate "Baudrate of CAN.";
CM_ SG_ 1414 MLU_2_OD_CAN1_autoErrorReset "Automatic reset of errors.";
CM_ SG_ 1414 MLU_2_OD_CAN1_lastErrorCode "Last error code.";
CM_ SG_ 1414 MLU_2_OD_CAN1_RxErrCnt "Receive error count of CAN1.";
CM_ SG_ 1414 MLU_2_OD_CAN1_TxErrCnt "Transmit error count of CAN1.";
CM_ SG_ 1414 MLU_2_OD_BuildTime "Software build time in the format HHMMSS.";
CM_ SG_ 1414 MLU_2_OD_BuildDate "Software build date in the format YYYYMMDD.";
CM_ SG_ 1414 MLU_2_OD_ChipUID2 "Seccond part of unique ID of microcontroller.";
CM_ SG_ 1414 MLU_2_OD_ChipUID1 "First part of unique ID of microcontroller.";
CM_ SG_ 1414 MLU_2_OD_SdcOut "Measurement of Shutdown Circuit Output";
CM_ SG_ 1414 MLU_2_OD_SdcIn "Measurement of Shutdown Circuit Input";
CM_ SG_ 1414 MLU_2_OD_runtime "Runtime of chip in milliseconds.";
CM_ SG_ 1414 MLU_2_OD_InputVoltage "Board supply voltage.";
CM_ SG_ 1414 MLU_2_OD_BoardTemp "Temperature of board";
CM_ SG_ 1414 MLU_2_OD_MemFree "Free memory in bytes.";
CM_ SG_ 1414 MLU_2_OD_CpuUsage "Current CPU usage in %.";
CM_ SG_ 1414 MLU_2_OD_OdEntrySendInterval "Interval for sending all readable OD entries. Sending is disabled if less than 5 ms.";
CM_ SG_ 1414 MLU_2_OD_SendOdOnBootup "Whether to send all OD entries on bootup.";
CM_ SG_ 1414 MLU_2_OD_HeartbeatInterval "Heartbeat Interval in milliseconds.";
CM_ SG_ 1414 MLU_2_OD_DbcVersion "CANzero DBC version.";
CM_ SG_ 1414 MLU_2_OD_StackVersion "CANzero stack version.";
CM_ SG_ 1414 MLU_2_OD_ProtocolVersion "CANzero Protocol Version.";
CM_ SG_ 1414 MLU_2_OD_NodeStatus "State of the node.";
CM_ SG_ 1414 MLU_2_OD_NodeID "CANzero Node-ID.";
CM_ SG_ 1414 MLU_2_SDO_RespCode "Response code of SDO access.";
CM_ SG_ 1414 MLU_2_SDO_ID "Specifies SDO-ID of MLU_2";
CM_ BO_ 1478 "DO NOT CHANGE ANYTHING HERE!
SDO Request Upload to node MLU_2 with Node-ID 0x6";
CM_ SG_ 1478 MLU_2_OD_CAN2_DelayedTxMessages "Number of delayed TX messages on CAN2 because no messagebox was free.";
CM_ SG_ 1478 MLU_2_OD_CAN2_ErrorStatus "Internal error status (e.g. Error active, Error passive, Bus Off)";
CM_ SG_ 1478 MLU_2_OD_CAN2_DiscardedTxMe_0000 "Number of discarded TX messages on CAN2 because all messageboxes were full";
CM_ SG_ 1478 MLU_2_OD_CAN2_Status "Status of CAN2.";
CM_ SG_ 1478 MLU_2_OD_CAN2_Baudrate "Baudrate of CAN.";
CM_ SG_ 1478 MLU_2_OD_CAN2_autoErrorReset "Automatic reset of errors.";
CM_ SG_ 1478 MLU_2_OD_CAN2_lastErrorCode "Last error code.";
CM_ SG_ 1478 MLU_2_OD_CAN2_RxErrCnt "Receive error count of CAN1.";
CM_ SG_ 1478 MLU_2_OD_CAN2_TxErrCnt "Transmit error count of CAN1.";
CM_ SG_ 1478 MLU_2_OD_CAN1_DelayedTxMessages "Number of delayed TX messages on CAN1 because no messagebox was free.";
CM_ SG_ 1478 MLU_2_OD_CAN1_ErrorStatus "Internal error status (e.g. Error active, Error passive, Bus Off)";
CM_ SG_ 1478 MLU_2_OD_CAN1_DiscardedTxMe_0000 "Number of discarded TX messages on CAN1 because all messageboxes were full";
CM_ SG_ 1478 MLU_2_OD_CAN1_Status "Status of CAN1.";
CM_ SG_ 1478 MLU_2_OD_CAN1_Baudrate "Baudrate of CAN.";
CM_ SG_ 1478 MLU_2_OD_CAN1_autoErrorReset "Automatic reset of errors.";
CM_ SG_ 1478 MLU_2_OD_CAN1_lastErrorCode "Last error code.";
CM_ SG_ 1478 MLU_2_OD_CAN1_RxErrCnt "Receive error count of CAN1.";
CM_ SG_ 1478 MLU_2_OD_CAN1_TxErrCnt "Transmit error count of CAN1.";
CM_ SG_ 1478 MLU_2_OD_BuildTime "Software build time in the format HHMMSS.";
CM_ SG_ 1478 MLU_2_OD_BuildDate "Software build date in the format YYYYMMDD.";
CM_ SG_ 1478 MLU_2_OD_ChipUID2 "Seccond part of unique ID of microcontroller.";
CM_ SG_ 1478 MLU_2_OD_ChipUID1 "First part of unique ID of microcontroller.";
CM_ SG_ 1478 MLU_2_OD_SdcOut "Measurement of Shutdown Circuit Output";
CM_ SG_ 1478 MLU_2_OD_SdcIn "Measurement of Shutdown Circuit Input";
CM_ SG_ 1478 MLU_2_OD_runtime "Runtime of chip in milliseconds.";
CM_ SG_ 1478 MLU_2_OD_InputVoltage "Board supply voltage.";
CM_ SG_ 1478 MLU_2_OD_BoardTemp "Temperature of board";
CM_ SG_ 1478 MLU_2_OD_MemFree "Free memory in bytes.";
CM_ SG_ 1478 MLU_2_OD_CpuUsage "Current CPU usage in %.";
CM_ SG_ 1478 MLU_2_OD_OdEntrySendInterval "Interval for sending all readable OD entries. Sending is disabled if less than 5 ms.";
CM_ SG_ 1478 MLU_2_OD_SendOdOnBootup "Whether to send all OD entries on bootup.";
CM_ SG_ 1478 MLU_2_OD_HeartbeatInterval "Heartbeat Interval in milliseconds.";
CM_ SG_ 1478 MLU_2_OD_DbcVersion "CANzero DBC version.";
CM_ SG_ 1478 MLU_2_OD_StackVersion "CANzero stack version.";
CM_ SG_ 1478 MLU_2_OD_ProtocolVersion "CANzero Protocol Version.";
CM_ SG_ 1478 MLU_2_OD_NodeStatus "State of the node.";
CM_ SG_ 1478 MLU_2_OD_NodeID "CANzero Node-ID.";
CM_ SG_ 1478 MLU_2_SDO_ID "Specifies SDO-ID of MLU_2";
CM_ BO_ 1542 "DO NOT CHANGE ANYTHING HERE!
SDO Request Download from node MLU_2 with Node-ID 0x6";
CM_ SG_ 1542 MLU_2_SDO_ID "Specifies SDO-ID of MLU_2";
CM_ BO_ 1798 "Heartbeat of node MLU_2 with Node-ID 0x6";
CM_ SG_ 1798 MLU_2_NodeState "Heartbeat status of node MLU_2";
CM_ BO_ 1862 "Bootloader transmit from node MLU_2 with Node-ID 0x6";
CM_ BO_ 1926 "Bootloader receive by node MLU_2 with Node-ID 0x6";
CM_ BO_ 135 "Emergency message of node MLU_3 with Node-ID 0x7";
CM_ SG_ 135 MLU_3_E0_OtherError "Other error.";
CM_ SG_ 135 MLU_3_W0_OtherWarning "Other warning.";
CM_ BO_ 391 "Transmit PDO 1 of node MLU_3 with Node-ID 0x7";
CM_ BO_ 455 "Receive PDO 1 of node MLU_3 with Node-ID 0x7";
CM_ BO_ 519 "Transmit PDO 2 of node MLU_3 with Node-ID 0x7";
CM_ BO_ 583 "Receive PDO 2 of node MLU_3 with Node-ID 0x7";
CM_ BO_ 647 "Transmit PDO 3 of node MLU_3 with Node-ID 0x7";
CM_ BO_ 711 "Receive PDO 3 of node MLU_3 with Node-ID 0x7";
CM_ BO_ 775 "Transmit PDO 4 of node MLU_3 with Node-ID 0x7";
CM_ BO_ 839 "Receive PDO 4 of node MLU_3 with Node-ID 0x7";
CM_ BO_ 903 "Transmit PDO 5 of node MLU_3 with Node-ID 0x7";
CM_ BO_ 967 "Transmit PDO 6 of node MLU_3 with Node-ID 0x7";
CM_ BO_ 1031 "Transmit PDO 7 of node MLU_3 with Node-ID 0x7";
CM_ BO_ 1095 "Transmit PDO 8 of node MLU_3 with Node-ID 0x7";
CM_ BO_ 1159 "Transmit PDO 9 of node MLU_3 with Node-ID 0x7";
CM_ BO_ 1223 "Transmit PDO 10 of node MLU_3 with Node-ID 0x7";
CM_ BO_ 1287 "Transmit PDO 11 of node MLU_3 with Node-ID 0x7";
CM_ BO_ 1351 "Transmit PDO 12 of node MLU_3 with Node-ID 0x7";
CM_ BO_ 1415 "DO NOT CHANGE ANYTHING HERE!
SDO Response of node MLU_3 with Node-ID 0x7";
CM_ SG_ 1415 MLU_3_OD_CAN2_DelayedTxMessages "Number of delayed TX messages on CAN2 because no messagebox was free.";
CM_ SG_ 1415 MLU_3_OD_CAN2_ErrorStatus "Internal error status (e.g. Error active, Error passive, Bus Off)";
CM_ SG_ 1415 MLU_3_OD_CAN2_DiscardedTxMessage "Number of discarded TX messages on CAN2 because all messageboxes were full";
CM_ SG_ 1415 MLU_3_OD_CAN2_Status "Status of CAN2.";
CM_ SG_ 1415 MLU_3_OD_CAN2_Baudrate "Baudrate of CAN.";
CM_ SG_ 1415 MLU_3_OD_CAN2_autoErrorReset "Automatic reset of errors.";
CM_ SG_ 1415 MLU_3_OD_CAN2_lastErrorCode "Last error code.";
CM_ SG_ 1415 MLU_3_OD_CAN2_RxErrCnt "Receive error count of CAN1.";
CM_ SG_ 1415 MLU_3_OD_CAN2_TxErrCnt "Transmit error count of CAN1.";
CM_ SG_ 1415 MLU_3_OD_CAN1_DelayedTxMessages "Number of delayed TX messages on CAN1 because no messagebox was free.";
CM_ SG_ 1415 MLU_3_OD_CAN1_ErrorStatus "Internal error status (e.g. Error active, Error passive, Bus Off)";
CM_ SG_ 1415 MLU_3_OD_CAN1_DiscardedTxMessage "Number of discarded TX messages on CAN1 because all messageboxes were full";
CM_ SG_ 1415 MLU_3_OD_CAN1_Status "Status of CAN1.";
CM_ SG_ 1415 MLU_3_OD_CAN1_Baudrate "Baudrate of CAN.";
CM_ SG_ 1415 MLU_3_OD_CAN1_autoErrorReset "Automatic reset of errors.";
CM_ SG_ 1415 MLU_3_OD_CAN1_lastErrorCode "Last error code.";
CM_ SG_ 1415 MLU_3_OD_CAN1_RxErrCnt "Receive error count of CAN1.";
CM_ SG_ 1415 MLU_3_OD_CAN1_TxErrCnt "Transmit error count of CAN1.";
CM_ SG_ 1415 MLU_3_OD_BuildTime "Software build time in the format HHMMSS.";
CM_ SG_ 1415 MLU_3_OD_BuildDate "Software build date in the format YYYYMMDD.";
CM_ SG_ 1415 MLU_3_OD_ChipUID2 "Seccond part of unique ID of microcontroller.";
CM_ SG_ 1415 MLU_3_OD_ChipUID1 "First part of unique ID of microcontroller.";
CM_ SG_ 1415 MLU_3_OD_SdcOut "Measurement of Shutdown Circuit Output";
CM_ SG_ 1415 MLU_3_OD_SdcIn "Measurement of Shutdown Circuit Input";
CM_ SG_ 1415 MLU_3_OD_runtime "Runtime of chip in milliseconds.";
CM_ SG_ 1415 MLU_3_OD_InputVoltage "Board supply voltage.";
CM_ SG_ 1415 MLU_3_OD_BoardTemp "Temperature of board";
CM_ SG_ 1415 MLU_3_OD_MemFree "Free memory in bytes.";
CM_ SG_ 1415 MLU_3_OD_CpuUsage "Current CPU usage in %.";
CM_ SG_ 1415 MLU_3_OD_OdEntrySendInterval "Interval for sending all readable OD entries. Sending is disabled if less than 5 ms.";
CM_ SG_ 1415 MLU_3_OD_SendOdOnBootup "Whether to send all OD entries on bootup.";
CM_ SG_ 1415 MLU_3_OD_HeartbeatInterval "Heartbeat Interval in milliseconds.";
CM_ SG_ 1415 MLU_3_OD_DbcVersion "CANzero DBC version.";
CM_ SG_ 1415 MLU_3_OD_StackVersion "CANzero stack version.";
CM_ SG_ 1415 MLU_3_OD_ProtocolVersion "CANzero Protocol Version.";
CM_ SG_ 1415 MLU_3_OD_NodeStatus "State of the node.";
CM_ SG_ 1415 MLU_3_OD_NodeID "CANzero Node-ID.";
CM_ SG_ 1415 MLU_3_SDO_RespCode "Response code of SDO access.";
CM_ SG_ 1415 MLU_3_SDO_ID "Specifies SDO-ID of MLU_3";
CM_ BO_ 1479 "DO NOT CHANGE ANYTHING HERE!
SDO Request Upload to node MLU_3 with Node-ID 0x7";
CM_ SG_ 1479 MLU_3_OD_CAN2_DelayedTxMessages "Number of delayed TX messages on CAN2 because no messagebox was free.";
CM_ SG_ 1479 MLU_3_OD_CAN2_ErrorStatus "Internal error status (e.g. Error active, Error passive, Bus Off)";
CM_ SG_ 1479 MLU_3_OD_CAN2_DiscardedTxMe_0000 "Number of discarded TX messages on CAN2 because all messageboxes were full";
CM_ SG_ 1479 MLU_3_OD_CAN2_Status "Status of CAN2.";
CM_ SG_ 1479 MLU_3_OD_CAN2_Baudrate "Baudrate of CAN.";
CM_ SG_ 1479 MLU_3_OD_CAN2_autoErrorReset "Automatic reset of errors.";
CM_ SG_ 1479 MLU_3_OD_CAN2_lastErrorCode "Last error code.";
CM_ SG_ 1479 MLU_3_OD_CAN2_RxErrCnt "Receive error count of CAN1.";
CM_ SG_ 1479 MLU_3_OD_CAN2_TxErrCnt "Transmit error count of CAN1.";
CM_ SG_ 1479 MLU_3_OD_CAN1_DelayedTxMessages "Number of delayed TX messages on CAN1 because no messagebox was free.";
CM_ SG_ 1479 MLU_3_OD_CAN1_ErrorStatus "Internal error status (e.g. Error active, Error passive, Bus Off)";
CM_ SG_ 1479 MLU_3_OD_CAN1_DiscardedTxMe_0000 "Number of discarded TX messages on CAN1 because all messageboxes were full";
CM_ SG_ 1479 MLU_3_OD_CAN1_Status "Status of CAN1.";
CM_ SG_ 1479 MLU_3_OD_CAN1_Baudrate "Baudrate of CAN.";
CM_ SG_ 1479 MLU_3_OD_CAN1_autoErrorReset "Automatic reset of errors.";
CM_ SG_ 1479 MLU_3_OD_CAN1_lastErrorCode "Last error code.";
CM_ SG_ 1479 MLU_3_OD_CAN1_RxErrCnt "Receive error count of CAN1.";
CM_ SG_ 1479 MLU_3_OD_CAN1_TxErrCnt "Transmit error count of CAN1.";
CM_ SG_ 1479 MLU_3_OD_BuildTime "Software build time in the format HHMMSS.";
CM_ SG_ 1479 MLU_3_OD_BuildDate "Software build date in the format YYYYMMDD.";
CM_ SG_ 1479 MLU_3_OD_ChipUID2 "Seccond part of unique ID of microcontroller.";
CM_ SG_ 1479 MLU_3_OD_ChipUID1 "First part of unique ID of microcontroller.";
CM_ SG_ 1479 MLU_3_OD_SdcOut "Measurement of Shutdown Circuit Output";
CM_ SG_ 1479 MLU_3_OD_SdcIn "Measurement of Shutdown Circuit Input";
CM_ SG_ 1479 MLU_3_OD_runtime "Runtime of chip in milliseconds.";
CM_ SG_ 1479 MLU_3_OD_InputVoltage "Board supply voltage.";
CM_ SG_ 1479 MLU_3_OD_BoardTemp "Temperature of board";
CM_ SG_ 1479 MLU_3_OD_MemFree "Free memory in bytes.";
CM_ SG_ 1479 MLU_3_OD_CpuUsage "Current CPU usage in %.";
CM_ SG_ 1479 MLU_3_OD_OdEntrySendInterval "Interval for sending all readable OD entries. Sending is disabled if less than 5 ms.";
CM_ SG_ 1479 MLU_3_OD_SendOdOnBootup "Whether to send all OD entries on bootup.";
CM_ SG_ 1479 MLU_3_OD_HeartbeatInterval "Heartbeat Interval in milliseconds.";
CM_ SG_ 1479 MLU_3_OD_DbcVersion "CANzero DBC version.";
CM_ SG_ 1479 MLU_3_OD_StackVersion "CANzero stack version.";
CM_ SG_ 1479 MLU_3_OD_ProtocolVersion "CANzero Protocol Version.";
CM_ SG_ 1479 MLU_3_OD_NodeStatus "State of the node.";
CM_ SG_ 1479 MLU_3_OD_NodeID "CANzero Node-ID.";
CM_ SG_ 1479 MLU_3_SDO_ID "Specifies SDO-ID of MLU_3";
CM_ BO_ 1543 "DO NOT CHANGE ANYTHING HERE!
SDO Request Download from node MLU_3 with Node-ID 0x7";
CM_ SG_ 1543 MLU_3_SDO_ID "Specifies SDO-ID of MLU_3";
CM_ BO_ 1799 "Heartbeat of node MLU_3 with Node-ID 0x7";
CM_ SG_ 1799 MLU_3_NodeState "Heartbeat status of node MLU_3";
CM_ BO_ 1863 "Bootloader transmit from node MLU_3 with Node-ID 0x7";
CM_ BO_ 1927 "Bootloader receive by node MLU_3 with Node-ID 0x7";
CM_ BO_ 136 "Emergency message of node MLU_4 with Node-ID 0x8";
CM_ SG_ 136 MLU_4_E0_OtherError "Other error.";
CM_ SG_ 136 MLU_4_W0_OtherWarning "Other warning.";
CM_ BO_ 392 "Transmit PDO 1 of node MLU_4 with Node-ID 0x8";
CM_ BO_ 456 "Receive PDO 1 of node MLU_4 with Node-ID 0x8";
CM_ BO_ 520 "Transmit PDO 2 of node MLU_4 with Node-ID 0x8";
CM_ BO_ 584 "Receive PDO 2 of node MLU_4 with Node-ID 0x8";
CM_ BO_ 648 "Transmit PDO 3 of node MLU_4 with Node-ID 0x8";
CM_ BO_ 712 "Receive PDO 3 of node MLU_4 with Node-ID 0x8";
CM_ BO_ 776 "Transmit PDO 4 of node MLU_4 with Node-ID 0x8";
CM_ BO_ 840 "Receive PDO 4 of node MLU_4 with Node-ID 0x8";
CM_ BO_ 904 "Transmit PDO 5 of node MLU_4 with Node-ID 0x8";
CM_ BO_ 968 "Transmit PDO 6 of node MLU_4 with Node-ID 0x8";
CM_ BO_ 1032 "Transmit PDO 7 of node MLU_4 with Node-ID 0x8";
CM_ BO_ 1096 "Transmit PDO 8 of node MLU_4 with Node-ID 0x8";
CM_ BO_ 1160 "Transmit PDO 9 of node MLU_4 with Node-ID 0x8";
CM_ BO_ 1224 "Transmit PDO 10 of node MLU_4 with Node-ID 0x8";
CM_ BO_ 1288 "Transmit PDO 11 of node MLU_4 with Node-ID 0x8";
CM_ BO_ 1352 "Transmit PDO 12 of node MLU_4 with Node-ID 0x8";
CM_ BO_ 1416 "DO NOT CHANGE ANYTHING HERE!
SDO Response of node MLU_4 with Node-ID 0x8";
CM_ SG_ 1416 MLU_4_OD_CAN2_DelayedTxMessages "Number of delayed TX messages on CAN2 because no messagebox was free.";
CM_ SG_ 1416 MLU_4_OD_CAN2_ErrorStatus "Internal error status (e.g. Error active, Error passive, Bus Off)";
CM_ SG_ 1416 MLU_4_OD_CAN2_DiscardedTxMessage "Number of discarded TX messages on CAN2 because all messageboxes were full";
CM_ SG_ 1416 MLU_4_OD_CAN2_Status "Status of CAN2.";
CM_ SG_ 1416 MLU_4_OD_CAN2_Baudrate "Baudrate of CAN.";
CM_ SG_ 1416 MLU_4_OD_CAN2_autoErrorReset "Automatic reset of errors.";
CM_ SG_ 1416 MLU_4_OD_CAN2_lastErrorCode "Last error code.";
CM_ SG_ 1416 MLU_4_OD_CAN2_RxErrCnt "Receive error count of CAN1.";
CM_ SG_ 1416 MLU_4_OD_CAN2_TxErrCnt "Transmit error count of CAN1.";
CM_ SG_ 1416 MLU_4_OD_CAN1_DelayedTxMessages "Number of delayed TX messages on CAN1 because no messagebox was free.";
CM_ SG_ 1416 MLU_4_OD_CAN1_ErrorStatus "Internal error status (e.g. Error active, Error passive, Bus Off)";
CM_ SG_ 1416 MLU_4_OD_CAN1_DiscardedTxMessage "Number of discarded TX messages on CAN1 because all messageboxes were full";
CM_ SG_ 1416 MLU_4_OD_CAN1_Status "Status of CAN1.";
CM_ SG_ 1416 MLU_4_OD_CAN1_Baudrate "Baudrate of CAN.";
CM_ SG_ 1416 MLU_4_OD_CAN1_autoErrorReset "Automatic reset of errors.";
CM_ SG_ 1416 MLU_4_OD_CAN1_lastErrorCode "Last error code.";
CM_ SG_ 1416 MLU_4_OD_CAN1_RxErrCnt "Receive error count of CAN1.";
CM_ SG_ 1416 MLU_4_OD_CAN1_TxErrCnt "Transmit error count of CAN1.";
CM_ SG_ 1416 MLU_4_OD_BuildTime "Software build time in the format HHMMSS.";
CM_ SG_ 1416 MLU_4_OD_BuildDate "Software build date in the format YYYYMMDD.";
CM_ SG_ 1416 MLU_4_OD_ChipUID2 "Seccond part of unique ID of microcontroller.";
CM_ SG_ 1416 MLU_4_OD_ChipUID1 "First part of unique ID of microcontroller.";
CM_ SG_ 1416 MLU_4_OD_SdcOut "Measurement of Shutdown Circuit Output";
CM_ SG_ 1416 MLU_4_OD_SdcIn "Measurement of Shutdown Circuit Input";
CM_ SG_ 1416 MLU_4_OD_runtime "Runtime of chip in milliseconds.";
CM_ SG_ 1416 MLU_4_OD_InputVoltage "Board supply voltage.";
CM_ SG_ 1416 MLU_4_OD_BoardTemp "Temperature of board";
CM_ SG_ 1416 MLU_4_OD_MemFree "Free memory in bytes.";
CM_ SG_ 1416 MLU_4_OD_CpuUsage "Current CPU usage in %.";
CM_ SG_ 1416 MLU_4_OD_OdEntrySendInterval "Interval for sending all readable OD entries. Sending is disabled if less than 5 ms.";
CM_ SG_ 1416 MLU_4_OD_SendOdOnBootup "Whether to send all OD entries on bootup.";
CM_ SG_ 1416 MLU_4_OD_HeartbeatInterval "Heartbeat Interval in milliseconds.";
CM_ SG_ 1416 MLU_4_OD_DbcVersion "CANzero DBC version.";
CM_ SG_ 1416 MLU_4_OD_StackVersion "CANzero stack version.";
CM_ SG_ 1416 MLU_4_OD_ProtocolVersion "CANzero Protocol Version.";
CM_ SG_ 1416 MLU_4_OD_NodeStatus "State of the node.";
CM_ SG_ 1416 MLU_4_OD_NodeID "CANzero Node-ID.";
CM_ SG_ 1416 MLU_4_SDO_RespCode "Response code of SDO access.";
CM_ SG_ 1416 MLU_4_SDO_ID "Specifies SDO-ID of MLU_4";
CM_ BO_ 1480 "DO NOT CHANGE ANYTHING HERE!
SDO Request Upload to node MLU_4 with Node-ID 0x8";
CM_ SG_ 1480 MLU_4_OD_CAN2_DelayedTxMessages "Number of delayed TX messages on CAN2 because no messagebox was free.";
CM_ SG_ 1480 MLU_4_OD_CAN2_ErrorStatus "Internal error status (e.g. Error active, Error passive, Bus Off)";
CM_ SG_ 1480 MLU_4_OD_CAN2_DiscardedTxMe_0000 "Number of discarded TX messages on CAN2 because all messageboxes were full";
CM_ SG_ 1480 MLU_4_OD_CAN2_Status "Status of CAN2.";
CM_ SG_ 1480 MLU_4_OD_CAN2_Baudrate "Baudrate of CAN.";
CM_ SG_ 1480 MLU_4_OD_CAN2_autoErrorReset "Automatic reset of errors.";
CM_ SG_ 1480 MLU_4_OD_CAN2_lastErrorCode "Last error code.";
CM_ SG_ 1480 MLU_4_OD_CAN2_RxErrCnt "Receive error count of CAN1.";
CM_ SG_ 1480 MLU_4_OD_CAN2_TxErrCnt "Transmit error count of CAN1.";
CM_ SG_ 1480 MLU_4_OD_CAN1_DelayedTxMessages "Number of delayed TX messages on CAN1 because no messagebox was free.";
CM_ SG_ 1480 MLU_4_OD_CAN1_ErrorStatus "Internal error status (e.g. Error active, Error passive, Bus Off)";
CM_ SG_ 1480 MLU_4_OD_CAN1_DiscardedTxMe_0000 "Number of discarded TX messages on CAN1 because all messageboxes were full";
CM_ SG_ 1480 MLU_4_OD_CAN1_Status "Status of CAN1.";
CM_ SG_ 1480 MLU_4_OD_CAN1_Baudrate "Baudrate of CAN.";
CM_ SG_ 1480 MLU_4_OD_CAN1_autoErrorReset "Automatic reset of errors.";
CM_ SG_ 1480 MLU_4_OD_CAN1_lastErrorCode "Last error code.";
CM_ SG_ 1480 MLU_4_OD_CAN1_RxErrCnt "Receive error count of CAN1.";
CM_ SG_ 1480 MLU_4_OD_CAN1_TxErrCnt "Transmit error count of CAN1.";
CM_ SG_ 1480 MLU_4_OD_BuildTime "Software build time in the format HHMMSS.";
CM_ SG_ 1480 MLU_4_OD_BuildDate "Software build date in the format YYYYMMDD.";
CM_ SG_ 1480 MLU_4_OD_ChipUID2 "Seccond part of unique ID of microcontroller.";
CM_ SG_ 1480 MLU_4_OD_ChipUID1 "First part of unique ID of microcontroller.";
CM_ SG_ 1480 MLU_4_OD_SdcOut "Measurement of Shutdown Circuit Output";
CM_ SG_ 1480 MLU_4_OD_SdcIn "Measurement of Shutdown Circuit Input";
CM_ SG_ 1480 MLU_4_OD_runtime "Runtime of chip in milliseconds.";
CM_ SG_ 1480 MLU_4_OD_InputVoltage "Board supply voltage.";
CM_ SG_ 1480 MLU_4_OD_BoardTemp "Temperature of board";
CM_ SG_ 1480 MLU_4_OD_MemFree "Free memory in bytes.";
CM_ SG_ 1480 MLU_4_OD_CpuUsage "Current CPU usage in %.";
CM_ SG_ 1480 MLU_4_OD_OdEntrySendInterval "Interval for sending all readable OD entries. Sending is disabled if less than 5 ms.";
CM_ SG_ 1480 MLU_4_OD_SendOdOnBootup "Whether to send all OD entries on bootup.";
CM_ SG_ 1480 MLU_4_OD_HeartbeatInterval "Heartbeat Interval in milliseconds.";
CM_ SG_ 1480 MLU_4_OD_DbcVersion "CANzero DBC version.";
CM_ SG_ 1480 MLU_4_OD_StackVersion "CANzero stack version.";
CM_ SG_ 1480 MLU_4_OD_ProtocolVersion "CANzero Protocol Version.";
CM_ SG_ 1480 MLU_4_OD_NodeStatus "State of the node.";
CM_ SG_ 1480 MLU_4_OD_NodeID "CANzero Node-ID.";
CM_ SG_ 1480 MLU_4_SDO_ID "Specifies SDO-ID of MLU_4";
CM_ BO_ 1544 "DO NOT CHANGE ANYTHING HERE!
SDO Request Download from node MLU_4 with Node-ID 0x8";
CM_ SG_ 1544 MLU_4_SDO_ID "Specifies SDO-ID of MLU_4";
CM_ BO_ 1800 "Heartbeat of node MLU_4 with Node-ID 0x8";
CM_ SG_ 1800 MLU_4_NodeState "Heartbeat status of node MLU_4";
CM_ BO_ 1864 "Bootloader transmit from node MLU_4 with Node-ID 0x8";
CM_ BO_ 1928 "Bootloader receive by node MLU_4 with Node-ID 0x8";
CM_ BO_ 137 "Emergency message of node MLU_5 with Node-ID 0x9";
CM_ SG_ 137 MLU_5_E0_OtherError "Other error.";
CM_ SG_ 137 MLU_5_W0_OtherWarning "Other warning.";
CM_ BO_ 393 "Transmit PDO 1 of node MLU_5 with Node-ID 0x9";
CM_ BO_ 457 "Receive PDO 1 of node MLU_5 with Node-ID 0x9";
CM_ BO_ 521 "Transmit PDO 2 of node MLU_5 with Node-ID 0x9";
CM_ BO_ 585 "Receive PDO 2 of node MLU_5 with Node-ID 0x9";
CM_ BO_ 649 "Transmit PDO 3 of node MLU_5 with Node-ID 0x9";
CM_ BO_ 713 "Receive PDO 3 of node MLU_5 with Node-ID 0x9";
CM_ BO_ 777 "Transmit PDO 4 of node MLU_5 with Node-ID 0x9";
CM_ BO_ 841 "Receive PDO 4 of node MLU_5 with Node-ID 0x9";
CM_ BO_ 905 "Transmit PDO 5 of node MLU_5 with Node-ID 0x9";
CM_ BO_ 969 "Transmit PDO 6 of node MLU_5 with Node-ID 0x9";
CM_ BO_ 1033 "Transmit PDO 7 of node MLU_5 with Node-ID 0x9";
CM_ BO_ 1097 "Transmit PDO 8 of node MLU_5 with Node-ID 0x9";
CM_ BO_ 1161 "Transmit PDO 9 of node MLU_5 with Node-ID 0x9";
CM_ BO_ 1225 "Transmit PDO 10 of node MLU_5 with Node-ID 0x9";
CM_ BO_ 1289 "Transmit PDO 11 of node MLU_5 with Node-ID 0x9";
CM_ BO_ 1353 "Transmit PDO 12 of node MLU_5 with Node-ID 0x9";
CM_ BO_ 1417 "DO NOT CHANGE ANYTHING HERE!
SDO Response of node MLU_5 with Node-ID 0x9";
CM_ SG_ 1417 MLU_5_OD_CAN2_DelayedTxMessages "Number of delayed TX messages on CAN2 because no messagebox was free.";
CM_ SG_ 1417 MLU_5_OD_CAN2_ErrorStatus "Internal error status (e.g. Error active, Error passive, Bus Off)";
CM_ SG_ 1417 MLU_5_OD_CAN2_DiscardedTxMessage "Number of discarded TX messages on CAN2 because all messageboxes were full";
CM_ SG_ 1417 MLU_5_OD_CAN2_Status "Status of CAN2.";
CM_ SG_ 1417 MLU_5_OD_CAN2_Baudrate "Baudrate of CAN.";
CM_ SG_ 1417 MLU_5_OD_CAN2_autoErrorReset "Automatic reset of errors.";
CM_ SG_ 1417 MLU_5_OD_CAN2_lastErrorCode "Last error code.";
CM_ SG_ 1417 MLU_5_OD_CAN2_RxErrCnt "Receive error count of CAN1.";
CM_ SG_ 1417 MLU_5_OD_CAN2_TxErrCnt "Transmit error count of CAN1.";
CM_ SG_ 1417 MLU_5_OD_CAN1_DelayedTxMessages "Number of delayed TX messages on CAN1 because no messagebox was free.";
CM_ SG_ 1417 MLU_5_OD_CAN1_ErrorStatus "Internal error status (e.g. Error active, Error passive, Bus Off)";
CM_ SG_ 1417 MLU_5_OD_CAN1_DiscardedTxMessage "Number of discarded TX messages on CAN1 because all messageboxes were full";
CM_ SG_ 1417 MLU_5_OD_CAN1_Status "Status of CAN1.";
CM_ SG_ 1417 MLU_5_OD_CAN1_Baudrate "Baudrate of CAN.";
CM_ SG_ 1417 MLU_5_OD_CAN1_autoErrorReset "Automatic reset of errors.";
CM_ SG_ 1417 MLU_5_OD_CAN1_lastErrorCode "Last error code.";
CM_ SG_ 1417 MLU_5_OD_CAN1_RxErrCnt "Receive error count of CAN1.";
CM_ SG_ 1417 MLU_5_OD_CAN1_TxErrCnt "Transmit error count of CAN1.";
CM_ SG_ 1417 MLU_5_OD_BuildTime "Software build time in the format HHMMSS.";
CM_ SG_ 1417 MLU_5_OD_BuildDate "Software build date in the format YYYYMMDD.";
CM_ SG_ 1417 MLU_5_OD_ChipUID2 "Seccond part of unique ID of microcontroller.";
CM_ SG_ 1417 MLU_5_OD_ChipUID1 "First part of unique ID of microcontroller.";
CM_ SG_ 1417 MLU_5_OD_SdcOut "Measurement of Shutdown Circuit Output";
CM_ SG_ 1417 MLU_5_OD_SdcIn "Measurement of Shutdown Circuit Input";
CM_ SG_ 1417 MLU_5_OD_runtime "Runtime of chip in milliseconds.";
CM_ SG_ 1417 MLU_5_OD_InputVoltage "Board supply voltage.";
CM_ SG_ 1417 MLU_5_OD_BoardTemp "Temperature of board";
CM_ SG_ 1417 MLU_5_OD_MemFree "Free memory in bytes.";
CM_ SG_ 1417 MLU_5_OD_CpuUsage "Current CPU usage in %.";
CM_ SG_ 1417 MLU_5_OD_OdEntrySendInterval "Interval for sending all readable OD entries. Sending is disabled if less than 5 ms.";
CM_ SG_ 1417 MLU_5_OD_SendOdOnBootup "Whether to send all OD entries on bootup.";
CM_ SG_ 1417 MLU_5_OD_HeartbeatInterval "Heartbeat Interval in milliseconds.";
CM_ SG_ 1417 MLU_5_OD_DbcVersion "CANzero DBC version.";
CM_ SG_ 1417 MLU_5_OD_StackVersion "CANzero stack version.";
CM_ SG_ 1417 MLU_5_OD_ProtocolVersion "CANzero Protocol Version.";
CM_ SG_ 1417 MLU_5_OD_NodeStatus "State of the node.";
CM_ SG_ 1417 MLU_5_OD_NodeID "CANzero Node-ID.";
CM_ SG_ 1417 MLU_5_SDO_RespCode "Response code of SDO access.";
CM_ SG_ 1417 MLU_5_SDO_ID "Specifies SDO-ID of MLU_5";
CM_ BO_ 1481 "DO NOT CHANGE ANYTHING HERE!
SDO Request Upload to node MLU_5 with Node-ID 0x9";
CM_ SG_ 1481 MLU_5_OD_CAN2_DelayedTxMessages "Number of delayed TX messages on CAN2 because no messagebox was free.";
CM_ SG_ 1481 MLU_5_OD_CAN2_ErrorStatus "Internal error status (e.g. Error active, Error passive, Bus Off)";
CM_ SG_ 1481 MLU_5_OD_CAN2_DiscardedTxMe_0000 "Number of discarded TX messages on CAN2 because all messageboxes were full";
CM_ SG_ 1481 MLU_5_OD_CAN2_Status "Status of CAN2.";
CM_ SG_ 1481 MLU_5_OD_CAN2_Baudrate "Baudrate of CAN.";
CM_ SG_ 1481 MLU_5_OD_CAN2_autoErrorReset "Automatic reset of errors.";
CM_ SG_ 1481 MLU_5_OD_CAN2_lastErrorCode "Last error code.";
CM_ SG_ 1481 MLU_5_OD_CAN2_RxErrCnt "Receive error count of CAN1.";
CM_ SG_ 1481 MLU_5_OD_CAN2_TxErrCnt "Transmit error count of CAN1.";
CM_ SG_ 1481 MLU_5_OD_CAN1_DelayedTxMessages "Number of delayed TX messages on CAN1 because no messagebox was free.";
CM_ SG_ 1481 MLU_5_OD_CAN1_ErrorStatus "Internal error status (e.g. Error active, Error passive, Bus Off)";
CM_ SG_ 1481 MLU_5_OD_CAN1_DiscardedTxMe_0000 "Number of discarded TX messages on CAN1 because all messageboxes were full";
CM_ SG_ 1481 MLU_5_OD_CAN1_Status "Status of CAN1.";
CM_ SG_ 1481 MLU_5_OD_CAN1_Baudrate "Baudrate of CAN.";
CM_ SG_ 1481 MLU_5_OD_CAN1_autoErrorReset "Automatic reset of errors.";
CM_ SG_ 1481 MLU_5_OD_CAN1_lastErrorCode "Last error code.";
CM_ SG_ 1481 MLU_5_OD_CAN1_RxErrCnt "Receive error count of CAN1.";
CM_ SG_ 1481 MLU_5_OD_CAN1_TxErrCnt "Transmit error count of CAN1.";
CM_ SG_ 1481 MLU_5_OD_BuildTime "Software build time in the format HHMMSS.";
CM_ SG_ 1481 MLU_5_OD_BuildDate "Software build date in the format YYYYMMDD.";
CM_ SG_ 1481 MLU_5_OD_ChipUID2 "Seccond part of unique ID of microcontroller.";
CM_ SG_ 1481 MLU_5_OD_ChipUID1 "First part of unique ID of microcontroller.";
CM_ SG_ 1481 MLU_5_OD_SdcOut "Measurement of Shutdown Circuit Output";
CM_ SG_ 1481 MLU_5_OD_SdcIn "Measurement of Shutdown Circuit Input";
CM_ SG_ 1481 MLU_5_OD_runtime "Runtime of chip in milliseconds.";
CM_ SG_ 1481 MLU_5_OD_InputVoltage "Board supply voltage.";
CM_ SG_ 1481 MLU_5_OD_BoardTemp "Temperature of board";
CM_ SG_ 1481 MLU_5_OD_MemFree "Free memory in bytes.";
CM_ SG_ 1481 MLU_5_OD_CpuUsage "Current CPU usage in %.";
CM_ SG_ 1481 MLU_5_OD_OdEntrySendInterval "Interval for sending all readable OD entries. Sending is disabled if less than 5 ms.";
CM_ SG_ 1481 MLU_5_OD_SendOdOnBootup "Whether to send all OD entries on bootup.";
CM_ SG_ 1481 MLU_5_OD_HeartbeatInterval "Heartbeat Interval in milliseconds.";
CM_ SG_ 1481 MLU_5_OD_DbcVersion "CANzero DBC version.";
CM_ SG_ 1481 MLU_5_OD_StackVersion "CANzero stack version.";
CM_ SG_ 1481 MLU_5_OD_ProtocolVersion "CANzero Protocol Version.";
CM_ SG_ 1481 MLU_5_OD_NodeStatus "State of the node.";
CM_ SG_ 1481 MLU_5_OD_NodeID "CANzero Node-ID.";
CM_ SG_ 1481 MLU_5_SDO_ID "Specifies SDO-ID of MLU_5";
CM_ BO_ 1545 "DO NOT CHANGE ANYTHING HERE!
SDO Request Download from node MLU_5 with Node-ID 0x9";
CM_ SG_ 1545 MLU_5_SDO_ID "Specifies SDO-ID of MLU_5";
CM_ BO_ 1801 "Heartbeat of node MLU_5 with Node-ID 0x9";
CM_ SG_ 1801 MLU_5_NodeState "Heartbeat status of node MLU_5";
CM_ BO_ 1865 "Bootloader transmit from node MLU_5 with Node-ID 0x9";
CM_ BO_ 1929 "Bootloader receive by node MLU_5 with Node-ID 0x9";
CM_ BO_ 144 "Emergency message of node MLU_6 with Node-ID 0x10";
CM_ SG_ 144 MLU_6_E0_OtherError "Other error.";
CM_ SG_ 144 MLU_6_W0_OtherWarning "Other warning.";
CM_ BO_ 400 "Transmit PDO 1 of node MLU_6 with Node-ID 0x10";
CM_ BO_ 464 "Receive PDO 1 of node MLU_6 with Node-ID 0x10";
CM_ BO_ 528 "Transmit PDO 2 of node MLU_6 with Node-ID 0x10";
CM_ BO_ 592 "Receive PDO 2 of node MLU_6 with Node-ID 0x10";
CM_ BO_ 656 "Transmit PDO 3 of node MLU_6 with Node-ID 0x10";
CM_ BO_ 720 "Receive PDO 3 of node MLU_6 with Node-ID 0x10";
CM_ BO_ 784 "Transmit PDO 4 of node MLU_6 with Node-ID 0x10";
CM_ BO_ 848 "Receive PDO 4 of node MLU_6 with Node-ID 0x10";
CM_ BO_ 912 "Transmit PDO 5 of node MLU_6 with Node-ID 0x10";
CM_ BO_ 976 "Transmit PDO 6 of node MLU_6 with Node-ID 0x10";
CM_ BO_ 1040 "Transmit PDO 7 of node MLU_6 with Node-ID 0x10";
CM_ BO_ 1104 "Transmit PDO 8 of node MLU_6 with Node-ID 0x10";
CM_ BO_ 1168 "Transmit PDO 9 of node MLU_6 with Node-ID 0x10";
CM_ BO_ 1232 "Transmit PDO 10 of node MLU_6 with Node-ID 0x10";
CM_ BO_ 1296 "Transmit PDO 11 of node MLU_6 with Node-ID 0x10";
CM_ BO_ 1360 "Transmit PDO 12 of node MLU_6 with Node-ID 0x10";
CM_ BO_ 1424 "DO NOT CHANGE ANYTHING HERE!
SDO Response of node MLU_6 with Node-ID 0x10";
CM_ SG_ 1424 MLU_6_OD_CAN2_DelayedTxMessages "Number of delayed TX messages on CAN2 because no messagebox was free.";
CM_ SG_ 1424 MLU_6_OD_CAN2_ErrorStatus "Internal error status (e.g. Error active, Error passive, Bus Off)";
CM_ SG_ 1424 MLU_6_OD_CAN2_DiscardedTxMessage "Number of discarded TX messages on CAN2 because all messageboxes were full";
CM_ SG_ 1424 MLU_6_OD_CAN2_Status "Status of CAN2.";
CM_ SG_ 1424 MLU_6_OD_CAN2_Baudrate "Baudrate of CAN.";
CM_ SG_ 1424 MLU_6_OD_CAN2_autoErrorReset "Automatic reset of errors.";
CM_ SG_ 1424 MLU_6_OD_CAN2_lastErrorCode "Last error code.";
CM_ SG_ 1424 MLU_6_OD_CAN2_RxErrCnt "Receive error count of CAN1.";
CM_ SG_ 1424 MLU_6_OD_CAN2_TxErrCnt "Transmit error count of CAN1.";
CM_ SG_ 1424 MLU_6_OD_CAN1_DelayedTxMessages "Number of delayed TX messages on CAN1 because no messagebox was free.";
CM_ SG_ 1424 MLU_6_OD_CAN1_ErrorStatus "Internal error status (e.g. Error active, Error passive, Bus Off)";
CM_ SG_ 1424 MLU_6_OD_CAN1_DiscardedTxMessage "Number of discarded TX messages on CAN1 because all messageboxes were full";
CM_ SG_ 1424 MLU_6_OD_CAN1_Status "Status of CAN1.";
CM_ SG_ 1424 MLU_6_OD_CAN1_Baudrate "Baudrate of CAN.";
CM_ SG_ 1424 MLU_6_OD_CAN1_autoErrorReset "Automatic reset of errors.";
CM_ SG_ 1424 MLU_6_OD_CAN1_lastErrorCode "Last error code.";
CM_ SG_ 1424 MLU_6_OD_CAN1_RxErrCnt "Receive error count of CAN1.";
CM_ SG_ 1424 MLU_6_OD_CAN1_TxErrCnt "Transmit error count of CAN1.";
CM_ SG_ 1424 MLU_6_OD_BuildTime "Software build time in the format HHMMSS.";
CM_ SG_ 1424 MLU_6_OD_BuildDate "Software build date in the format YYYYMMDD.";
CM_ SG_ 1424 MLU_6_OD_ChipUID2 "Seccond part of unique ID of microcontroller.";
CM_ SG_ 1424 MLU_6_OD_ChipUID1 "First part of unique ID of microcontroller.";
CM_ SG_ 1424 MLU_6_OD_SdcOut "Measurement of Shutdown Circuit Output";
CM_ SG_ 1424 MLU_6_OD_SdcIn "Measurement of Shutdown Circuit Input";
CM_ SG_ 1424 MLU_6_OD_runtime "Runtime of chip in milliseconds.";
CM_ SG_ 1424 MLU_6_OD_InputVoltage "Board supply voltage.";
CM_ SG_ 1424 MLU_6_OD_BoardTemp "Temperature of board";
CM_ SG_ 1424 MLU_6_OD_MemFree "Free memory in bytes.";
CM_ SG_ 1424 MLU_6_OD_CpuUsage "Current CPU usage in %.";
CM_ SG_ 1424 MLU_6_OD_OdEntrySendInterval "Interval for sending all readable OD entries. Sending is disabled if less than 5 ms.";
CM_ SG_ 1424 MLU_6_OD_SendOdOnBootup "Whether to send all OD entries on bootup.";
CM_ SG_ 1424 MLU_6_OD_HeartbeatInterval "Heartbeat Interval in milliseconds.";
CM_ SG_ 1424 MLU_6_OD_DbcVersion "CANzero DBC version.";
CM_ SG_ 1424 MLU_6_OD_StackVersion "CANzero stack version.";
CM_ SG_ 1424 MLU_6_OD_ProtocolVersion "CANzero Protocol Version.";
CM_ SG_ 1424 MLU_6_OD_NodeStatus "State of the node.";
CM_ SG_ 1424 MLU_6_OD_NodeID "CANzero Node-ID.";
CM_ SG_ 1424 MLU_6_SDO_RespCode "Response code of SDO access.";
CM_ SG_ 1424 MLU_6_SDO_ID "Specifies SDO-ID of MLU_6";
CM_ BO_ 1488 "DO NOT CHANGE ANYTHING HERE!
SDO Request Upload to node MLU_6 with Node-ID 0x10";
CM_ SG_ 1488 MLU_6_OD_CAN2_DelayedTxMessages "Number of delayed TX messages on CAN2 because no messagebox was free.";
CM_ SG_ 1488 MLU_6_OD_CAN2_ErrorStatus "Internal error status (e.g. Error active, Error passive, Bus Off)";
CM_ SG_ 1488 MLU_6_OD_CAN2_DiscardedTxMe_0000 "Number of discarded TX messages on CAN2 because all messageboxes were full";
CM_ SG_ 1488 MLU_6_OD_CAN2_Status "Status of CAN2.";
CM_ SG_ 1488 MLU_6_OD_CAN2_Baudrate "Baudrate of CAN.";
CM_ SG_ 1488 MLU_6_OD_CAN2_autoErrorReset "Automatic reset of errors.";
CM_ SG_ 1488 MLU_6_OD_CAN2_lastErrorCode "Last error code.";
CM_ SG_ 1488 MLU_6_OD_CAN2_RxErrCnt "Receive error count of CAN1.";
CM_ SG_ 1488 MLU_6_OD_CAN2_TxErrCnt "Transmit error count of CAN1.";
CM_ SG_ 1488 MLU_6_OD_CAN1_DelayedTxMessages "Number of delayed TX messages on CAN1 because no messagebox was free.";
CM_ SG_ 1488 MLU_6_OD_CAN1_ErrorStatus "Internal error status (e.g. Error active, Error passive, Bus Off)";
CM_ SG_ 1488 MLU_6_OD_CAN1_DiscardedTxMe_0000 "Number of discarded TX messages on CAN1 because all messageboxes were full";
CM_ SG_ 1488 MLU_6_OD_CAN1_Status "Status of CAN1.";
CM_ SG_ 1488 MLU_6_OD_CAN1_Baudrate "Baudrate of CAN.";
CM_ SG_ 1488 MLU_6_OD_CAN1_autoErrorReset "Automatic reset of errors.";
CM_ SG_ 1488 MLU_6_OD_CAN1_lastErrorCode "Last error code.";
CM_ SG_ 1488 MLU_6_OD_CAN1_RxErrCnt "Receive error count of CAN1.";
CM_ SG_ 1488 MLU_6_OD_CAN1_TxErrCnt "Transmit error count of CAN1.";
CM_ SG_ 1488 MLU_6_OD_BuildTime "Software build time in the format HHMMSS.";
CM_ SG_ 1488 MLU_6_OD_BuildDate "Software build date in the format YYYYMMDD.";
CM_ SG_ 1488 MLU_6_OD_ChipUID2 "Seccond part of unique ID of microcontroller.";
CM_ SG_ 1488 MLU_6_OD_ChipUID1 "First part of unique ID of microcontroller.";
CM_ SG_ 1488 MLU_6_OD_SdcOut "Measurement of Shutdown Circuit Output";
CM_ SG_ 1488 MLU_6_OD_SdcIn "Measurement of Shutdown Circuit Input";
CM_ SG_ 1488 MLU_6_OD_runtime "Runtime of chip in milliseconds.";
CM_ SG_ 1488 MLU_6_OD_InputVoltage "Board supply voltage.";
CM_ SG_ 1488 MLU_6_OD_BoardTemp "Temperature of board";
CM_ SG_ 1488 MLU_6_OD_MemFree "Free memory in bytes.";
CM_ SG_ 1488 MLU_6_OD_CpuUsage "Current CPU usage in %.";
CM_ SG_ 1488 MLU_6_OD_OdEntrySendInterval "Interval for sending all readable OD entries. Sending is disabled if less than 5 ms.";
CM_ SG_ 1488 MLU_6_OD_SendOdOnBootup "Whether to send all OD entries on bootup.";
CM_ SG_ 1488 MLU_6_OD_HeartbeatInterval "Heartbeat Interval in milliseconds.";
CM_ SG_ 1488 MLU_6_OD_DbcVersion "CANzero DBC version.";
CM_ SG_ 1488 MLU_6_OD_StackVersion "CANzero stack version.";
CM_ SG_ 1488 MLU_6_OD_ProtocolVersion "CANzero Protocol Version.";
CM_ SG_ 1488 MLU_6_OD_NodeStatus "State of the node.";
CM_ SG_ 1488 MLU_6_OD_NodeID "CANzero Node-ID.";
CM_ SG_ 1488 MLU_6_SDO_ID "Specifies SDO-ID of MLU_6";
CM_ BO_ 1552 "DO NOT CHANGE ANYTHING HERE!
SDO Request Download from node MLU_6 with Node-ID 0x10";
CM_ SG_ 1552 MLU_6_SDO_ID "Specifies SDO-ID of MLU_6";
CM_ BO_ 1808 "Heartbeat of node MLU_6 with Node-ID 0x10";
CM_ SG_ 1808 MLU_6_NodeState "Heartbeat status of node MLU_6";
CM_ BO_ 1872 "Bootloader transmit from node MLU_6 with Node-ID 0x10";
CM_ BO_ 1936 "Bootloader receive by node MLU_6 with Node-ID 0x10";
BA_DEF_ SG_  "GenSigSendType" ENUM  "Cyclic","OnWrite","OnWriteWithRepetition","OnChange","OnChangeWithRepetition","IfActive","IfActiveWithRepetition","NoSigSendType";
BA_DEF_ BO_  "GenMsgSendType" ENUM  "Cyclic","not_used","not_used","not_used","not_used","Cyclic","not_used","IfActive","NoMsgSendType";
BA_DEF_ BO_  "GenMsgCycleTime" INT 2 50000;
BA_DEF_ BO_  "GenMsgDelayTime" INT 1 1000;
BA_DEF_ BO_  "GenMsgNrOfRepetitions" INT 1 999999;
BA_DEF_ SG_  "GenSigStartValue" FLOAT 0 100000000000;
BA_DEF_ SG_  "CANzero_SDO_Group" STRING ;
BA_DEF_ SG_  "CANzero_SDO_AccessIfOperational" ENUM  "No","Yes";
BA_DEF_ SG_  "CANzero_SDO_AccessType" ENUM  "Read Write","Read Only","Write Only";
BA_DEF_ SG_  "CANzero_SDO_Default" FLOAT 0 0;
BA_DEF_ SG_  "SystemSignalLongSymbol" STRING ;
BA_DEF_DEF_  "GenSigSendType" "Cyclic";
BA_DEF_DEF_  "GenMsgSendType" "NoMsgSendType";
BA_DEF_DEF_  "GenMsgCycleTime" 100;
BA_DEF_DEF_  "GenMsgDelayTime" 1;
BA_DEF_DEF_  "GenMsgNrOfRepetitions" 1;
BA_DEF_DEF_  "GenSigStartValue" 0;
BA_DEF_DEF_  "CANzero_SDO_Group" "";
BA_DEF_DEF_  "CANzero_SDO_AccessIfOperational" "No";
BA_DEF_DEF_  "CANzero_SDO_AccessType" "Read Write";
BA_DEF_DEF_  "CANzero_SDO_Default" 0;
BA_DEF_DEF_  "SystemSignalLongSymbol" "";
BA_ "CANzero_SDO_Group" SG_ 1414 MLU_2_OD_CAN2_DelayedTxMessages "CAN";
BA_ "CANzero_SDO_AccessType" SG_ 1414 MLU_2_OD_CAN2_DelayedTxMessages 1;
BA_ "CANzero_SDO_AccessIfOperational" SG_ 1414 MLU_2_OD_CAN2_DelayedTxMessages 1;
BA_ "CANzero_SDO_Group" SG_ 1414 MLU_2_OD_CAN2_ErrorStatus "CAN";
BA_ "CANzero_SDO_AccessType" SG_ 1414 MLU_2_OD_CAN2_ErrorStatus 1;
BA_ "CANzero_SDO_AccessIfOperational" SG_ 1414 MLU_2_OD_CAN2_ErrorStatus 1;
BA_ "CANzero_SDO_Group" SG_ 1414 MLU_2_OD_CAN2_DiscardedTxMessage "CAN";
BA_ "CANzero_SDO_AccessType" SG_ 1414 MLU_2_OD_CAN2_DiscardedTxMessage 1;
BA_ "CANzero_SDO_AccessIfOperational" SG_ 1414 MLU_2_OD_CAN2_DiscardedTxMessage 1;
BA_ "SystemSignalLongSymbol" SG_ 1414 MLU_2_OD_CAN2_DiscardedTxMessage "MLU_2_OD_CAN2_DiscardedTxMessages";
BA_ "CANzero_SDO_Group" SG_ 1414 MLU_2_OD_CAN2_Status "CAN";
BA_ "CANzero_SDO_AccessType" SG_ 1414 MLU_2_OD_CAN2_Status 1;
BA_ "CANzero_SDO_AccessIfOperational" SG_ 1414 MLU_2_OD_CAN2_Status 1;
BA_ "CANzero_SDO_Group" SG_ 1414 MLU_2_OD_CAN2_Baudrate "CAN";
BA_ "CANzero_SDO_AccessIfOperational" SG_ 1414 MLU_2_OD_CAN2_Baudrate 1;
BA_ "GenSigStartValue" SG_ 1414 MLU_2_OD_CAN2_Baudrate 1000.0;
BA_ "CANzero_SDO_Default" SG_ 1414 MLU_2_OD_CAN2_Baudrate 1000;
BA_ "CANzero_SDO_Group" SG_ 1414 MLU_2_OD_CAN2_autoErrorReset "CAN";
BA_ "CANzero_SDO_AccessIfOperational" SG_ 1414 MLU_2_OD_CAN2_autoErrorReset 1;
BA_ "GenSigStartValue" SG_ 1414 MLU_2_OD_CAN2_autoErrorReset 1.0;
BA_ "CANzero_SDO_Default" SG_ 1414 MLU_2_OD_CAN2_autoErrorReset 1;
BA_ "CANzero_SDO_Group" SG_ 1414 MLU_2_OD_CAN2_lastErrorCode "CAN";
BA_ "CANzero_SDO_AccessType" SG_ 1414 MLU_2_OD_CAN2_lastErrorCode 1;
BA_ "CANzero_SDO_AccessIfOperational" SG_ 1414 MLU_2_OD_CAN2_lastErrorCode 1;
BA_ "CANzero_SDO_Group" SG_ 1414 MLU_2_OD_CAN2_RxErrCnt "CAN";
BA_ "CANzero_SDO_AccessType" SG_ 1414 MLU_2_OD_CAN2_RxErrCnt 1;
BA_ "CANzero_SDO_AccessIfOperational" SG_ 1414 MLU_2_OD_CAN2_RxErrCnt 1;
BA_ "CANzero_SDO_Group" SG_ 1414 MLU_2_OD_CAN2_TxErrCnt "CAN";
BA_ "CANzero_SDO_AccessType" SG_ 1414 MLU_2_OD_CAN2_TxErrCnt 1;
BA_ "CANzero_SDO_AccessIfOperational" SG_ 1414 MLU_2_OD_CAN2_TxErrCnt 1;
BA_ "CANzero_SDO_Group" SG_ 1414 MLU_2_OD_CAN1_DelayedTxMessages "CAN";
BA_ "CANzero_SDO_AccessType" SG_ 1414 MLU_2_OD_CAN1_DelayedTxMessages 1;
BA_ "CANzero_SDO_AccessIfOperational" SG_ 1414 MLU_2_OD_CAN1_DelayedTxMessages 1;
BA_ "CANzero_SDO_Group" SG_ 1414 MLU_2_OD_CAN1_ErrorStatus "CAN";
BA_ "CANzero_SDO_AccessType" SG_ 1414 MLU_2_OD_CAN1_ErrorStatus 1;
BA_ "CANzero_SDO_AccessIfOperational" SG_ 1414 MLU_2_OD_CAN1_ErrorStatus 1;
BA_ "CANzero_SDO_Group" SG_ 1414 MLU_2_OD_CAN1_DiscardedTxMessage "CAN";
BA_ "CANzero_SDO_AccessType" SG_ 1414 MLU_2_OD_CAN1_DiscardedTxMessage 1;
BA_ "CANzero_SDO_AccessIfOperational" SG_ 1414 MLU_2_OD_CAN1_DiscardedTxMessage 1;
BA_ "SystemSignalLongSymbol" SG_ 1414 MLU_2_OD_CAN1_DiscardedTxMessage "MLU_2_OD_CAN1_DiscardedTxMessages";
BA_ "CANzero_SDO_Group" SG_ 1414 MLU_2_OD_CAN1_Status "CAN";
BA_ "CANzero_SDO_AccessType" SG_ 1414 MLU_2_OD_CAN1_Status 1;
BA_ "CANzero_SDO_AccessIfOperational" SG_ 1414 MLU_2_OD_CAN1_Status 1;
BA_ "CANzero_SDO_Group" SG_ 1414 MLU_2_OD_CAN1_Baudrate "CAN";
BA_ "CANzero_SDO_AccessIfOperational" SG_ 1414 MLU_2_OD_CAN1_Baudrate 1;
BA_ "GenSigStartValue" SG_ 1414 MLU_2_OD_CAN1_Baudrate 1000.0;
BA_ "CANzero_SDO_Default" SG_ 1414 MLU_2_OD_CAN1_Baudrate 1000;
BA_ "CANzero_SDO_Group" SG_ 1414 MLU_2_OD_CAN1_autoErrorReset "CAN";
BA_ "CANzero_SDO_AccessIfOperational" SG_ 1414 MLU_2_OD_CAN1_autoErrorReset 1;
BA_ "GenSigStartValue" SG_ 1414 MLU_2_OD_CAN1_autoErrorReset 1.0;
BA_ "CANzero_SDO_Default" SG_ 1414 MLU_2_OD_CAN1_autoErrorReset 1;
BA_ "CANzero_SDO_Group" SG_ 1414 MLU_2_OD_CAN1_lastErrorCode "CAN";
BA_ "CANzero_SDO_AccessType" SG_ 1414 MLU_2_OD_CAN1_lastErrorCode 1;
BA_ "CANzero_SDO_AccessIfOperational" SG_ 1414 MLU_2_OD_CAN1_lastErrorCode 1;
BA_ "CANzero_SDO_Group" SG_ 1414 MLU_2_OD_CAN1_RxErrCnt "CAN";
BA_ "CANzero_SDO_AccessType" SG_ 1414 MLU_2_OD_CAN1_RxErrCnt 1;
BA_ "CANzero_SDO_AccessIfOperational" SG_ 1414 MLU_2_OD_CAN1_RxErrCnt 1;
BA_ "CANzero_SDO_Group" SG_ 1414 MLU_2_OD_CAN1_TxErrCnt "CAN";
BA_ "CANzero_SDO_AccessType" SG_ 1414 MLU_2_OD_CAN1_TxErrCnt 1;
BA_ "CANzero_SDO_AccessIfOperational" SG_ 1414 MLU_2_OD_CAN1_TxErrCnt 1;
BA_ "CANzero_SDO_AccessType" SG_ 1414 MLU_2_OD_BuildTime 1;
BA_ "CANzero_SDO_AccessIfOperational" SG_ 1414 MLU_2_OD_BuildTime 1;
BA_ "CANzero_SDO_AccessType" SG_ 1414 MLU_2_OD_BuildDate 1;
BA_ "CANzero_SDO_AccessIfOperational" SG_ 1414 MLU_2_OD_BuildDate 1;
BA_ "CANzero_SDO_AccessType" SG_ 1414 MLU_2_OD_ChipUID2 1;
BA_ "CANzero_SDO_AccessIfOperational" SG_ 1414 MLU_2_OD_ChipUID2 1;
BA_ "CANzero_SDO_AccessType" SG_ 1414 MLU_2_OD_ChipUID1 1;
BA_ "CANzero_SDO_AccessIfOperational" SG_ 1414 MLU_2_OD_ChipUID1 1;
BA_ "CANzero_SDO_AccessType" SG_ 1414 MLU_2_OD_SdcOut 1;
BA_ "CANzero_SDO_AccessIfOperational" SG_ 1414 MLU_2_OD_SdcOut 1;
BA_ "CANzero_SDO_AccessType" SG_ 1414 MLU_2_OD_SdcIn 1;
BA_ "CANzero_SDO_AccessIfOperational" SG_ 1414 MLU_2_OD_SdcIn 1;
BA_ "CANzero_SDO_AccessType" SG_ 1414 MLU_2_OD_runtime 1;
BA_ "CANzero_SDO_AccessIfOperational" SG_ 1414 MLU_2_OD_runtime 1;
BA_ "CANzero_SDO_AccessType" SG_ 1414 MLU_2_OD_InputVoltage 1;
BA_ "CANzero_SDO_AccessIfOperational" SG_ 1414 MLU_2_OD_InputVoltage 1;
BA_ "CANzero_SDO_AccessType" SG_ 1414 MLU_2_OD_BoardTemp 1;
BA_ "CANzero_SDO_AccessIfOperational" SG_ 1414 MLU_2_OD_BoardTemp 1;
BA_ "GenSigStartValue" SG_ 1414 MLU_2_OD_BoardTemp 3000.0;
BA_ "CANzero_SDO_AccessType" SG_ 1414 MLU_2_OD_MemFree 1;
BA_ "CANzero_SDO_AccessIfOperational" SG_ 1414 MLU_2_OD_MemFree 1;
BA_ "CANzero_SDO_AccessType" SG_ 1414 MLU_2_OD_CpuUsage 1;
BA_ "CANzero_SDO_AccessIfOperational" SG_ 1414 MLU_2_OD_CpuUsage 1;
BA_ "CANzero_SDO_AccessIfOperational" SG_ 1414 MLU_2_OD_OdEntrySendInterval 1;
BA_ "GenSigStartValue" SG_ 1414 MLU_2_OD_OdEntrySendInterval 50.0;
BA_ "CANzero_SDO_Default" SG_ 1414 MLU_2_OD_OdEntrySendInterval 50;
BA_ "CANzero_SDO_AccessIfOperational" SG_ 1414 MLU_2_OD_SendOdOnBootup 1;
BA_ "CANzero_SDO_AccessIfOperational" SG_ 1414 MLU_2_OD_HeartbeatInterval 1;
BA_ "GenSigStartValue" SG_ 1414 MLU_2_OD_HeartbeatInterval 250.0;
BA_ "CANzero_SDO_Default" SG_ 1414 MLU_2_OD_HeartbeatInterval 250;
BA_ "CANzero_SDO_AccessType" SG_ 1414 MLU_2_OD_DbcVersion 1;
BA_ "CANzero_SDO_AccessIfOperational" SG_ 1414 MLU_2_OD_DbcVersion 1;
BA_ "CANzero_SDO_AccessType" SG_ 1414 MLU_2_OD_StackVersion 1;
BA_ "CANzero_SDO_AccessIfOperational" SG_ 1414 MLU_2_OD_StackVersion 1;
BA_ "CANzero_SDO_AccessType" SG_ 1414 MLU_2_OD_ProtocolVersion 1;
BA_ "CANzero_SDO_AccessIfOperational" SG_ 1414 MLU_2_OD_ProtocolVersion 1;
BA_ "GenSigStartValue" SG_ 1414 MLU_2_OD_ProtocolVersion 1.0;
BA_ "CANzero_SDO_Default" SG_ 1414 MLU_2_OD_ProtocolVersion 1;
BA_ "CANzero_SDO_AccessType" SG_ 1414 MLU_2_OD_NodeStatus 1;
BA_ "CANzero_SDO_AccessIfOperational" SG_ 1414 MLU_2_OD_NodeStatus 1;
BA_ "CANzero_SDO_AccessType" SG_ 1414 MLU_2_OD_NodeID 1;
BA_ "CANzero_SDO_AccessIfOperational" SG_ 1414 MLU_2_OD_NodeID 1;
BA_ "CANzero_SDO_Group" SG_ 1478 MLU_2_OD_CAN2_DelayedTxMessages "CAN";
BA_ "CANzero_SDO_AccessType" SG_ 1478 MLU_2_OD_CAN2_DelayedTxMessages 1;
BA_ "CANzero_SDO_AccessIfOperational" SG_ 1478 MLU_2_OD_CAN2_DelayedTxMessages 1;
BA_ "CANzero_SDO_Group" SG_ 1478 MLU_2_OD_CAN2_ErrorStatus "CAN";
BA_ "CANzero_SDO_AccessType" SG_ 1478 MLU_2_OD_CAN2_ErrorStatus 1;
BA_ "CANzero_SDO_AccessIfOperational" SG_ 1478 MLU_2_OD_CAN2_ErrorStatus 1;
BA_ "CANzero_SDO_Group" SG_ 1478 MLU_2_OD_CAN2_DiscardedTxMe_0000 "CAN";
BA_ "CANzero_SDO_AccessType" SG_ 1478 MLU_2_OD_CAN2_DiscardedTxMe_0000 1;
BA_ "CANzero_SDO_AccessIfOperational" SG_ 1478 MLU_2_OD_CAN2_DiscardedTxMe_0000 1;
BA_ "SystemSignalLongSymbol" SG_ 1478 MLU_2_OD_CAN2_DiscardedTxMe_0000 "MLU_2_OD_CAN2_DiscardedTxMessages";
BA_ "CANzero_SDO_Group" SG_ 1478 MLU_2_OD_CAN2_Status "CAN";
BA_ "CANzero_SDO_AccessType" SG_ 1478 MLU_2_OD_CAN2_Status 1;
BA_ "CANzero_SDO_AccessIfOperational" SG_ 1478 MLU_2_OD_CAN2_Status 1;
BA_ "CANzero_SDO_Group" SG_ 1478 MLU_2_OD_CAN2_Baudrate "CAN";
BA_ "CANzero_SDO_AccessIfOperational" SG_ 1478 MLU_2_OD_CAN2_Baudrate 1;
BA_ "GenSigStartValue" SG_ 1478 MLU_2_OD_CAN2_Baudrate 1000.0;
BA_ "CANzero_SDO_Default" SG_ 1478 MLU_2_OD_CAN2_Baudrate 1000;
BA_ "CANzero_SDO_Group" SG_ 1478 MLU_2_OD_CAN2_autoErrorReset "CAN";
BA_ "CANzero_SDO_AccessIfOperational" SG_ 1478 MLU_2_OD_CAN2_autoErrorReset 1;
BA_ "GenSigStartValue" SG_ 1478 MLU_2_OD_CAN2_autoErrorReset 1.0;
BA_ "CANzero_SDO_Default" SG_ 1478 MLU_2_OD_CAN2_autoErrorReset 1;
BA_ "CANzero_SDO_Group" SG_ 1478 MLU_2_OD_CAN2_lastErrorCode "CAN";
BA_ "CANzero_SDO_AccessType" SG_ 1478 MLU_2_OD_CAN2_lastErrorCode 1;
BA_ "CANzero_SDO_AccessIfOperational" SG_ 1478 MLU_2_OD_CAN2_lastErrorCode 1;
BA_ "CANzero_SDO_Group" SG_ 1478 MLU_2_OD_CAN2_RxErrCnt "CAN";
BA_ "CANzero_SDO_AccessType" SG_ 1478 MLU_2_OD_CAN2_RxErrCnt 1;
BA_ "CANzero_SDO_AccessIfOperational" SG_ 1478 MLU_2_OD_CAN2_RxErrCnt 1;
BA_ "CANzero_SDO_Group" SG_ 1478 MLU_2_OD_CAN2_TxErrCnt "CAN";
BA_ "CANzero_SDO_AccessType" SG_ 1478 MLU_2_OD_CAN2_TxErrCnt 1;
BA_ "CANzero_SDO_AccessIfOperational" SG_ 1478 MLU_2_OD_CAN2_TxErrCnt 1;
BA_ "CANzero_SDO_Group" SG_ 1478 MLU_2_OD_CAN1_DelayedTxMessages "CAN";
BA_ "CANzero_SDO_AccessType" SG_ 1478 MLU_2_OD_CAN1_DelayedTxMessages 1;
BA_ "CANzero_SDO_AccessIfOperational" SG_ 1478 MLU_2_OD_CAN1_DelayedTxMessages 1;
BA_ "CANzero_SDO_Group" SG_ 1478 MLU_2_OD_CAN1_ErrorStatus "CAN";
BA_ "CANzero_SDO_AccessType" SG_ 1478 MLU_2_OD_CAN1_ErrorStatus 1;
BA_ "CANzero_SDO_AccessIfOperational" SG_ 1478 MLU_2_OD_CAN1_ErrorStatus 1;
BA_ "CANzero_SDO_Group" SG_ 1478 MLU_2_OD_CAN1_DiscardedTxMe_0000 "CAN";
BA_ "CANzero_SDO_AccessType" SG_ 1478 MLU_2_OD_CAN1_DiscardedTxMe_0000 1;
BA_ "CANzero_SDO_AccessIfOperational" SG_ 1478 MLU_2_OD_CAN1_DiscardedTxMe_0000 1;
BA_ "SystemSignalLongSymbol" SG_ 1478 MLU_2_OD_CAN1_DiscardedTxMe_0000 "MLU_2_OD_CAN1_DiscardedTxMessages";
BA_ "CANzero_SDO_Group" SG_ 1478 MLU_2_OD_CAN1_Status "CAN";
BA_ "CANzero_SDO_AccessType" SG_ 1478 MLU_2_OD_CAN1_Status 1;
BA_ "CANzero_SDO_AccessIfOperational" SG_ 1478 MLU_2_OD_CAN1_Status 1;
BA_ "CANzero_SDO_Group" SG_ 1478 MLU_2_OD_CAN1_Baudrate "CAN";
BA_ "CANzero_SDO_AccessIfOperational" SG_ 1478 MLU_2_OD_CAN1_Baudrate 1;
BA_ "GenSigStartValue" SG_ 1478 MLU_2_OD_CAN1_Baudrate 1000.0;
BA_ "CANzero_SDO_Default" SG_ 1478 MLU_2_OD_CAN1_Baudrate 1000;
BA_ "CANzero_SDO_Group" SG_ 1478 MLU_2_OD_CAN1_autoErrorReset "CAN";
BA_ "CANzero_SDO_AccessIfOperational" SG_ 1478 MLU_2_OD_CAN1_autoErrorReset 1;
BA_ "GenSigStartValue" SG_ 1478 MLU_2_OD_CAN1_autoErrorReset 1.0;
BA_ "CANzero_SDO_Default" SG_ 1478 MLU_2_OD_CAN1_autoErrorReset 1;
BA_ "CANzero_SDO_Group" SG_ 1478 MLU_2_OD_CAN1_lastErrorCode "CAN";
BA_ "CANzero_SDO_AccessType" SG_ 1478 MLU_2_OD_CAN1_lastErrorCode 1;
BA_ "CANzero_SDO_AccessIfOperational" SG_ 1478 MLU_2_OD_CAN1_lastErrorCode 1;
BA_ "CANzero_SDO_Group" SG_ 1478 MLU_2_OD_CAN1_RxErrCnt "CAN";
BA_ "CANzero_SDO_AccessType" SG_ 1478 MLU_2_OD_CAN1_RxErrCnt 1;
BA_ "CANzero_SDO_AccessIfOperational" SG_ 1478 MLU_2_OD_CAN1_RxErrCnt 1;
BA_ "CANzero_SDO_Group" SG_ 1478 MLU_2_OD_CAN1_TxErrCnt "CAN";
BA_ "CANzero_SDO_AccessType" SG_ 1478 MLU_2_OD_CAN1_TxErrCnt 1;
BA_ "CANzero_SDO_AccessIfOperational" SG_ 1478 MLU_2_OD_CAN1_TxErrCnt 1;
BA_ "CANzero_SDO_AccessType" SG_ 1478 MLU_2_OD_BuildTime 1;
BA_ "CANzero_SDO_AccessIfOperational" SG_ 1478 MLU_2_OD_BuildTime 1;
BA_ "CANzero_SDO_AccessType" SG_ 1478 MLU_2_OD_BuildDate 1;
BA_ "CANzero_SDO_AccessIfOperational" SG_ 1478 MLU_2_OD_BuildDate 1;
BA_ "CANzero_SDO_AccessType" SG_ 1478 MLU_2_OD_ChipUID2 1;
BA_ "CANzero_SDO_AccessIfOperational" SG_ 1478 MLU_2_OD_ChipUID2 1;
BA_ "CANzero_SDO_AccessType" SG_ 1478 MLU_2_OD_ChipUID1 1;
BA_ "CANzero_SDO_AccessIfOperational" SG_ 1478 MLU_2_OD_ChipUID1 1;
BA_ "CANzero_SDO_AccessType" SG_ 1478 MLU_2_OD_SdcOut 1;
BA_ "CANzero_SDO_AccessIfOperational" SG_ 1478 MLU_2_OD_SdcOut 1;
BA_ "CANzero_SDO_AccessType" SG_ 1478 MLU_2_OD_SdcIn 1;
BA_ "CANzero_SDO_AccessIfOperational" SG_ 1478 MLU_2_OD_SdcIn 1;
BA_ "CANzero_SDO_AccessType" SG_ 1478 MLU_2_OD_runtime 1;
BA_ "CANzero_SDO_AccessIfOperational" SG_ 1478 MLU_2_OD_runtime 1;
BA_ "CANzero_SDO_AccessType" SG_ 1478 MLU_2_OD_InputVoltage 1;
BA_ "CANzero_SDO_AccessIfOperational" SG_ 1478 MLU_2_OD_InputVoltage 1;
BA_ "CANzero_SDO_AccessType" SG_ 1478 MLU_2_OD_BoardTemp 1;
BA_ "CANzero_SDO_AccessIfOperational" SG_ 1478 MLU_2_OD_BoardTemp 1;
BA_ "GenSigStartValue" SG_ 1478 MLU_2_OD_BoardTemp 3000.0;
BA_ "CANzero_SDO_AccessType" SG_ 1478 MLU_2_OD_MemFree 1;
BA_ "CANzero_SDO_AccessIfOperational" SG_ 1478 MLU_2_OD_MemFree 1;
BA_ "CANzero_SDO_AccessType" SG_ 1478 MLU_2_OD_CpuUsage 1;
BA_ "CANzero_SDO_AccessIfOperational" SG_ 1478 MLU_2_OD_CpuUsage 1;
BA_ "CANzero_SDO_AccessIfOperational" SG_ 1478 MLU_2_OD_OdEntrySendInterval 1;
BA_ "GenSigStartValue" SG_ 1478 MLU_2_OD_OdEntrySendInterval 50.0;
BA_ "CANzero_SDO_Default" SG_ 1478 MLU_2_OD_OdEntrySendInterval 50;
BA_ "CANzero_SDO_AccessIfOperational" SG_ 1478 MLU_2_OD_SendOdOnBootup 1;
BA_ "CANzero_SDO_AccessIfOperational" SG_ 1478 MLU_2_OD_HeartbeatInterval 1;
BA_ "GenSigStartValue" SG_ 1478 MLU_2_OD_HeartbeatInterval 250.0;
BA_ "CANzero_SDO_Default" SG_ 1478 MLU_2_OD_HeartbeatInterval 250;
BA_ "CANzero_SDO_AccessType" SG_ 1478 MLU_2_OD_DbcVersion 1;
BA_ "CANzero_SDO_AccessIfOperational" SG_ 1478 MLU_2_OD_DbcVersion 1;
BA_ "CANzero_SDO_AccessType" SG_ 1478 MLU_2_OD_StackVersion 1;
BA_ "CANzero_SDO_AccessIfOperational" SG_ 1478 MLU_2_OD_StackVersion 1;
BA_ "CANzero_SDO_AccessType" SG_ 1478 MLU_2_OD_ProtocolVersion 1;
BA_ "CANzero_SDO_AccessIfOperational" SG_ 1478 MLU_2_OD_ProtocolVersion 1;
BA_ "GenSigStartValue" SG_ 1478 MLU_2_OD_ProtocolVersion 1.0;
BA_ "CANzero_SDO_Default" SG_ 1478 MLU_2_OD_ProtocolVersion 1;
BA_ "CANzero_SDO_AccessType" SG_ 1478 MLU_2_OD_NodeStatus 1;
BA_ "CANzero_SDO_AccessIfOperational" SG_ 1478 MLU_2_OD_NodeStatus 1;
BA_ "CANzero_SDO_AccessType" SG_ 1478 MLU_2_OD_NodeID 1;
BA_ "CANzero_SDO_AccessIfOperational" SG_ 1478 MLU_2_OD_NodeID 1;
BA_ "CANzero_SDO_Group" SG_ 1415 MLU_3_OD_CAN2_DelayedTxMessages "CAN";
BA_ "CANzero_SDO_AccessType" SG_ 1415 MLU_3_OD_CAN2_DelayedTxMessages 1;
BA_ "CANzero_SDO_AccessIfOperational" SG_ 1415 MLU_3_OD_CAN2_DelayedTxMessages 1;
BA_ "CANzero_SDO_Group" SG_ 1415 MLU_3_OD_CAN2_ErrorStatus "CAN";
BA_ "CANzero_SDO_AccessType" SG_ 1415 MLU_3_OD_CAN2_ErrorStatus 1;
BA_ "CANzero_SDO_AccessIfOperational" SG_ 1415 MLU_3_OD_CAN2_ErrorStatus 1;
BA_ "CANzero_SDO_Group" SG_ 1415 MLU_3_OD_CAN2_DiscardedTxMessage "CAN";
BA_ "CANzero_SDO_AccessType" SG_ 1415 MLU_3_OD_CAN2_DiscardedTxMessage 1;
BA_ "CANzero_SDO_AccessIfOperational" SG_ 1415 MLU_3_OD_CAN2_DiscardedTxMessage 1;
BA_ "SystemSignalLongSymbol" SG_ 1415 MLU_3_OD_CAN2_DiscardedTxMessage "MLU_3_OD_CAN2_DiscardedTxMessages";
BA_ "CANzero_SDO_Group" SG_ 1415 MLU_3_OD_CAN2_Status "CAN";
BA_ "CANzero_SDO_AccessType" SG_ 1415 MLU_3_OD_CAN2_Status 1;
BA_ "CANzero_SDO_AccessIfOperational" SG_ 1415 MLU_3_OD_CAN2_Status 1;
BA_ "CANzero_SDO_Group" SG_ 1415 MLU_3_OD_CAN2_Baudrate "CAN";
BA_ "CANzero_SDO_AccessIfOperational" SG_ 1415 MLU_3_OD_CAN2_Baudrate 1;
BA_ "GenSigStartValue" SG_ 1415 MLU_3_OD_CAN2_Baudrate 1000.0;
BA_ "CANzero_SDO_Default" SG_ 1415 MLU_3_OD_CAN2_Baudrate 1000;
BA_ "CANzero_SDO_Group" SG_ 1415 MLU_3_OD_CAN2_autoErrorReset "CAN";
BA_ "CANzero_SDO_AccessIfOperational" SG_ 1415 MLU_3_OD_CAN2_autoErrorReset 1;
BA_ "GenSigStartValue" SG_ 1415 MLU_3_OD_CAN2_autoErrorReset 1.0;
BA_ "CANzero_SDO_Default" SG_ 1415 MLU_3_OD_CAN2_autoErrorReset 1;
BA_ "CANzero_SDO_Group" SG_ 1415 MLU_3_OD_CAN2_lastErrorCode "CAN";
BA_ "CANzero_SDO_AccessType" SG_ 1415 MLU_3_OD_CAN2_lastErrorCode 1;
BA_ "CANzero_SDO_AccessIfOperational" SG_ 1415 MLU_3_OD_CAN2_lastErrorCode 1;
BA_ "CANzero_SDO_Group" SG_ 1415 MLU_3_OD_CAN2_RxErrCnt "CAN";
BA_ "CANzero_SDO_AccessType" SG_ 1415 MLU_3_OD_CAN2_RxErrCnt 1;
BA_ "CANzero_SDO_AccessIfOperational" SG_ 1415 MLU_3_OD_CAN2_RxErrCnt 1;
BA_ "CANzero_SDO_Group" SG_ 1415 MLU_3_OD_CAN2_TxErrCnt "CAN";
BA_ "CANzero_SDO_AccessType" SG_ 1415 MLU_3_OD_CAN2_TxErrCnt 1;
BA_ "CANzero_SDO_AccessIfOperational" SG_ 1415 MLU_3_OD_CAN2_TxErrCnt 1;
BA_ "CANzero_SDO_Group" SG_ 1415 MLU_3_OD_CAN1_DelayedTxMessages "CAN";
BA_ "CANzero_SDO_AccessType" SG_ 1415 MLU_3_OD_CAN1_DelayedTxMessages 1;
BA_ "CANzero_SDO_AccessIfOperational" SG_ 1415 MLU_3_OD_CAN1_DelayedTxMessages 1;
BA_ "CANzero_SDO_Group" SG_ 1415 MLU_3_OD_CAN1_ErrorStatus "CAN";
BA_ "CANzero_SDO_AccessType" SG_ 1415 MLU_3_OD_CAN1_ErrorStatus 1;
BA_ "CANzero_SDO_AccessIfOperational" SG_ 1415 MLU_3_OD_CAN1_ErrorStatus 1;
BA_ "CANzero_SDO_Group" SG_ 1415 MLU_3_OD_CAN1_DiscardedTxMessage "CAN";
BA_ "CANzero_SDO_AccessType" SG_ 1415 MLU_3_OD_CAN1_DiscardedTxMessage 1;
BA_ "CANzero_SDO_AccessIfOperational" SG_ 1415 MLU_3_OD_CAN1_DiscardedTxMessage 1;
BA_ "SystemSignalLongSymbol" SG_ 1415 MLU_3_OD_CAN1_DiscardedTxMessage "MLU_3_OD_CAN1_DiscardedTxMessages";
BA_ "CANzero_SDO_Group" SG_ 1415 MLU_3_OD_CAN1_Status "CAN";
BA_ "CANzero_SDO_AccessType" SG_ 1415 MLU_3_OD_CAN1_Status 1;
BA_ "CANzero_SDO_AccessIfOperational" SG_ 1415 MLU_3_OD_CAN1_Status 1;
BA_ "CANzero_SDO_Group" SG_ 1415 MLU_3_OD_CAN1_Baudrate "CAN";
BA_ "CANzero_SDO_AccessIfOperational" SG_ 1415 MLU_3_OD_CAN1_Baudrate 1;
BA_ "GenSigStartValue" SG_ 1415 MLU_3_OD_CAN1_Baudrate 1000.0;
BA_ "CANzero_SDO_Default" SG_ 1415 MLU_3_OD_CAN1_Baudrate 1000;
BA_ "CANzero_SDO_Group" SG_ 1415 MLU_3_OD_CAN1_autoErrorReset "CAN";
BA_ "CANzero_SDO_AccessIfOperational" SG_ 1415 MLU_3_OD_CAN1_autoErrorReset 1;
BA_ "GenSigStartValue" SG_ 1415 MLU_3_OD_CAN1_autoErrorReset 1.0;
BA_ "CANzero_SDO_Default" SG_ 1415 MLU_3_OD_CAN1_autoErrorReset 1;
BA_ "CANzero_SDO_Group" SG_ 1415 MLU_3_OD_CAN1_lastErrorCode "CAN";
BA_ "CANzero_SDO_AccessType" SG_ 1415 MLU_3_OD_CAN1_lastErrorCode 1;
BA_ "CANzero_SDO_AccessIfOperational" SG_ 1415 MLU_3_OD_CAN1_lastErrorCode 1;
BA_ "CANzero_SDO_Group" SG_ 1415 MLU_3_OD_CAN1_RxErrCnt "CAN";
BA_ "CANzero_SDO_AccessType" SG_ 1415 MLU_3_OD_CAN1_RxErrCnt 1;
BA_ "CANzero_SDO_AccessIfOperational" SG_ 1415 MLU_3_OD_CAN1_RxErrCnt 1;
BA_ "CANzero_SDO_Group" SG_ 1415 MLU_3_OD_CAN1_TxErrCnt "CAN";
BA_ "CANzero_SDO_AccessType" SG_ 1415 MLU_3_OD_CAN1_TxErrCnt 1;
BA_ "CANzero_SDO_AccessIfOperational" SG_ 1415 MLU_3_OD_CAN1_TxErrCnt 1;
BA_ "CANzero_SDO_AccessType" SG_ 1415 MLU_3_OD_BuildTime 1;
BA_ "CANzero_SDO_AccessIfOperational" SG_ 1415 MLU_3_OD_BuildTime 1;
BA_ "CANzero_SDO_AccessType" SG_ 1415 MLU_3_OD_BuildDate 1;
BA_ "CANzero_SDO_AccessIfOperational" SG_ 1415 MLU_3_OD_BuildDate 1;
BA_ "CANzero_SDO_AccessType" SG_ 1415 MLU_3_OD_ChipUID2 1;
BA_ "CANzero_SDO_AccessIfOperational" SG_ 1415 MLU_3_OD_ChipUID2 1;
BA_ "CANzero_SDO_AccessType" SG_ 1415 MLU_3_OD_ChipUID1 1;
BA_ "CANzero_SDO_AccessIfOperational" SG_ 1415 MLU_3_OD_ChipUID1 1;
BA_ "CANzero_SDO_AccessType" SG_ 1415 MLU_3_OD_SdcOut 1;
BA_ "CANzero_SDO_AccessIfOperational" SG_ 1415 MLU_3_OD_SdcOut 1;
BA_ "CANzero_SDO_AccessType" SG_ 1415 MLU_3_OD_SdcIn 1;
BA_ "CANzero_SDO_AccessIfOperational" SG_ 1415 MLU_3_OD_SdcIn 1;
BA_ "CANzero_SDO_AccessType" SG_ 1415 MLU_3_OD_runtime 1;
BA_ "CANzero_SDO_AccessIfOperational" SG_ 1415 MLU_3_OD_runtime 1;
BA_ "CANzero_SDO_AccessType" SG_ 1415 MLU_3_OD_InputVoltage 1;
BA_ "CANzero_SDO_AccessIfOperational" SG_ 1415 MLU_3_OD_InputVoltage 1;
BA_ "CANzero_SDO_AccessType" SG_ 1415 MLU_3_OD_BoardTemp 1;
BA_ "CANzero_SDO_AccessIfOperational" SG_ 1415 MLU_3_OD_BoardTemp 1;
BA_ "GenSigStartValue" SG_ 1415 MLU_3_OD_BoardTemp 3000.0;
BA_ "CANzero_SDO_AccessType" SG_ 1415 MLU_3_OD_MemFree 1;
BA_ "CANzero_SDO_AccessIfOperational" SG_ 1415 MLU_3_OD_MemFree 1;
BA_ "CANzero_SDO_AccessType" SG_ 1415 MLU_3_OD_CpuUsage 1;
BA_ "CANzero_SDO_AccessIfOperational" SG_ 1415 MLU_3_OD_CpuUsage 1;
BA_ "CANzero_SDO_AccessIfOperational" SG_ 1415 MLU_3_OD_OdEntrySendInterval 1;
BA_ "GenSigStartValue" SG_ 1415 MLU_3_OD_OdEntrySendInterval 50.0;
BA_ "CANzero_SDO_Default" SG_ 1415 MLU_3_OD_OdEntrySendInterval 50;
BA_ "CANzero_SDO_AccessIfOperational" SG_ 1415 MLU_3_OD_SendOdOnBootup 1;
BA_ "CANzero_SDO_AccessIfOperational" SG_ 1415 MLU_3_OD_HeartbeatInterval 1;
BA_ "GenSigStartValue" SG_ 1415 MLU_3_OD_HeartbeatInterval 250.0;
BA_ "CANzero_SDO_Default" SG_ 1415 MLU_3_OD_HeartbeatInterval 250;
BA_ "CANzero_SDO_AccessType" SG_ 1415 MLU_3_OD_DbcVersion 1;
BA_ "CANzero_SDO_AccessIfOperational" SG_ 1415 MLU_3_OD_DbcVersion 1;
BA_ "CANzero_SDO_AccessType" SG_ 1415 MLU_3_OD_StackVersion 1;
BA_ "CANzero_SDO_AccessIfOperational" SG_ 1415 MLU_3_OD_StackVersion 1;
BA_ "CANzero_SDO_AccessType" SG_ 1415 MLU_3_OD_ProtocolVersion 1;
BA_ "CANzero_SDO_AccessIfOperational" SG_ 1415 MLU_3_OD_ProtocolVersion 1;
BA_ "GenSigStartValue" SG_ 1415 MLU_3_OD_ProtocolVersion 1.0;
BA_ "CANzero_SDO_Default" SG_ 1415 MLU_3_OD_ProtocolVersion 1;
BA_ "CANzero_SDO_AccessType" SG_ 1415 MLU_3_OD_NodeStatus 1;
BA_ "CANzero_SDO_AccessIfOperational" SG_ 1415 MLU_3_OD_NodeStatus 1;
BA_ "CANzero_SDO_AccessType" SG_ 1415 MLU_3_OD_NodeID 1;
BA_ "CANzero_SDO_AccessIfOperational" SG_ 1415 MLU_3_OD_NodeID 1;
BA_ "CANzero_SDO_Group" SG_ 1479 MLU_3_OD_CAN2_DelayedTxMessages "CAN";
BA_ "CANzero_SDO_AccessType" SG_ 1479 MLU_3_OD_CAN2_DelayedTxMessages 1;
BA_ "CANzero_SDO_AccessIfOperational" SG_ 1479 MLU_3_OD_CAN2_DelayedTxMessages 1;
BA_ "CANzero_SDO_Group" SG_ 1479 MLU_3_OD_CAN2_ErrorStatus "CAN";
BA_ "CANzero_SDO_AccessType" SG_ 1479 MLU_3_OD_CAN2_ErrorStatus 1;
BA_ "CANzero_SDO_AccessIfOperational" SG_ 1479 MLU_3_OD_CAN2_ErrorStatus 1;
BA_ "CANzero_SDO_Group" SG_ 1479 MLU_3_OD_CAN2_DiscardedTxMe_0000 "CAN";
BA_ "CANzero_SDO_AccessType" SG_ 1479 MLU_3_OD_CAN2_DiscardedTxMe_0000 1;
BA_ "CANzero_SDO_AccessIfOperational" SG_ 1479 MLU_3_OD_CAN2_DiscardedTxMe_0000 1;
BA_ "SystemSignalLongSymbol" SG_ 1479 MLU_3_OD_CAN2_DiscardedTxMe_0000 "MLU_3_OD_CAN2_DiscardedTxMessages";
BA_ "CANzero_SDO_Group" SG_ 1479 MLU_3_OD_CAN2_Status "CAN";
BA_ "CANzero_SDO_AccessType" SG_ 1479 MLU_3_OD_CAN2_Status 1;
BA_ "CANzero_SDO_AccessIfOperational" SG_ 1479 MLU_3_OD_CAN2_Status 1;
BA_ "CANzero_SDO_Group" SG_ 1479 MLU_3_OD_CAN2_Baudrate "CAN";
BA_ "CANzero_SDO_AccessIfOperational" SG_ 1479 MLU_3_OD_CAN2_Baudrate 1;
BA_ "GenSigStartValue" SG_ 1479 MLU_3_OD_CAN2_Baudrate 1000.0;
BA_ "CANzero_SDO_Default" SG_ 1479 MLU_3_OD_CAN2_Baudrate 1000;
BA_ "CANzero_SDO_Group" SG_ 1479 MLU_3_OD_CAN2_autoErrorReset "CAN";
BA_ "CANzero_SDO_AccessIfOperational" SG_ 1479 MLU_3_OD_CAN2_autoErrorReset 1;
BA_ "GenSigStartValue" SG_ 1479 MLU_3_OD_CAN2_autoErrorReset 1.0;
BA_ "CANzero_SDO_Default" SG_ 1479 MLU_3_OD_CAN2_autoErrorReset 1;
BA_ "CANzero_SDO_Group" SG_ 1479 MLU_3_OD_CAN2_lastErrorCode "CAN";
BA_ "CANzero_SDO_AccessType" SG_ 1479 MLU_3_OD_CAN2_lastErrorCode 1;
BA_ "CANzero_SDO_AccessIfOperational" SG_ 1479 MLU_3_OD_CAN2_lastErrorCode 1;
BA_ "CANzero_SDO_Group" SG_ 1479 MLU_3_OD_CAN2_RxErrCnt "CAN";
BA_ "CANzero_SDO_AccessType" SG_ 1479 MLU_3_OD_CAN2_RxErrCnt 1;
BA_ "CANzero_SDO_AccessIfOperational" SG_ 1479 MLU_3_OD_CAN2_RxErrCnt 1;
BA_ "CANzero_SDO_Group" SG_ 1479 MLU_3_OD_CAN2_TxErrCnt "CAN";
BA_ "CANzero_SDO_AccessType" SG_ 1479 MLU_3_OD_CAN2_TxErrCnt 1;
BA_ "CANzero_SDO_AccessIfOperational" SG_ 1479 MLU_3_OD_CAN2_TxErrCnt 1;
BA_ "CANzero_SDO_Group" SG_ 1479 MLU_3_OD_CAN1_DelayedTxMessages "CAN";
BA_ "CANzero_SDO_AccessType" SG_ 1479 MLU_3_OD_CAN1_DelayedTxMessages 1;
BA_ "CANzero_SDO_AccessIfOperational" SG_ 1479 MLU_3_OD_CAN1_DelayedTxMessages 1;
BA_ "CANzero_SDO_Group" SG_ 1479 MLU_3_OD_CAN1_ErrorStatus "CAN";
BA_ "CANzero_SDO_AccessType" SG_ 1479 MLU_3_OD_CAN1_ErrorStatus 1;
BA_ "CANzero_SDO_AccessIfOperational" SG_ 1479 MLU_3_OD_CAN1_ErrorStatus 1;
BA_ "CANzero_SDO_Group" SG_ 1479 MLU_3_OD_CAN1_DiscardedTxMe_0000 "CAN";
BA_ "CANzero_SDO_AccessType" SG_ 1479 MLU_3_OD_CAN1_DiscardedTxMe_0000 1;
BA_ "CANzero_SDO_AccessIfOperational" SG_ 1479 MLU_3_OD_CAN1_DiscardedTxMe_0000 1;
BA_ "SystemSignalLongSymbol" SG_ 1479 MLU_3_OD_CAN1_DiscardedTxMe_0000 "MLU_3_OD_CAN1_DiscardedTxMessages";
BA_ "CANzero_SDO_Group" SG_ 1479 MLU_3_OD_CAN1_Status "CAN";
BA_ "CANzero_SDO_AccessType" SG_ 1479 MLU_3_OD_CAN1_Status 1;
BA_ "CANzero_SDO_AccessIfOperational" SG_ 1479 MLU_3_OD_CAN1_Status 1;
BA_ "CANzero_SDO_Group" SG_ 1479 MLU_3_OD_CAN1_Baudrate "CAN";
BA_ "CANzero_SDO_AccessIfOperational" SG_ 1479 MLU_3_OD_CAN1_Baudrate 1;
BA_ "GenSigStartValue" SG_ 1479 MLU_3_OD_CAN1_Baudrate 1000.0;
BA_ "CANzero_SDO_Default" SG_ 1479 MLU_3_OD_CAN1_Baudrate 1000;
BA_ "CANzero_SDO_Group" SG_ 1479 MLU_3_OD_CAN1_autoErrorReset "CAN";
BA_ "CANzero_SDO_AccessIfOperational" SG_ 1479 MLU_3_OD_CAN1_autoErrorReset 1;
BA_ "GenSigStartValue" SG_ 1479 MLU_3_OD_CAN1_autoErrorReset 1.0;
BA_ "CANzero_SDO_Default" SG_ 1479 MLU_3_OD_CAN1_autoErrorReset 1;
BA_ "CANzero_SDO_Group" SG_ 1479 MLU_3_OD_CAN1_lastErrorCode "CAN";
BA_ "CANzero_SDO_AccessType" SG_ 1479 MLU_3_OD_CAN1_lastErrorCode 1;
BA_ "CANzero_SDO_AccessIfOperational" SG_ 1479 MLU_3_OD_CAN1_lastErrorCode 1;
BA_ "CANzero_SDO_Group" SG_ 1479 MLU_3_OD_CAN1_RxErrCnt "CAN";
BA_ "CANzero_SDO_AccessType" SG_ 1479 MLU_3_OD_CAN1_RxErrCnt 1;
BA_ "CANzero_SDO_AccessIfOperational" SG_ 1479 MLU_3_OD_CAN1_RxErrCnt 1;
BA_ "CANzero_SDO_Group" SG_ 1479 MLU_3_OD_CAN1_TxErrCnt "CAN";
BA_ "CANzero_SDO_AccessType" SG_ 1479 MLU_3_OD_CAN1_TxErrCnt 1;
BA_ "CANzero_SDO_AccessIfOperational" SG_ 1479 MLU_3_OD_CAN1_TxErrCnt 1;
BA_ "CANzero_SDO_AccessType" SG_ 1479 MLU_3_OD_BuildTime 1;
BA_ "CANzero_SDO_AccessIfOperational" SG_ 1479 MLU_3_OD_BuildTime 1;
BA_ "CANzero_SDO_AccessType" SG_ 1479 MLU_3_OD_BuildDate 1;
BA_ "CANzero_SDO_AccessIfOperational" SG_ 1479 MLU_3_OD_BuildDate 1;
BA_ "CANzero_SDO_AccessType" SG_ 1479 MLU_3_OD_ChipUID2 1;
BA_ "CANzero_SDO_AccessIfOperational" SG_ 1479 MLU_3_OD_ChipUID2 1;
BA_ "CANzero_SDO_AccessType" SG_ 1479 MLU_3_OD_ChipUID1 1;
BA_ "CANzero_SDO_AccessIfOperational" SG_ 1479 MLU_3_OD_ChipUID1 1;
BA_ "CANzero_SDO_AccessType" SG_ 1479 MLU_3_OD_SdcOut 1;
BA_ "CANzero_SDO_AccessIfOperational" SG_ 1479 MLU_3_OD_SdcOut 1;
BA_ "CANzero_SDO_AccessType" SG_ 1479 MLU_3_OD_SdcIn 1;
BA_ "CANzero_SDO_AccessIfOperational" SG_ 1479 MLU_3_OD_SdcIn 1;
BA_ "CANzero_SDO_AccessType" SG_ 1479 MLU_3_OD_runtime 1;
BA_ "CANzero_SDO_AccessIfOperational" SG_ 1479 MLU_3_OD_runtime 1;
BA_ "CANzero_SDO_AccessType" SG_ 1479 MLU_3_OD_InputVoltage 1;
BA_ "CANzero_SDO_AccessIfOperational" SG_ 1479 MLU_3_OD_InputVoltage 1;
BA_ "CANzero_SDO_AccessType" SG_ 1479 MLU_3_OD_BoardTemp 1;
BA_ "CANzero_SDO_AccessIfOperational" SG_ 1479 MLU_3_OD_BoardTemp 1;
BA_ "GenSigStartValue" SG_ 1479 MLU_3_OD_BoardTemp 3000.0;
BA_ "CANzero_SDO_AccessType" SG_ 1479 MLU_3_OD_MemFree 1;
BA_ "CANzero_SDO_AccessIfOperational" SG_ 1479 MLU_3_OD_MemFree 1;
BA_ "CANzero_SDO_AccessType" SG_ 1479 MLU_3_OD_CpuUsage 1;
BA_ "CANzero_SDO_AccessIfOperational" SG_ 1479 MLU_3_OD_CpuUsage 1;
BA_ "CANzero_SDO_AccessIfOperational" SG_ 1479 MLU_3_OD_OdEntrySendInterval 1;
BA_ "GenSigStartValue" SG_ 1479 MLU_3_OD_OdEntrySendInterval 50.0;
BA_ "CANzero_SDO_Default" SG_ 1479 MLU_3_OD_OdEntrySendInterval 50;
BA_ "CANzero_SDO_AccessIfOperational" SG_ 1479 MLU_3_OD_SendOdOnBootup 1;
BA_ "CANzero_SDO_AccessIfOperational" SG_ 1479 MLU_3_OD_HeartbeatInterval 1;
BA_ "GenSigStartValue" SG_ 1479 MLU_3_OD_HeartbeatInterval 250.0;
BA_ "CANzero_SDO_Default" SG_ 1479 MLU_3_OD_HeartbeatInterval 250;
BA_ "CANzero_SDO_AccessType" SG_ 1479 MLU_3_OD_DbcVersion 1;
BA_ "CANzero_SDO_AccessIfOperational" SG_ 1479 MLU_3_OD_DbcVersion 1;
BA_ "CANzero_SDO_AccessType" SG_ 1479 MLU_3_OD_StackVersion 1;
BA_ "CANzero_SDO_AccessIfOperational" SG_ 1479 MLU_3_OD_StackVersion 1;
BA_ "CANzero_SDO_AccessType" SG_ 1479 MLU_3_OD_ProtocolVersion 1;
BA_ "CANzero_SDO_AccessIfOperational" SG_ 1479 MLU_3_OD_ProtocolVersion 1;
BA_ "GenSigStartValue" SG_ 1479 MLU_3_OD_ProtocolVersion 1.0;
BA_ "CANzero_SDO_Default" SG_ 1479 MLU_3_OD_ProtocolVersion 1;
BA_ "CANzero_SDO_AccessType" SG_ 1479 MLU_3_OD_NodeStatus 1;
BA_ "CANzero_SDO_AccessIfOperational" SG_ 1479 MLU_3_OD_NodeStatus 1;
BA_ "CANzero_SDO_AccessType" SG_ 1479 MLU_3_OD_NodeID 1;
BA_ "CANzero_SDO_AccessIfOperational" SG_ 1479 MLU_3_OD_NodeID 1;
BA_ "CANzero_SDO_Group" SG_ 1416 MLU_4_OD_CAN2_DelayedTxMessages "CAN";
BA_ "CANzero_SDO_AccessType" SG_ 1416 MLU_4_OD_CAN2_DelayedTxMessages 1;
BA_ "CANzero_SDO_AccessIfOperational" SG_ 1416 MLU_4_OD_CAN2_DelayedTxMessages 1;
BA_ "CANzero_SDO_Group" SG_ 1416 MLU_4_OD_CAN2_ErrorStatus "CAN";
BA_ "CANzero_SDO_AccessType" SG_ 1416 MLU_4_OD_CAN2_ErrorStatus 1;
BA_ "CANzero_SDO_AccessIfOperational" SG_ 1416 MLU_4_OD_CAN2_ErrorStatus 1;
BA_ "CANzero_SDO_Group" SG_ 1416 MLU_4_OD_CAN2_DiscardedTxMessage "CAN";
BA_ "CANzero_SDO_AccessType" SG_ 1416 MLU_4_OD_CAN2_DiscardedTxMessage 1;
BA_ "CANzero_SDO_AccessIfOperational" SG_ 1416 MLU_4_OD_CAN2_DiscardedTxMessage 1;
BA_ "SystemSignalLongSymbol" SG_ 1416 MLU_4_OD_CAN2_DiscardedTxMessage "MLU_4_OD_CAN2_DiscardedTxMessages";
BA_ "CANzero_SDO_Group" SG_ 1416 MLU_4_OD_CAN2_Status "CAN";
BA_ "CANzero_SDO_AccessType" SG_ 1416 MLU_4_OD_CAN2_Status 1;
BA_ "CANzero_SDO_AccessIfOperational" SG_ 1416 MLU_4_OD_CAN2_Status 1;
BA_ "CANzero_SDO_Group" SG_ 1416 MLU_4_OD_CAN2_Baudrate "CAN";
BA_ "CANzero_SDO_AccessIfOperational" SG_ 1416 MLU_4_OD_CAN2_Baudrate 1;
BA_ "GenSigStartValue" SG_ 1416 MLU_4_OD_CAN2_Baudrate 1000.0;
BA_ "CANzero_SDO_Default" SG_ 1416 MLU_4_OD_CAN2_Baudrate 1000;
BA_ "CANzero_SDO_Group" SG_ 1416 MLU_4_OD_CAN2_autoErrorReset "CAN";
BA_ "CANzero_SDO_AccessIfOperational" SG_ 1416 MLU_4_OD_CAN2_autoErrorReset 1;
BA_ "GenSigStartValue" SG_ 1416 MLU_4_OD_CAN2_autoErrorReset 1.0;
BA_ "CANzero_SDO_Default" SG_ 1416 MLU_4_OD_CAN2_autoErrorReset 1;
BA_ "CANzero_SDO_Group" SG_ 1416 MLU_4_OD_CAN2_lastErrorCode "CAN";
BA_ "CANzero_SDO_AccessType" SG_ 1416 MLU_4_OD_CAN2_lastErrorCode 1;
BA_ "CANzero_SDO_AccessIfOperational" SG_ 1416 MLU_4_OD_CAN2_lastErrorCode 1;
BA_ "CANzero_SDO_Group" SG_ 1416 MLU_4_OD_CAN2_RxErrCnt "CAN";
BA_ "CANzero_SDO_AccessType" SG_ 1416 MLU_4_OD_CAN2_RxErrCnt 1;
BA_ "CANzero_SDO_AccessIfOperational" SG_ 1416 MLU_4_OD_CAN2_RxErrCnt 1;
BA_ "CANzero_SDO_Group" SG_ 1416 MLU_4_OD_CAN2_TxErrCnt "CAN";
BA_ "CANzero_SDO_AccessType" SG_ 1416 MLU_4_OD_CAN2_TxErrCnt 1;
BA_ "CANzero_SDO_AccessIfOperational" SG_ 1416 MLU_4_OD_CAN2_TxErrCnt 1;
BA_ "CANzero_SDO_Group" SG_ 1416 MLU_4_OD_CAN1_DelayedTxMessages "CAN";
BA_ "CANzero_SDO_AccessType" SG_ 1416 MLU_4_OD_CAN1_DelayedTxMessages 1;
BA_ "CANzero_SDO_AccessIfOperational" SG_ 1416 MLU_4_OD_CAN1_DelayedTxMessages 1;
BA_ "CANzero_SDO_Group" SG_ 1416 MLU_4_OD_CAN1_ErrorStatus "CAN";
BA_ "CANzero_SDO_AccessType" SG_ 1416 MLU_4_OD_CAN1_ErrorStatus 1;
BA_ "CANzero_SDO_AccessIfOperational" SG_ 1416 MLU_4_OD_CAN1_ErrorStatus 1;
BA_ "CANzero_SDO_Group" SG_ 1416 MLU_4_OD_CAN1_DiscardedTxMessage "CAN";
BA_ "CANzero_SDO_AccessType" SG_ 1416 MLU_4_OD_CAN1_DiscardedTxMessage 1;
BA_ "CANzero_SDO_AccessIfOperational" SG_ 1416 MLU_4_OD_CAN1_DiscardedTxMessage 1;
BA_ "SystemSignalLongSymbol" SG_ 1416 MLU_4_OD_CAN1_DiscardedTxMessage "MLU_4_OD_CAN1_DiscardedTxMessages";
BA_ "CANzero_SDO_Group" SG_ 1416 MLU_4_OD_CAN1_Status "CAN";
BA_ "CANzero_SDO_AccessType" SG_ 1416 MLU_4_OD_CAN1_Status 1;
BA_ "CANzero_SDO_AccessIfOperational" SG_ 1416 MLU_4_OD_CAN1_Status 1;
BA_ "CANzero_SDO_Group" SG_ 1416 MLU_4_OD_CAN1_Baudrate "CAN";
BA_ "CANzero_SDO_AccessIfOperational" SG_ 1416 MLU_4_OD_CAN1_Baudrate 1;
BA_ "GenSigStartValue" SG_ 1416 MLU_4_OD_CAN1_Baudrate 1000.0;
BA_ "CANzero_SDO_Default" SG_ 1416 MLU_4_OD_CAN1_Baudrate 1000;
BA_ "CANzero_SDO_Group" SG_ 1416 MLU_4_OD_CAN1_autoErrorReset "CAN";
BA_ "CANzero_SDO_AccessIfOperational" SG_ 1416 MLU_4_OD_CAN1_autoErrorReset 1;
BA_ "GenSigStartValue" SG_ 1416 MLU_4_OD_CAN1_autoErrorReset 1.0;
BA_ "CANzero_SDO_Default" SG_ 1416 MLU_4_OD_CAN1_autoErrorReset 1;
BA_ "CANzero_SDO_Group" SG_ 1416 MLU_4_OD_CAN1_lastErrorCode "CAN";
BA_ "CANzero_SDO_AccessType" SG_ 1416 MLU_4_OD_CAN1_lastErrorCode 1;
BA_ "CANzero_SDO_AccessIfOperational" SG_ 1416 MLU_4_OD_CAN1_lastErrorCode 1;
BA_ "CANzero_SDO_Group" SG_ 1416 MLU_4_OD_CAN1_RxErrCnt "CAN";
BA_ "CANzero_SDO_AccessType" SG_ 1416 MLU_4_OD_CAN1_RxErrCnt 1;
BA_ "CANzero_SDO_AccessIfOperational" SG_ 1416 MLU_4_OD_CAN1_RxErrCnt 1;
BA_ "CANzero_SDO_Group" SG_ 1416 MLU_4_OD_CAN1_TxErrCnt "CAN";
BA_ "CANzero_SDO_AccessType" SG_ 1416 MLU_4_OD_CAN1_TxErrCnt 1;
BA_ "CANzero_SDO_AccessIfOperational" SG_ 1416 MLU_4_OD_CAN1_TxErrCnt 1;
BA_ "CANzero_SDO_AccessType" SG_ 1416 MLU_4_OD_BuildTime 1;
BA_ "CANzero_SDO_AccessIfOperational" SG_ 1416 MLU_4_OD_BuildTime 1;
BA_ "CANzero_SDO_AccessType" SG_ 1416 MLU_4_OD_BuildDate 1;
BA_ "CANzero_SDO_AccessIfOperational" SG_ 1416 MLU_4_OD_BuildDate 1;
BA_ "CANzero_SDO_AccessType" SG_ 1416 MLU_4_OD_ChipUID2 1;
BA_ "CANzero_SDO_AccessIfOperational" SG_ 1416 MLU_4_OD_ChipUID2 1;
BA_ "CANzero_SDO_AccessType" SG_ 1416 MLU_4_OD_ChipUID1 1;
BA_ "CANzero_SDO_AccessIfOperational" SG_ 1416 MLU_4_OD_ChipUID1 1;
BA_ "CANzero_SDO_AccessType" SG_ 1416 MLU_4_OD_SdcOut 1;
BA_ "CANzero_SDO_AccessIfOperational" SG_ 1416 MLU_4_OD_SdcOut 1;
BA_ "CANzero_SDO_AccessType" SG_ 1416 MLU_4_OD_SdcIn 1;
BA_ "CANzero_SDO_AccessIfOperational" SG_ 1416 MLU_4_OD_SdcIn 1;
BA_ "CANzero_SDO_AccessType" SG_ 1416 MLU_4_OD_runtime 1;
BA_ "CANzero_SDO_AccessIfOperational" SG_ 1416 MLU_4_OD_runtime 1;
BA_ "CANzero_SDO_AccessType" SG_ 1416 MLU_4_OD_InputVoltage 1;
BA_ "CANzero_SDO_AccessIfOperational" SG_ 1416 MLU_4_OD_InputVoltage 1;
BA_ "CANzero_SDO_AccessType" SG_ 1416 MLU_4_OD_BoardTemp 1;
BA_ "CANzero_SDO_AccessIfOperational" SG_ 1416 MLU_4_OD_BoardTemp 1;
BA_ "GenSigStartValue" SG_ 1416 MLU_4_OD_BoardTemp 3000.0;
BA_ "CANzero_SDO_AccessType" SG_ 1416 MLU_4_OD_MemFree 1;
BA_ "CANzero_SDO_AccessIfOperational" SG_ 1416 MLU_4_OD_MemFree 1;
BA_ "CANzero_SDO_AccessType" SG_ 1416 MLU_4_OD_CpuUsage 1;
BA_ "CANzero_SDO_AccessIfOperational" SG_ 1416 MLU_4_OD_CpuUsage 1;
BA_ "CANzero_SDO_AccessIfOperational" SG_ 1416 MLU_4_OD_OdEntrySendInterval 1;
BA_ "GenSigStartValue" SG_ 1416 MLU_4_OD_OdEntrySendInterval 50.0;
BA_ "CANzero_SDO_Default" SG_ 1416 MLU_4_OD_OdEntrySendInterval 50;
BA_ "CANzero_SDO_AccessIfOperational" SG_ 1416 MLU_4_OD_SendOdOnBootup 1;
BA_ "CANzero_SDO_AccessIfOperational" SG_ 1416 MLU_4_OD_HeartbeatInterval 1;
BA_ "GenSigStartValue" SG_ 1416 MLU_4_OD_HeartbeatInterval 250.0;
BA_ "CANzero_SDO_Default" SG_ 1416 MLU_4_OD_HeartbeatInterval 250;
BA_ "CANzero_SDO_AccessType" SG_ 1416 MLU_4_OD_DbcVersion 1;
BA_ "CANzero_SDO_AccessIfOperational" SG_ 1416 MLU_4_OD_DbcVersion 1;
BA_ "CANzero_SDO_AccessType" SG_ 1416 MLU_4_OD_StackVersion 1;
BA_ "CANzero_SDO_AccessIfOperational" SG_ 1416 MLU_4_OD_StackVersion 1;
BA_ "CANzero_SDO_AccessType" SG_ 1416 MLU_4_OD_ProtocolVersion 1;
BA_ "CANzero_SDO_AccessIfOperational" SG_ 1416 MLU_4_OD_ProtocolVersion 1;
BA_ "GenSigStartValue" SG_ 1416 MLU_4_OD_ProtocolVersion 1.0;
BA_ "CANzero_SDO_Default" SG_ 1416 MLU_4_OD_ProtocolVersion 1;
BA_ "CANzero_SDO_AccessType" SG_ 1416 MLU_4_OD_NodeStatus 1;
BA_ "CANzero_SDO_AccessIfOperational" SG_ 1416 MLU_4_OD_NodeStatus 1;
BA_ "CANzero_SDO_AccessType" SG_ 1416 MLU_4_OD_NodeID 1;
BA_ "CANzero_SDO_AccessIfOperational" SG_ 1416 MLU_4_OD_NodeID 1;
BA_ "CANzero_SDO_Group" SG_ 1480 MLU_4_OD_CAN2_DelayedTxMessages "CAN";
BA_ "CANzero_SDO_AccessType" SG_ 1480 MLU_4_OD_CAN2_DelayedTxMessages 1;
BA_ "CANzero_SDO_AccessIfOperational" SG_ 1480 MLU_4_OD_CAN2_DelayedTxMessages 1;
BA_ "CANzero_SDO_Group" SG_ 1480 MLU_4_OD_CAN2_ErrorStatus "CAN";
BA_ "CANzero_SDO_AccessType" SG_ 1480 MLU_4_OD_CAN2_ErrorStatus 1;
BA_ "CANzero_SDO_AccessIfOperational" SG_ 1480 MLU_4_OD_CAN2_ErrorStatus 1;
BA_ "CANzero_SDO_Group" SG_ 1480 MLU_4_OD_CAN2_DiscardedTxMe_0000 "CAN";
BA_ "CANzero_SDO_AccessType" SG_ 1480 MLU_4_OD_CAN2_DiscardedTxMe_0000 1;
BA_ "CANzero_SDO_AccessIfOperational" SG_ 1480 MLU_4_OD_CAN2_DiscardedTxMe_0000 1;
BA_ "SystemSignalLongSymbol" SG_ 1480 MLU_4_OD_CAN2_DiscardedTxMe_0000 "MLU_4_OD_CAN2_DiscardedTxMessages";
BA_ "CANzero_SDO_Group" SG_ 1480 MLU_4_OD_CAN2_Status "CAN";
BA_ "CANzero_SDO_AccessType" SG_ 1480 MLU_4_OD_CAN2_Status 1;
BA_ "CANzero_SDO_AccessIfOperational" SG_ 1480 MLU_4_OD_CAN2_Status 1;
BA_ "CANzero_SDO_Group" SG_ 1480 MLU_4_OD_CAN2_Baudrate "CAN";
BA_ "CANzero_SDO_AccessIfOperational" SG_ 1480 MLU_4_OD_CAN2_Baudrate 1;
BA_ "GenSigStartValue" SG_ 1480 MLU_4_OD_CAN2_Baudrate 1000.0;
BA_ "CANzero_SDO_Default" SG_ 1480 MLU_4_OD_CAN2_Baudrate 1000;
BA_ "CANzero_SDO_Group" SG_ 1480 MLU_4_OD_CAN2_autoErrorReset "CAN";
BA_ "CANzero_SDO_AccessIfOperational" SG_ 1480 MLU_4_OD_CAN2_autoErrorReset 1;
BA_ "GenSigStartValue" SG_ 1480 MLU_4_OD_CAN2_autoErrorReset 1.0;
BA_ "CANzero_SDO_Default" SG_ 1480 MLU_4_OD_CAN2_autoErrorReset 1;
BA_ "CANzero_SDO_Group" SG_ 1480 MLU_4_OD_CAN2_lastErrorCode "CAN";
BA_ "CANzero_SDO_AccessType" SG_ 1480 MLU_4_OD_CAN2_lastErrorCode 1;
BA_ "CANzero_SDO_AccessIfOperational" SG_ 1480 MLU_4_OD_CAN2_lastErrorCode 1;
BA_ "CANzero_SDO_Group" SG_ 1480 MLU_4_OD_CAN2_RxErrCnt "CAN";
BA_ "CANzero_SDO_AccessType" SG_ 1480 MLU_4_OD_CAN2_RxErrCnt 1;
BA_ "CANzero_SDO_AccessIfOperational" SG_ 1480 MLU_4_OD_CAN2_RxErrCnt 1;
BA_ "CANzero_SDO_Group" SG_ 1480 MLU_4_OD_CAN2_TxErrCnt "CAN";
BA_ "CANzero_SDO_AccessType" SG_ 1480 MLU_4_OD_CAN2_TxErrCnt 1;
BA_ "CANzero_SDO_AccessIfOperational" SG_ 1480 MLU_4_OD_CAN2_TxErrCnt 1;
BA_ "CANzero_SDO_Group" SG_ 1480 MLU_4_OD_CAN1_DelayedTxMessages "CAN";
BA_ "CANzero_SDO_AccessType" SG_ 1480 MLU_4_OD_CAN1_DelayedTxMessages 1;
BA_ "CANzero_SDO_AccessIfOperational" SG_ 1480 MLU_4_OD_CAN1_DelayedTxMessages 1;
BA_ "CANzero_SDO_Group" SG_ 1480 MLU_4_OD_CAN1_ErrorStatus "CAN";
BA_ "CANzero_SDO_AccessType" SG_ 1480 MLU_4_OD_CAN1_ErrorStatus 1;
BA_ "CANzero_SDO_AccessIfOperational" SG_ 1480 MLU_4_OD_CAN1_ErrorStatus 1;
BA_ "CANzero_SDO_Group" SG_ 1480 MLU_4_OD_CAN1_DiscardedTxMe_0000 "CAN";
BA_ "CANzero_SDO_AccessType" SG_ 1480 MLU_4_OD_CAN1_DiscardedTxMe_0000 1;
BA_ "CANzero_SDO_AccessIfOperational" SG_ 1480 MLU_4_OD_CAN1_DiscardedTxMe_0000 1;
BA_ "SystemSignalLongSymbol" SG_ 1480 MLU_4_OD_CAN1_DiscardedTxMe_0000 "MLU_4_OD_CAN1_DiscardedTxMessages";
BA_ "CANzero_SDO_Group" SG_ 1480 MLU_4_OD_CAN1_Status "CAN";
BA_ "CANzero_SDO_AccessType" SG_ 1480 MLU_4_OD_CAN1_Status 1;
BA_ "CANzero_SDO_AccessIfOperational" SG_ 1480 MLU_4_OD_CAN1_Status 1;
BA_ "CANzero_SDO_Group" SG_ 1480 MLU_4_OD_CAN1_Baudrate "CAN";
BA_ "CANzero_SDO_AccessIfOperational" SG_ 1480 MLU_4_OD_CAN1_Baudrate 1;
BA_ "GenSigStartValue" SG_ 1480 MLU_4_OD_CAN1_Baudrate 1000.0;
BA_ "CANzero_SDO_Default" SG_ 1480 MLU_4_OD_CAN1_Baudrate 1000;
BA_ "CANzero_SDO_Group" SG_ 1480 MLU_4_OD_CAN1_autoErrorReset "CAN";
BA_ "CANzero_SDO_AccessIfOperational" SG_ 1480 MLU_4_OD_CAN1_autoErrorReset 1;
BA_ "GenSigStartValue" SG_ 1480 MLU_4_OD_CAN1_autoErrorReset 1.0;
BA_ "CANzero_SDO_Default" SG_ 1480 MLU_4_OD_CAN1_autoErrorReset 1;
BA_ "CANzero_SDO_Group" SG_ 1480 MLU_4_OD_CAN1_lastErrorCode "CAN";
BA_ "CANzero_SDO_AccessType" SG_ 1480 MLU_4_OD_CAN1_lastErrorCode 1;
BA_ "CANzero_SDO_AccessIfOperational" SG_ 1480 MLU_4_OD_CAN1_lastErrorCode 1;
BA_ "CANzero_SDO_Group" SG_ 1480 MLU_4_OD_CAN1_RxErrCnt "CAN";
BA_ "CANzero_SDO_AccessType" SG_ 1480 MLU_4_OD_CAN1_RxErrCnt 1;
BA_ "CANzero_SDO_AccessIfOperational" SG_ 1480 MLU_4_OD_CAN1_RxErrCnt 1;
BA_ "CANzero_SDO_Group" SG_ 1480 MLU_4_OD_CAN1_TxErrCnt "CAN";
BA_ "CANzero_SDO_AccessType" SG_ 1480 MLU_4_OD_CAN1_TxErrCnt 1;
BA_ "CANzero_SDO_AccessIfOperational" SG_ 1480 MLU_4_OD_CAN1_TxErrCnt 1;
BA_ "CANzero_SDO_AccessType" SG_ 1480 MLU_4_OD_BuildTime 1;
BA_ "CANzero_SDO_AccessIfOperational" SG_ 1480 MLU_4_OD_BuildTime 1;
BA_ "CANzero_SDO_AccessType" SG_ 1480 MLU_4_OD_BuildDate 1;
BA_ "CANzero_SDO_AccessIfOperational" SG_ 1480 MLU_4_OD_BuildDate 1;
BA_ "CANzero_SDO_AccessType" SG_ 1480 MLU_4_OD_ChipUID2 1;
BA_ "CANzero_SDO_AccessIfOperational" SG_ 1480 MLU_4_OD_ChipUID2 1;
BA_ "CANzero_SDO_AccessType" SG_ 1480 MLU_4_OD_ChipUID1 1;
BA_ "CANzero_SDO_AccessIfOperational" SG_ 1480 MLU_4_OD_ChipUID1 1;
BA_ "CANzero_SDO_AccessType" SG_ 1480 MLU_4_OD_SdcOut 1;
BA_ "CANzero_SDO_AccessIfOperational" SG_ 1480 MLU_4_OD_SdcOut 1;
BA_ "CANzero_SDO_AccessType" SG_ 1480 MLU_4_OD_SdcIn 1;
BA_ "CANzero_SDO_AccessIfOperational" SG_ 1480 MLU_4_OD_SdcIn 1;
BA_ "CANzero_SDO_AccessType" SG_ 1480 MLU_4_OD_runtime 1;
BA_ "CANzero_SDO_AccessIfOperational" SG_ 1480 MLU_4_OD_runtime 1;
BA_ "CANzero_SDO_AccessType" SG_ 1480 MLU_4_OD_InputVoltage 1;
BA_ "CANzero_SDO_AccessIfOperational" SG_ 1480 MLU_4_OD_InputVoltage 1;
BA_ "CANzero_SDO_AccessType" SG_ 1480 MLU_4_OD_BoardTemp 1;
BA_ "CANzero_SDO_AccessIfOperational" SG_ 1480 MLU_4_OD_BoardTemp 1;
BA_ "GenSigStartValue" SG_ 1480 MLU_4_OD_BoardTemp 3000.0;
BA_ "CANzero_SDO_AccessType" SG_ 1480 MLU_4_OD_MemFree 1;
BA_ "CANzero_SDO_AccessIfOperational" SG_ 1480 MLU_4_OD_MemFree 1;
BA_ "CANzero_SDO_AccessType" SG_ 1480 MLU_4_OD_CpuUsage 1;
BA_ "CANzero_SDO_AccessIfOperational" SG_ 1480 MLU_4_OD_CpuUsage 1;
BA_ "CANzero_SDO_AccessIfOperational" SG_ 1480 MLU_4_OD_OdEntrySendInterval 1;
BA_ "GenSigStartValue" SG_ 1480 MLU_4_OD_OdEntrySendInterval 50.0;
BA_ "CANzero_SDO_Default" SG_ 1480 MLU_4_OD_OdEntrySendInterval 50;
BA_ "CANzero_SDO_AccessIfOperational" SG_ 1480 MLU_4_OD_SendOdOnBootup 1;
BA_ "CANzero_SDO_AccessIfOperational" SG_ 1480 MLU_4_OD_HeartbeatInterval 1;
BA_ "GenSigStartValue" SG_ 1480 MLU_4_OD_HeartbeatInterval 250.0;
BA_ "CANzero_SDO_Default" SG_ 1480 MLU_4_OD_HeartbeatInterval 250;
BA_ "CANzero_SDO_AccessType" SG_ 1480 MLU_4_OD_DbcVersion 1;
BA_ "CANzero_SDO_AccessIfOperational" SG_ 1480 MLU_4_OD_DbcVersion 1;
BA_ "CANzero_SDO_AccessType" SG_ 1480 MLU_4_OD_StackVersion 1;
BA_ "CANzero_SDO_AccessIfOperational" SG_ 1480 MLU_4_OD_StackVersion 1;
BA_ "CANzero_SDO_AccessType" SG_ 1480 MLU_4_OD_ProtocolVersion 1;
BA_ "CANzero_SDO_AccessIfOperational" SG_ 1480 MLU_4_OD_ProtocolVersion 1;
BA_ "GenSigStartValue" SG_ 1480 MLU_4_OD_ProtocolVersion 1.0;
BA_ "CANzero_SDO_Default" SG_ 1480 MLU_4_OD_ProtocolVersion 1;
BA_ "CANzero_SDO_AccessType" SG_ 1480 MLU_4_OD_NodeStatus 1;
BA_ "CANzero_SDO_AccessIfOperational" SG_ 1480 MLU_4_OD_NodeStatus 1;
BA_ "CANzero_SDO_AccessType" SG_ 1480 MLU_4_OD_NodeID 1;
BA_ "CANzero_SDO_AccessIfOperational" SG_ 1480 MLU_4_OD_NodeID 1;
BA_ "CANzero_SDO_Group" SG_ 1417 MLU_5_OD_CAN2_DelayedTxMessages "CAN";
BA_ "CANzero_SDO_AccessType" SG_ 1417 MLU_5_OD_CAN2_DelayedTxMessages 1;
BA_ "CANzero_SDO_AccessIfOperational" SG_ 1417 MLU_5_OD_CAN2_DelayedTxMessages 1;
BA_ "CANzero_SDO_Group" SG_ 1417 MLU_5_OD_CAN2_ErrorStatus "CAN";
BA_ "CANzero_SDO_AccessType" SG_ 1417 MLU_5_OD_CAN2_ErrorStatus 1;
BA_ "CANzero_SDO_AccessIfOperational" SG_ 1417 MLU_5_OD_CAN2_ErrorStatus 1;
BA_ "CANzero_SDO_Group" SG_ 1417 MLU_5_OD_CAN2_DiscardedTxMessage "CAN";
BA_ "CANzero_SDO_AccessType" SG_ 1417 MLU_5_OD_CAN2_DiscardedTxMessage 1;
BA_ "CANzero_SDO_AccessIfOperational" SG_ 1417 MLU_5_OD_CAN2_DiscardedTxMessage 1;
BA_ "SystemSignalLongSymbol" SG_ 1417 MLU_5_OD_CAN2_DiscardedTxMessage "MLU_5_OD_CAN2_DiscardedTxMessages";
BA_ "CANzero_SDO_Group" SG_ 1417 MLU_5_OD_CAN2_Status "CAN";
BA_ "CANzero_SDO_AccessType" SG_ 1417 MLU_5_OD_CAN2_Status 1;
BA_ "CANzero_SDO_AccessIfOperational" SG_ 1417 MLU_5_OD_CAN2_Status 1;
BA_ "CANzero_SDO_Group" SG_ 1417 MLU_5_OD_CAN2_Baudrate "CAN";
BA_ "CANzero_SDO_AccessIfOperational" SG_ 1417 MLU_5_OD_CAN2_Baudrate 1;
BA_ "GenSigStartValue" SG_ 1417 MLU_5_OD_CAN2_Baudrate 1000.0;
BA_ "CANzero_SDO_Default" SG_ 1417 MLU_5_OD_CAN2_Baudrate 1000;
BA_ "CANzero_SDO_Group" SG_ 1417 MLU_5_OD_CAN2_autoErrorReset "CAN";
BA_ "CANzero_SDO_AccessIfOperational" SG_ 1417 MLU_5_OD_CAN2_autoErrorReset 1;
BA_ "GenSigStartValue" SG_ 1417 MLU_5_OD_CAN2_autoErrorReset 1.0;
BA_ "CANzero_SDO_Default" SG_ 1417 MLU_5_OD_CAN2_autoErrorReset 1;
BA_ "CANzero_SDO_Group" SG_ 1417 MLU_5_OD_CAN2_lastErrorCode "CAN";
BA_ "CANzero_SDO_AccessType" SG_ 1417 MLU_5_OD_CAN2_lastErrorCode 1;
BA_ "CANzero_SDO_AccessIfOperational" SG_ 1417 MLU_5_OD_CAN2_lastErrorCode 1;
BA_ "CANzero_SDO_Group" SG_ 1417 MLU_5_OD_CAN2_RxErrCnt "CAN";
BA_ "CANzero_SDO_AccessType" SG_ 1417 MLU_5_OD_CAN2_RxErrCnt 1;
BA_ "CANzero_SDO_AccessIfOperational" SG_ 1417 MLU_5_OD_CAN2_RxErrCnt 1;
BA_ "CANzero_SDO_Group" SG_ 1417 MLU_5_OD_CAN2_TxErrCnt "CAN";
BA_ "CANzero_SDO_AccessType" SG_ 1417 MLU_5_OD_CAN2_TxErrCnt 1;
BA_ "CANzero_SDO_AccessIfOperational" SG_ 1417 MLU_5_OD_CAN2_TxErrCnt 1;
BA_ "CANzero_SDO_Group" SG_ 1417 MLU_5_OD_CAN1_DelayedTxMessages "CAN";
BA_ "CANzero_SDO_AccessType" SG_ 1417 MLU_5_OD_CAN1_DelayedTxMessages 1;
BA_ "CANzero_SDO_AccessIfOperational" SG_ 1417 MLU_5_OD_CAN1_DelayedTxMessages 1;
BA_ "CANzero_SDO_Group" SG_ 1417 MLU_5_OD_CAN1_ErrorStatus "CAN";
BA_ "CANzero_SDO_AccessType" SG_ 1417 MLU_5_OD_CAN1_ErrorStatus 1;
BA_ "CANzero_SDO_AccessIfOperational" SG_ 1417 MLU_5_OD_CAN1_ErrorStatus 1;
BA_ "CANzero_SDO_Group" SG_ 1417 MLU_5_OD_CAN1_DiscardedTxMessage "CAN";
BA_ "CANzero_SDO_AccessType" SG_ 1417 MLU_5_OD_CAN1_DiscardedTxMessage 1;
BA_ "CANzero_SDO_AccessIfOperational" SG_ 1417 MLU_5_OD_CAN1_DiscardedTxMessage 1;
BA_ "SystemSignalLongSymbol" SG_ 1417 MLU_5_OD_CAN1_DiscardedTxMessage "MLU_5_OD_CAN1_DiscardedTxMessages";
BA_ "CANzero_SDO_Group" SG_ 1417 MLU_5_OD_CAN1_Status "CAN";
BA_ "CANzero_SDO_AccessType" SG_ 1417 MLU_5_OD_CAN1_Status 1;
BA_ "CANzero_SDO_AccessIfOperational" SG_ 1417 MLU_5_OD_CAN1_Status 1;
BA_ "CANzero_SDO_Group" SG_ 1417 MLU_5_OD_CAN1_Baudrate "CAN";
BA_ "CANzero_SDO_AccessIfOperational" SG_ 1417 MLU_5_OD_CAN1_Baudrate 1;
BA_ "GenSigStartValue" SG_ 1417 MLU_5_OD_CAN1_Baudrate 1000.0;
BA_ "CANzero_SDO_Default" SG_ 1417 MLU_5_OD_CAN1_Baudrate 1000;
BA_ "CANzero_SDO_Group" SG_ 1417 MLU_5_OD_CAN1_autoErrorReset "CAN";
BA_ "CANzero_SDO_AccessIfOperational" SG_ 1417 MLU_5_OD_CAN1_autoErrorReset 1;
BA_ "GenSigStartValue" SG_ 1417 MLU_5_OD_CAN1_autoErrorReset 1.0;
BA_ "CANzero_SDO_Default" SG_ 1417 MLU_5_OD_CAN1_autoErrorReset 1;
BA_ "CANzero_SDO_Group" SG_ 1417 MLU_5_OD_CAN1_lastErrorCode "CAN";
BA_ "CANzero_SDO_AccessType" SG_ 1417 MLU_5_OD_CAN1_lastErrorCode 1;
BA_ "CANzero_SDO_AccessIfOperational" SG_ 1417 MLU_5_OD_CAN1_lastErrorCode 1;
BA_ "CANzero_SDO_Group" SG_ 1417 MLU_5_OD_CAN1_RxErrCnt "CAN";
BA_ "CANzero_SDO_AccessType" SG_ 1417 MLU_5_OD_CAN1_RxErrCnt 1;
BA_ "CANzero_SDO_AccessIfOperational" SG_ 1417 MLU_5_OD_CAN1_RxErrCnt 1;
BA_ "CANzero_SDO_Group" SG_ 1417 MLU_5_OD_CAN1_TxErrCnt "CAN";
BA_ "CANzero_SDO_AccessType" SG_ 1417 MLU_5_OD_CAN1_TxErrCnt 1;
BA_ "CANzero_SDO_AccessIfOperational" SG_ 1417 MLU_5_OD_CAN1_TxErrCnt 1;
BA_ "CANzero_SDO_AccessType" SG_ 1417 MLU_5_OD_BuildTime 1;
BA_ "CANzero_SDO_AccessIfOperational" SG_ 1417 MLU_5_OD_BuildTime 1;
BA_ "CANzero_SDO_AccessType" SG_ 1417 MLU_5_OD_BuildDate 1;
BA_ "CANzero_SDO_AccessIfOperational" SG_ 1417 MLU_5_OD_BuildDate 1;
BA_ "CANzero_SDO_AccessType" SG_ 1417 MLU_5_OD_ChipUID2 1;
BA_ "CANzero_SDO_AccessIfOperational" SG_ 1417 MLU_5_OD_ChipUID2 1;
BA_ "CANzero_SDO_AccessType" SG_ 1417 MLU_5_OD_ChipUID1 1;
BA_ "CANzero_SDO_AccessIfOperational" SG_ 1417 MLU_5_OD_ChipUID1 1;
BA_ "CANzero_SDO_AccessType" SG_ 1417 MLU_5_OD_SdcOut 1;
BA_ "CANzero_SDO_AccessIfOperational" SG_ 1417 MLU_5_OD_SdcOut 1;
BA_ "CANzero_SDO_AccessType" SG_ 1417 MLU_5_OD_SdcIn 1;
BA_ "CANzero_SDO_AccessIfOperational" SG_ 1417 MLU_5_OD_SdcIn 1;
BA_ "CANzero_SDO_AccessType" SG_ 1417 MLU_5_OD_runtime 1;
BA_ "CANzero_SDO_AccessIfOperational" SG_ 1417 MLU_5_OD_runtime 1;
BA_ "CANzero_SDO_AccessType" SG_ 1417 MLU_5_OD_InputVoltage 1;
BA_ "CANzero_SDO_AccessIfOperational" SG_ 1417 MLU_5_OD_InputVoltage 1;
BA_ "CANzero_SDO_AccessType" SG_ 1417 MLU_5_OD_BoardTemp 1;
BA_ "CANzero_SDO_AccessIfOperational" SG_ 1417 MLU_5_OD_BoardTemp 1;
BA_ "GenSigStartValue" SG_ 1417 MLU_5_OD_BoardTemp 3000.0;
BA_ "CANzero_SDO_AccessType" SG_ 1417 MLU_5_OD_MemFree 1;
BA_ "CANzero_SDO_AccessIfOperational" SG_ 1417 MLU_5_OD_MemFree 1;
BA_ "CANzero_SDO_AccessType" SG_ 1417 MLU_5_OD_CpuUsage 1;
BA_ "CANzero_SDO_AccessIfOperational" SG_ 1417 MLU_5_OD_CpuUsage 1;
BA_ "CANzero_SDO_AccessIfOperational" SG_ 1417 MLU_5_OD_OdEntrySendInterval 1;
BA_ "GenSigStartValue" SG_ 1417 MLU_5_OD_OdEntrySendInterval 50.0;
BA_ "CANzero_SDO_Default" SG_ 1417 MLU_5_OD_OdEntrySendInterval 50;
BA_ "CANzero_SDO_AccessIfOperational" SG_ 1417 MLU_5_OD_SendOdOnBootup 1;
BA_ "CANzero_SDO_AccessIfOperational" SG_ 1417 MLU_5_OD_HeartbeatInterval 1;
BA_ "GenSigStartValue" SG_ 1417 MLU_5_OD_HeartbeatInterval 250.0;
BA_ "CANzero_SDO_Default" SG_ 1417 MLU_5_OD_HeartbeatInterval 250;
BA_ "CANzero_SDO_AccessType" SG_ 1417 MLU_5_OD_DbcVersion 1;
BA_ "CANzero_SDO_AccessIfOperational" SG_ 1417 MLU_5_OD_DbcVersion 1;
BA_ "CANzero_SDO_AccessType" SG_ 1417 MLU_5_OD_StackVersion 1;
BA_ "CANzero_SDO_AccessIfOperational" SG_ 1417 MLU_5_OD_StackVersion 1;
BA_ "CANzero_SDO_AccessType" SG_ 1417 MLU_5_OD_ProtocolVersion 1;
BA_ "CANzero_SDO_AccessIfOperational" SG_ 1417 MLU_5_OD_ProtocolVersion 1;
BA_ "GenSigStartValue" SG_ 1417 MLU_5_OD_ProtocolVersion 1.0;
BA_ "CANzero_SDO_Default" SG_ 1417 MLU_5_OD_ProtocolVersion 1;
BA_ "CANzero_SDO_AccessType" SG_ 1417 MLU_5_OD_NodeStatus 1;
BA_ "CANzero_SDO_AccessIfOperational" SG_ 1417 MLU_5_OD_NodeStatus 1;
BA_ "CANzero_SDO_AccessType" SG_ 1417 MLU_5_OD_NodeID 1;
BA_ "CANzero_SDO_AccessIfOperational" SG_ 1417 MLU_5_OD_NodeID 1;
BA_ "CANzero_SDO_Group" SG_ 1481 MLU_5_OD_CAN2_DelayedTxMessages "CAN";
BA_ "CANzero_SDO_AccessType" SG_ 1481 MLU_5_OD_CAN2_DelayedTxMessages 1;
BA_ "CANzero_SDO_AccessIfOperational" SG_ 1481 MLU_5_OD_CAN2_DelayedTxMessages 1;
BA_ "CANzero_SDO_Group" SG_ 1481 MLU_5_OD_CAN2_ErrorStatus "CAN";
BA_ "CANzero_SDO_AccessType" SG_ 1481 MLU_5_OD_CAN2_ErrorStatus 1;
BA_ "CANzero_SDO_AccessIfOperational" SG_ 1481 MLU_5_OD_CAN2_ErrorStatus 1;
BA_ "CANzero_SDO_Group" SG_ 1481 MLU_5_OD_CAN2_DiscardedTxMe_0000 "CAN";
BA_ "CANzero_SDO_AccessType" SG_ 1481 MLU_5_OD_CAN2_DiscardedTxMe_0000 1;
BA_ "CANzero_SDO_AccessIfOperational" SG_ 1481 MLU_5_OD_CAN2_DiscardedTxMe_0000 1;
BA_ "SystemSignalLongSymbol" SG_ 1481 MLU_5_OD_CAN2_DiscardedTxMe_0000 "MLU_5_OD_CAN2_DiscardedTxMessages";
BA_ "CANzero_SDO_Group" SG_ 1481 MLU_5_OD_CAN2_Status "CAN";
BA_ "CANzero_SDO_AccessType" SG_ 1481 MLU_5_OD_CAN2_Status 1;
BA_ "CANzero_SDO_AccessIfOperational" SG_ 1481 MLU_5_OD_CAN2_Status 1;
BA_ "CANzero_SDO_Group" SG_ 1481 MLU_5_OD_CAN2_Baudrate "CAN";
BA_ "CANzero_SDO_AccessIfOperational" SG_ 1481 MLU_5_OD_CAN2_Baudrate 1;
BA_ "GenSigStartValue" SG_ 1481 MLU_5_OD_CAN2_Baudrate 1000.0;
BA_ "CANzero_SDO_Default" SG_ 1481 MLU_5_OD_CAN2_Baudrate 1000;
BA_ "CANzero_SDO_Group" SG_ 1481 MLU_5_OD_CAN2_autoErrorReset "CAN";
BA_ "CANzero_SDO_AccessIfOperational" SG_ 1481 MLU_5_OD_CAN2_autoErrorReset 1;
BA_ "GenSigStartValue" SG_ 1481 MLU_5_OD_CAN2_autoErrorReset 1.0;
BA_ "CANzero_SDO_Default" SG_ 1481 MLU_5_OD_CAN2_autoErrorReset 1;
BA_ "CANzero_SDO_Group" SG_ 1481 MLU_5_OD_CAN2_lastErrorCode "CAN";
BA_ "CANzero_SDO_AccessType" SG_ 1481 MLU_5_OD_CAN2_lastErrorCode 1;
BA_ "CANzero_SDO_AccessIfOperational" SG_ 1481 MLU_5_OD_CAN2_lastErrorCode 1;
BA_ "CANzero_SDO_Group" SG_ 1481 MLU_5_OD_CAN2_RxErrCnt "CAN";
BA_ "CANzero_SDO_AccessType" SG_ 1481 MLU_5_OD_CAN2_RxErrCnt 1;
BA_ "CANzero_SDO_AccessIfOperational" SG_ 1481 MLU_5_OD_CAN2_RxErrCnt 1;
BA_ "CANzero_SDO_Group" SG_ 1481 MLU_5_OD_CAN2_TxErrCnt "CAN";
BA_ "CANzero_SDO_AccessType" SG_ 1481 MLU_5_OD_CAN2_TxErrCnt 1;
BA_ "CANzero_SDO_AccessIfOperational" SG_ 1481 MLU_5_OD_CAN2_TxErrCnt 1;
BA_ "CANzero_SDO_Group" SG_ 1481 MLU_5_OD_CAN1_DelayedTxMessages "CAN";
BA_ "CANzero_SDO_AccessType" SG_ 1481 MLU_5_OD_CAN1_DelayedTxMessages 1;
BA_ "CANzero_SDO_AccessIfOperational" SG_ 1481 MLU_5_OD_CAN1_DelayedTxMessages 1;
BA_ "CANzero_SDO_Group" SG_ 1481 MLU_5_OD_CAN1_ErrorStatus "CAN";
BA_ "CANzero_SDO_AccessType" SG_ 1481 MLU_5_OD_CAN1_ErrorStatus 1;
BA_ "CANzero_SDO_AccessIfOperational" SG_ 1481 MLU_5_OD_CAN1_ErrorStatus 1;
BA_ "CANzero_SDO_Group" SG_ 1481 MLU_5_OD_CAN1_DiscardedTxMe_0000 "CAN";
BA_ "CANzero_SDO_AccessType" SG_ 1481 MLU_5_OD_CAN1_DiscardedTxMe_0000 1;
BA_ "CANzero_SDO_AccessIfOperational" SG_ 1481 MLU_5_OD_CAN1_DiscardedTxMe_0000 1;
BA_ "SystemSignalLongSymbol" SG_ 1481 MLU_5_OD_CAN1_DiscardedTxMe_0000 "MLU_5_OD_CAN1_DiscardedTxMessages";
BA_ "CANzero_SDO_Group" SG_ 1481 MLU_5_OD_CAN1_Status "CAN";
BA_ "CANzero_SDO_AccessType" SG_ 1481 MLU_5_OD_CAN1_Status 1;
BA_ "CANzero_SDO_AccessIfOperational" SG_ 1481 MLU_5_OD_CAN1_Status 1;
BA_ "CANzero_SDO_Group" SG_ 1481 MLU_5_OD_CAN1_Baudrate "CAN";
BA_ "CANzero_SDO_AccessIfOperational" SG_ 1481 MLU_5_OD_CAN1_Baudrate 1;
BA_ "GenSigStartValue" SG_ 1481 MLU_5_OD_CAN1_Baudrate 1000.0;
BA_ "CANzero_SDO_Default" SG_ 1481 MLU_5_OD_CAN1_Baudrate 1000;
BA_ "CANzero_SDO_Group" SG_ 1481 MLU_5_OD_CAN1_autoErrorReset "CAN";
BA_ "CANzero_SDO_AccessIfOperational" SG_ 1481 MLU_5_OD_CAN1_autoErrorReset 1;
BA_ "GenSigStartValue" SG_ 1481 MLU_5_OD_CAN1_autoErrorReset 1.0;
BA_ "CANzero_SDO_Default" SG_ 1481 MLU_5_OD_CAN1_autoErrorReset 1;
BA_ "CANzero_SDO_Group" SG_ 1481 MLU_5_OD_CAN1_lastErrorCode "CAN";
BA_ "CANzero_SDO_AccessType" SG_ 1481 MLU_5_OD_CAN1_lastErrorCode 1;
BA_ "CANzero_SDO_AccessIfOperational" SG_ 1481 MLU_5_OD_CAN1_lastErrorCode 1;
BA_ "CANzero_SDO_Group" SG_ 1481 MLU_5_OD_CAN1_RxErrCnt "CAN";
BA_ "CANzero_SDO_AccessType" SG_ 1481 MLU_5_OD_CAN1_RxErrCnt 1;
BA_ "CANzero_SDO_AccessIfOperational" SG_ 1481 MLU_5_OD_CAN1_RxErrCnt 1;
BA_ "CANzero_SDO_Group" SG_ 1481 MLU_5_OD_CAN1_TxErrCnt "CAN";
BA_ "CANzero_SDO_AccessType" SG_ 1481 MLU_5_OD_CAN1_TxErrCnt 1;
BA_ "CANzero_SDO_AccessIfOperational" SG_ 1481 MLU_5_OD_CAN1_TxErrCnt 1;
BA_ "CANzero_SDO_AccessType" SG_ 1481 MLU_5_OD_BuildTime 1;
BA_ "CANzero_SDO_AccessIfOperational" SG_ 1481 MLU_5_OD_BuildTime 1;
BA_ "CANzero_SDO_AccessType" SG_ 1481 MLU_5_OD_BuildDate 1;
BA_ "CANzero_SDO_AccessIfOperational" SG_ 1481 MLU_5_OD_BuildDate 1;
BA_ "CANzero_SDO_AccessType" SG_ 1481 MLU_5_OD_ChipUID2 1;
BA_ "CANzero_SDO_AccessIfOperational" SG_ 1481 MLU_5_OD_ChipUID2 1;
BA_ "CANzero_SDO_AccessType" SG_ 1481 MLU_5_OD_ChipUID1 1;
BA_ "CANzero_SDO_AccessIfOperational" SG_ 1481 MLU_5_OD_ChipUID1 1;
BA_ "CANzero_SDO_AccessType" SG_ 1481 MLU_5_OD_SdcOut 1;
BA_ "CANzero_SDO_AccessIfOperational" SG_ 1481 MLU_5_OD_SdcOut 1;
BA_ "CANzero_SDO_AccessType" SG_ 1481 MLU_5_OD_SdcIn 1;
BA_ "CANzero_SDO_AccessIfOperational" SG_ 1481 MLU_5_OD_SdcIn 1;
BA_ "CANzero_SDO_AccessType" SG_ 1481 MLU_5_OD_runtime 1;
BA_ "CANzero_SDO_AccessIfOperational" SG_ 1481 MLU_5_OD_runtime 1;
BA_ "CANzero_SDO_AccessType" SG_ 1481 MLU_5_OD_InputVoltage 1;
BA_ "CANzero_SDO_AccessIfOperational" SG_ 1481 MLU_5_OD_InputVoltage 1;
BA_ "CANzero_SDO_AccessType" SG_ 1481 MLU_5_OD_BoardTemp 1;
BA_ "CANzero_SDO_AccessIfOperational" SG_ 1481 MLU_5_OD_BoardTemp 1;
BA_ "GenSigStartValue" SG_ 1481 MLU_5_OD_BoardTemp 3000.0;
BA_ "CANzero_SDO_AccessType" SG_ 1481 MLU_5_OD_MemFree 1;
BA_ "CANzero_SDO_AccessIfOperational" SG_ 1481 MLU_5_OD_MemFree 1;
BA_ "CANzero_SDO_AccessType" SG_ 1481 MLU_5_OD_CpuUsage 1;
BA_ "CANzero_SDO_AccessIfOperational" SG_ 1481 MLU_5_OD_CpuUsage 1;
BA_ "CANzero_SDO_AccessIfOperational" SG_ 1481 MLU_5_OD_OdEntrySendInterval 1;
BA_ "GenSigStartValue" SG_ 1481 MLU_5_OD_OdEntrySendInterval 50.0;
BA_ "CANzero_SDO_Default" SG_ 1481 MLU_5_OD_OdEntrySendInterval 50;
BA_ "CANzero_SDO_AccessIfOperational" SG_ 1481 MLU_5_OD_SendOdOnBootup 1;
BA_ "CANzero_SDO_AccessIfOperational" SG_ 1481 MLU_5_OD_HeartbeatInterval 1;
BA_ "GenSigStartValue" SG_ 1481 MLU_5_OD_HeartbeatInterval 250.0;
BA_ "CANzero_SDO_Default" SG_ 1481 MLU_5_OD_HeartbeatInterval 250;
BA_ "CANzero_SDO_AccessType" SG_ 1481 MLU_5_OD_DbcVersion 1;
BA_ "CANzero_SDO_AccessIfOperational" SG_ 1481 MLU_5_OD_DbcVersion 1;
BA_ "CANzero_SDO_AccessType" SG_ 1481 MLU_5_OD_StackVersion 1;
BA_ "CANzero_SDO_AccessIfOperational" SG_ 1481 MLU_5_OD_StackVersion 1;
BA_ "CANzero_SDO_AccessType" SG_ 1481 MLU_5_OD_ProtocolVersion 1;
BA_ "CANzero_SDO_AccessIfOperational" SG_ 1481 MLU_5_OD_ProtocolVersion 1;
BA_ "GenSigStartValue" SG_ 1481 MLU_5_OD_ProtocolVersion 1.0;
BA_ "CANzero_SDO_Default" SG_ 1481 MLU_5_OD_ProtocolVersion 1;
BA_ "CANzero_SDO_AccessType" SG_ 1481 MLU_5_OD_NodeStatus 1;
BA_ "CANzero_SDO_AccessIfOperational" SG_ 1481 MLU_5_OD_NodeStatus 1;
BA_ "CANzero_SDO_AccessType" SG_ 1481 MLU_5_OD_NodeID 1;
BA_ "CANzero_SDO_AccessIfOperational" SG_ 1481 MLU_5_OD_NodeID 1;
BA_ "CANzero_SDO_Group" SG_ 1424 MLU_6_OD_CAN2_DelayedTxMessages "CAN";
BA_ "CANzero_SDO_AccessType" SG_ 1424 MLU_6_OD_CAN2_DelayedTxMessages 1;
BA_ "CANzero_SDO_AccessIfOperational" SG_ 1424 MLU_6_OD_CAN2_DelayedTxMessages 1;
BA_ "CANzero_SDO_Group" SG_ 1424 MLU_6_OD_CAN2_ErrorStatus "CAN";
BA_ "CANzero_SDO_AccessType" SG_ 1424 MLU_6_OD_CAN2_ErrorStatus 1;
BA_ "CANzero_SDO_AccessIfOperational" SG_ 1424 MLU_6_OD_CAN2_ErrorStatus 1;
BA_ "CANzero_SDO_Group" SG_ 1424 MLU_6_OD_CAN2_DiscardedTxMessage "CAN";
BA_ "CANzero_SDO_AccessType" SG_ 1424 MLU_6_OD_CAN2_DiscardedTxMessage 1;
BA_ "CANzero_SDO_AccessIfOperational" SG_ 1424 MLU_6_OD_CAN2_DiscardedTxMessage 1;
BA_ "SystemSignalLongSymbol" SG_ 1424 MLU_6_OD_CAN2_DiscardedTxMessage "MLU_6_OD_CAN2_DiscardedTxMessages";
BA_ "CANzero_SDO_Group" SG_ 1424 MLU_6_OD_CAN2_Status "CAN";
BA_ "CANzero_SDO_AccessType" SG_ 1424 MLU_6_OD_CAN2_Status 1;
BA_ "CANzero_SDO_AccessIfOperational" SG_ 1424 MLU_6_OD_CAN2_Status 1;
BA_ "CANzero_SDO_Group" SG_ 1424 MLU_6_OD_CAN2_Baudrate "CAN";
BA_ "CANzero_SDO_AccessIfOperational" SG_ 1424 MLU_6_OD_CAN2_Baudrate 1;
BA_ "GenSigStartValue" SG_ 1424 MLU_6_OD_CAN2_Baudrate 1000.0;
BA_ "CANzero_SDO_Default" SG_ 1424 MLU_6_OD_CAN2_Baudrate 1000;
BA_ "CANzero_SDO_Group" SG_ 1424 MLU_6_OD_CAN2_autoErrorReset "CAN";
BA_ "CANzero_SDO_AccessIfOperational" SG_ 1424 MLU_6_OD_CAN2_autoErrorReset 1;
BA_ "GenSigStartValue" SG_ 1424 MLU_6_OD_CAN2_autoErrorReset 1.0;
BA_ "CANzero_SDO_Default" SG_ 1424 MLU_6_OD_CAN2_autoErrorReset 1;
BA_ "CANzero_SDO_Group" SG_ 1424 MLU_6_OD_CAN2_lastErrorCode "CAN";
BA_ "CANzero_SDO_AccessType" SG_ 1424 MLU_6_OD_CAN2_lastErrorCode 1;
BA_ "CANzero_SDO_AccessIfOperational" SG_ 1424 MLU_6_OD_CAN2_lastErrorCode 1;
BA_ "CANzero_SDO_Group" SG_ 1424 MLU_6_OD_CAN2_RxErrCnt "CAN";
BA_ "CANzero_SDO_AccessType" SG_ 1424 MLU_6_OD_CAN2_RxErrCnt 1;
BA_ "CANzero_SDO_AccessIfOperational" SG_ 1424 MLU_6_OD_CAN2_RxErrCnt 1;
BA_ "CANzero_SDO_Group" SG_ 1424 MLU_6_OD_CAN2_TxErrCnt "CAN";
BA_ "CANzero_SDO_AccessType" SG_ 1424 MLU_6_OD_CAN2_TxErrCnt 1;
BA_ "CANzero_SDO_AccessIfOperational" SG_ 1424 MLU_6_OD_CAN2_TxErrCnt 1;
BA_ "CANzero_SDO_Group" SG_ 1424 MLU_6_OD_CAN1_DelayedTxMessages "CAN";
BA_ "CANzero_SDO_AccessType" SG_ 1424 MLU_6_OD_CAN1_DelayedTxMessages 1;
BA_ "CANzero_SDO_AccessIfOperational" SG_ 1424 MLU_6_OD_CAN1_DelayedTxMessages 1;
BA_ "CANzero_SDO_Group" SG_ 1424 MLU_6_OD_CAN1_ErrorStatus "CAN";
BA_ "CANzero_SDO_AccessType" SG_ 1424 MLU_6_OD_CAN1_ErrorStatus 1;
BA_ "CANzero_SDO_AccessIfOperational" SG_ 1424 MLU_6_OD_CAN1_ErrorStatus 1;
BA_ "CANzero_SDO_Group" SG_ 1424 MLU_6_OD_CAN1_DiscardedTxMessage "CAN";
BA_ "CANzero_SDO_AccessType" SG_ 1424 MLU_6_OD_CAN1_DiscardedTxMessage 1;
BA_ "CANzero_SDO_AccessIfOperational" SG_ 1424 MLU_6_OD_CAN1_DiscardedTxMessage 1;
BA_ "SystemSignalLongSymbol" SG_ 1424 MLU_6_OD_CAN1_DiscardedTxMessage "MLU_6_OD_CAN1_DiscardedTxMessages";
BA_ "CANzero_SDO_Group" SG_ 1424 MLU_6_OD_CAN1_Status "CAN";
BA_ "CANzero_SDO_AccessType" SG_ 1424 MLU_6_OD_CAN1_Status 1;
BA_ "CANzero_SDO_AccessIfOperational" SG_ 1424 MLU_6_OD_CAN1_Status 1;
BA_ "CANzero_SDO_Group" SG_ 1424 MLU_6_OD_CAN1_Baudrate "CAN";
BA_ "CANzero_SDO_AccessIfOperational" SG_ 1424 MLU_6_OD_CAN1_Baudrate 1;
BA_ "GenSigStartValue" SG_ 1424 MLU_6_OD_CAN1_Baudrate 1000.0;
BA_ "CANzero_SDO_Default" SG_ 1424 MLU_6_OD_CAN1_Baudrate 1000;
BA_ "CANzero_SDO_Group" SG_ 1424 MLU_6_OD_CAN1_autoErrorReset "CAN";
BA_ "CANzero_SDO_AccessIfOperational" SG_ 1424 MLU_6_OD_CAN1_autoErrorReset 1;
BA_ "GenSigStartValue" SG_ 1424 MLU_6_OD_CAN1_autoErrorReset 1.0;
BA_ "CANzero_SDO_Default" SG_ 1424 MLU_6_OD_CAN1_autoErrorReset 1;
BA_ "CANzero_SDO_Group" SG_ 1424 MLU_6_OD_CAN1_lastErrorCode "CAN";
BA_ "CANzero_SDO_AccessType" SG_ 1424 MLU_6_OD_CAN1_lastErrorCode 1;
BA_ "CANzero_SDO_AccessIfOperational" SG_ 1424 MLU_6_OD_CAN1_lastErrorCode 1;
BA_ "CANzero_SDO_Group" SG_ 1424 MLU_6_OD_CAN1_RxErrCnt "CAN";
BA_ "CANzero_SDO_AccessType" SG_ 1424 MLU_6_OD_CAN1_RxErrCnt 1;
BA_ "CANzero_SDO_AccessIfOperational" SG_ 1424 MLU_6_OD_CAN1_RxErrCnt 1;
BA_ "CANzero_SDO_Group" SG_ 1424 MLU_6_OD_CAN1_TxErrCnt "CAN";
BA_ "CANzero_SDO_AccessType" SG_ 1424 MLU_6_OD_CAN1_TxErrCnt 1;
BA_ "CANzero_SDO_AccessIfOperational" SG_ 1424 MLU_6_OD_CAN1_TxErrCnt 1;
BA_ "CANzero_SDO_AccessType" SG_ 1424 MLU_6_OD_BuildTime 1;
BA_ "CANzero_SDO_AccessIfOperational" SG_ 1424 MLU_6_OD_BuildTime 1;
BA_ "CANzero_SDO_AccessType" SG_ 1424 MLU_6_OD_BuildDate 1;
BA_ "CANzero_SDO_AccessIfOperational" SG_ 1424 MLU_6_OD_BuildDate 1;
BA_ "CANzero_SDO_AccessType" SG_ 1424 MLU_6_OD_ChipUID2 1;
BA_ "CANzero_SDO_AccessIfOperational" SG_ 1424 MLU_6_OD_ChipUID2 1;
BA_ "CANzero_SDO_AccessType" SG_ 1424 MLU_6_OD_ChipUID1 1;
BA_ "CANzero_SDO_AccessIfOperational" SG_ 1424 MLU_6_OD_ChipUID1 1;
BA_ "CANzero_SDO_AccessType" SG_ 1424 MLU_6_OD_SdcOut 1;
BA_ "CANzero_SDO_AccessIfOperational" SG_ 1424 MLU_6_OD_SdcOut 1;
BA_ "CANzero_SDO_AccessType" SG_ 1424 MLU_6_OD_SdcIn 1;
BA_ "CANzero_SDO_AccessIfOperational" SG_ 1424 MLU_6_OD_SdcIn 1;
BA_ "CANzero_SDO_AccessType" SG_ 1424 MLU_6_OD_runtime 1;
BA_ "CANzero_SDO_AccessIfOperational" SG_ 1424 MLU_6_OD_runtime 1;
BA_ "CANzero_SDO_AccessType" SG_ 1424 MLU_6_OD_InputVoltage 1;
BA_ "CANzero_SDO_AccessIfOperational" SG_ 1424 MLU_6_OD_InputVoltage 1;
BA_ "CANzero_SDO_AccessType" SG_ 1424 MLU_6_OD_BoardTemp 1;
BA_ "CANzero_SDO_AccessIfOperational" SG_ 1424 MLU_6_OD_BoardTemp 1;
BA_ "GenSigStartValue" SG_ 1424 MLU_6_OD_BoardTemp 3000.0;
BA_ "CANzero_SDO_AccessType" SG_ 1424 MLU_6_OD_MemFree 1;
BA_ "CANzero_SDO_AccessIfOperational" SG_ 1424 MLU_6_OD_MemFree 1;
BA_ "CANzero_SDO_AccessType" SG_ 1424 MLU_6_OD_CpuUsage 1;
BA_ "CANzero_SDO_AccessIfOperational" SG_ 1424 MLU_6_OD_CpuUsage 1;
BA_ "CANzero_SDO_AccessIfOperational" SG_ 1424 MLU_6_OD_OdEntrySendInterval 1;
BA_ "GenSigStartValue" SG_ 1424 MLU_6_OD_OdEntrySendInterval 50.0;
BA_ "CANzero_SDO_Default" SG_ 1424 MLU_6_OD_OdEntrySendInterval 50;
BA_ "CANzero_SDO_AccessIfOperational" SG_ 1424 MLU_6_OD_SendOdOnBootup 1;
BA_ "CANzero_SDO_AccessIfOperational" SG_ 1424 MLU_6_OD_HeartbeatInterval 1;
BA_ "GenSigStartValue" SG_ 1424 MLU_6_OD_HeartbeatInterval 250.0;
BA_ "CANzero_SDO_Default" SG_ 1424 MLU_6_OD_HeartbeatInterval 250;
BA_ "CANzero_SDO_AccessType" SG_ 1424 MLU_6_OD_DbcVersion 1;
BA_ "CANzero_SDO_AccessIfOperational" SG_ 1424 MLU_6_OD_DbcVersion 1;
BA_ "CANzero_SDO_AccessType" SG_ 1424 MLU_6_OD_StackVersion 1;
BA_ "CANzero_SDO_AccessIfOperational" SG_ 1424 MLU_6_OD_StackVersion 1;
BA_ "CANzero_SDO_AccessType" SG_ 1424 MLU_6_OD_ProtocolVersion 1;
BA_ "CANzero_SDO_AccessIfOperational" SG_ 1424 MLU_6_OD_ProtocolVersion 1;
BA_ "GenSigStartValue" SG_ 1424 MLU_6_OD_ProtocolVersion 1.0;
BA_ "CANzero_SDO_Default" SG_ 1424 MLU_6_OD_ProtocolVersion 1;
BA_ "CANzero_SDO_AccessType" SG_ 1424 MLU_6_OD_NodeStatus 1;
BA_ "CANzero_SDO_AccessIfOperational" SG_ 1424 MLU_6_OD_NodeStatus 1;
BA_ "CANzero_SDO_AccessType" SG_ 1424 MLU_6_OD_NodeID 1;
BA_ "CANzero_SDO_AccessIfOperational" SG_ 1424 MLU_6_OD_NodeID 1;
BA_ "CANzero_SDO_Group" SG_ 1488 MLU_6_OD_CAN2_DelayedTxMessages "CAN";
BA_ "CANzero_SDO_AccessType" SG_ 1488 MLU_6_OD_CAN2_DelayedTxMessages 1;
BA_ "CANzero_SDO_AccessIfOperational" SG_ 1488 MLU_6_OD_CAN2_DelayedTxMessages 1;
BA_ "CANzero_SDO_Group" SG_ 1488 MLU_6_OD_CAN2_ErrorStatus "CAN";
BA_ "CANzero_SDO_AccessType" SG_ 1488 MLU_6_OD_CAN2_ErrorStatus 1;
BA_ "CANzero_SDO_AccessIfOperational" SG_ 1488 MLU_6_OD_CAN2_ErrorStatus 1;
BA_ "CANzero_SDO_Group" SG_ 1488 MLU_6_OD_CAN2_DiscardedTxMe_0000 "CAN";
BA_ "CANzero_SDO_AccessType" SG_ 1488 MLU_6_OD_CAN2_DiscardedTxMe_0000 1;
BA_ "CANzero_SDO_AccessIfOperational" SG_ 1488 MLU_6_OD_CAN2_DiscardedTxMe_0000 1;
BA_ "SystemSignalLongSymbol" SG_ 1488 MLU_6_OD_CAN2_DiscardedTxMe_0000 "MLU_6_OD_CAN2_DiscardedTxMessages";
BA_ "CANzero_SDO_Group" SG_ 1488 MLU_6_OD_CAN2_Status "CAN";
BA_ "CANzero_SDO_AccessType" SG_ 1488 MLU_6_OD_CAN2_Status 1;
BA_ "CANzero_SDO_AccessIfOperational" SG_ 1488 MLU_6_OD_CAN2_Status 1;
BA_ "CANzero_SDO_Group" SG_ 1488 MLU_6_OD_CAN2_Baudrate "CAN";
BA_ "CANzero_SDO_AccessIfOperational" SG_ 1488 MLU_6_OD_CAN2_Baudrate 1;
BA_ "GenSigStartValue" SG_ 1488 MLU_6_OD_CAN2_Baudrate 1000.0;
BA_ "CANzero_SDO_Default" SG_ 1488 MLU_6_OD_CAN2_Baudrate 1000;
BA_ "CANzero_SDO_Group" SG_ 1488 MLU_6_OD_CAN2_autoErrorReset "CAN";
BA_ "CANzero_SDO_AccessIfOperational" SG_ 1488 MLU_6_OD_CAN2_autoErrorReset 1;
BA_ "GenSigStartValue" SG_ 1488 MLU_6_OD_CAN2_autoErrorReset 1.0;
BA_ "CANzero_SDO_Default" SG_ 1488 MLU_6_OD_CAN2_autoErrorReset 1;
BA_ "CANzero_SDO_Group" SG_ 1488 MLU_6_OD_CAN2_lastErrorCode "CAN";
BA_ "CANzero_SDO_AccessType" SG_ 1488 MLU_6_OD_CAN2_lastErrorCode 1;
BA_ "CANzero_SDO_AccessIfOperational" SG_ 1488 MLU_6_OD_CAN2_lastErrorCode 1;
BA_ "CANzero_SDO_Group" SG_ 1488 MLU_6_OD_CAN2_RxErrCnt "CAN";
BA_ "CANzero_SDO_AccessType" SG_ 1488 MLU_6_OD_CAN2_RxErrCnt 1;
BA_ "CANzero_SDO_AccessIfOperational" SG_ 1488 MLU_6_OD_CAN2_RxErrCnt 1;
BA_ "CANzero_SDO_Group" SG_ 1488 MLU_6_OD_CAN2_TxErrCnt "CAN";
BA_ "CANzero_SDO_AccessType" SG_ 1488 MLU_6_OD_CAN2_TxErrCnt 1;
BA_ "CANzero_SDO_AccessIfOperational" SG_ 1488 MLU_6_OD_CAN2_TxErrCnt 1;
BA_ "CANzero_SDO_Group" SG_ 1488 MLU_6_OD_CAN1_DelayedTxMessages "CAN";
BA_ "CANzero_SDO_AccessType" SG_ 1488 MLU_6_OD_CAN1_DelayedTxMessages 1;
BA_ "CANzero_SDO_AccessIfOperational" SG_ 1488 MLU_6_OD_CAN1_DelayedTxMessages 1;
BA_ "CANzero_SDO_Group" SG_ 1488 MLU_6_OD_CAN1_ErrorStatus "CAN";
BA_ "CANzero_SDO_AccessType" SG_ 1488 MLU_6_OD_CAN1_ErrorStatus 1;
BA_ "CANzero_SDO_AccessIfOperational" SG_ 1488 MLU_6_OD_CAN1_ErrorStatus 1;
BA_ "CANzero_SDO_Group" SG_ 1488 MLU_6_OD_CAN1_DiscardedTxMe_0000 "CAN";
BA_ "CANzero_SDO_AccessType" SG_ 1488 MLU_6_OD_CAN1_DiscardedTxMe_0000 1;
BA_ "CANzero_SDO_AccessIfOperational" SG_ 1488 MLU_6_OD_CAN1_DiscardedTxMe_0000 1;
BA_ "SystemSignalLongSymbol" SG_ 1488 MLU_6_OD_CAN1_DiscardedTxMe_0000 "MLU_6_OD_CAN1_DiscardedTxMessages";
BA_ "CANzero_SDO_Group" SG_ 1488 MLU_6_OD_CAN1_Status "CAN";
BA_ "CANzero_SDO_AccessType" SG_ 1488 MLU_6_OD_CAN1_Status 1;
BA_ "CANzero_SDO_AccessIfOperational" SG_ 1488 MLU_6_OD_CAN1_Status 1;
BA_ "CANzero_SDO_Group" SG_ 1488 MLU_6_OD_CAN1_Baudrate "CAN";
BA_ "CANzero_SDO_AccessIfOperational" SG_ 1488 MLU_6_OD_CAN1_Baudrate 1;
BA_ "GenSigStartValue" SG_ 1488 MLU_6_OD_CAN1_Baudrate 1000.0;
BA_ "CANzero_SDO_Default" SG_ 1488 MLU_6_OD_CAN1_Baudrate 1000;
BA_ "CANzero_SDO_Group" SG_ 1488 MLU_6_OD_CAN1_autoErrorReset "CAN";
BA_ "CANzero_SDO_AccessIfOperational" SG_ 1488 MLU_6_OD_CAN1_autoErrorReset 1;
BA_ "GenSigStartValue" SG_ 1488 MLU_6_OD_CAN1_autoErrorReset 1.0;
BA_ "CANzero_SDO_Default" SG_ 1488 MLU_6_OD_CAN1_autoErrorReset 1;
BA_ "CANzero_SDO_Group" SG_ 1488 MLU_6_OD_CAN1_lastErrorCode "CAN";
BA_ "CANzero_SDO_AccessType" SG_ 1488 MLU_6_OD_CAN1_lastErrorCode 1;
BA_ "CANzero_SDO_AccessIfOperational" SG_ 1488 MLU_6_OD_CAN1_lastErrorCode 1;
BA_ "CANzero_SDO_Group" SG_ 1488 MLU_6_OD_CAN1_RxErrCnt "CAN";
BA_ "CANzero_SDO_AccessType" SG_ 1488 MLU_6_OD_CAN1_RxErrCnt 1;
BA_ "CANzero_SDO_AccessIfOperational" SG_ 1488 MLU_6_OD_CAN1_RxErrCnt 1;
BA_ "CANzero_SDO_Group" SG_ 1488 MLU_6_OD_CAN1_TxErrCnt "CAN";
BA_ "CANzero_SDO_AccessType" SG_ 1488 MLU_6_OD_CAN1_TxErrCnt 1;
BA_ "CANzero_SDO_AccessIfOperational" SG_ 1488 MLU_6_OD_CAN1_TxErrCnt 1;
BA_ "CANzero_SDO_AccessType" SG_ 1488 MLU_6_OD_BuildTime 1;
BA_ "CANzero_SDO_AccessIfOperational" SG_ 1488 MLU_6_OD_BuildTime 1;
BA_ "CANzero_SDO_AccessType" SG_ 1488 MLU_6_OD_BuildDate 1;
BA_ "CANzero_SDO_AccessIfOperational" SG_ 1488 MLU_6_OD_BuildDate 1;
BA_ "CANzero_SDO_AccessType" SG_ 1488 MLU_6_OD_ChipUID2 1;
BA_ "CANzero_SDO_AccessIfOperational" SG_ 1488 MLU_6_OD_ChipUID2 1;
BA_ "CANzero_SDO_AccessType" SG_ 1488 MLU_6_OD_ChipUID1 1;
BA_ "CANzero_SDO_AccessIfOperational" SG_ 1488 MLU_6_OD_ChipUID1 1;
BA_ "CANzero_SDO_AccessType" SG_ 1488 MLU_6_OD_SdcOut 1;
BA_ "CANzero_SDO_AccessIfOperational" SG_ 1488 MLU_6_OD_SdcOut 1;
BA_ "CANzero_SDO_AccessType" SG_ 1488 MLU_6_OD_SdcIn 1;
BA_ "CANzero_SDO_AccessIfOperational" SG_ 1488 MLU_6_OD_SdcIn 1;
BA_ "CANzero_SDO_AccessType" SG_ 1488 MLU_6_OD_runtime 1;
BA_ "CANzero_SDO_AccessIfOperational" SG_ 1488 MLU_6_OD_runtime 1;
BA_ "CANzero_SDO_AccessType" SG_ 1488 MLU_6_OD_InputVoltage 1;
BA_ "CANzero_SDO_AccessIfOperational" SG_ 1488 MLU_6_OD_InputVoltage 1;
BA_ "CANzero_SDO_AccessType" SG_ 1488 MLU_6_OD_BoardTemp 1;
BA_ "CANzero_SDO_AccessIfOperational" SG_ 1488 MLU_6_OD_BoardTemp 1;
BA_ "GenSigStartValue" SG_ 1488 MLU_6_OD_BoardTemp 3000.0;
BA_ "CANzero_SDO_AccessType" SG_ 1488 MLU_6_OD_MemFree 1;
BA_ "CANzero_SDO_AccessIfOperational" SG_ 1488 MLU_6_OD_MemFree 1;
BA_ "CANzero_SDO_AccessType" SG_ 1488 MLU_6_OD_CpuUsage 1;
BA_ "CANzero_SDO_AccessIfOperational" SG_ 1488 MLU_6_OD_CpuUsage 1;
BA_ "CANzero_SDO_AccessIfOperational" SG_ 1488 MLU_6_OD_OdEntrySendInterval 1;
BA_ "GenSigStartValue" SG_ 1488 MLU_6_OD_OdEntrySendInterval 50.0;
BA_ "CANzero_SDO_Default" SG_ 1488 MLU_6_OD_OdEntrySendInterval 50;
BA_ "CANzero_SDO_AccessIfOperational" SG_ 1488 MLU_6_OD_SendOdOnBootup 1;
BA_ "CANzero_SDO_AccessIfOperational" SG_ 1488 MLU_6_OD_HeartbeatInterval 1;
BA_ "GenSigStartValue" SG_ 1488 MLU_6_OD_HeartbeatInterval 250.0;
BA_ "CANzero_SDO_Default" SG_ 1488 MLU_6_OD_HeartbeatInterval 250;
BA_ "CANzero_SDO_AccessType" SG_ 1488 MLU_6_OD_DbcVersion 1;
BA_ "CANzero_SDO_AccessIfOperational" SG_ 1488 MLU_6_OD_DbcVersion 1;
BA_ "CANzero_SDO_AccessType" SG_ 1488 MLU_6_OD_StackVersion 1;
BA_ "CANzero_SDO_AccessIfOperational" SG_ 1488 MLU_6_OD_StackVersion 1;
BA_ "CANzero_SDO_AccessType" SG_ 1488 MLU_6_OD_ProtocolVersion 1;
BA_ "CANzero_SDO_AccessIfOperational" SG_ 1488 MLU_6_OD_ProtocolVersion 1;
BA_ "GenSigStartValue" SG_ 1488 MLU_6_OD_ProtocolVersion 1.0;
BA_ "CANzero_SDO_Default" SG_ 1488 MLU_6_OD_ProtocolVersion 1;
BA_ "CANzero_SDO_AccessType" SG_ 1488 MLU_6_OD_NodeStatus 1;
BA_ "CANzero_SDO_AccessIfOperational" SG_ 1488 MLU_6_OD_NodeStatus 1;
BA_ "CANzero_SDO_AccessType" SG_ 1488 MLU_6_OD_NodeID 1;
BA_ "CANzero_SDO_AccessIfOperational" SG_ 1488 MLU_6_OD_NodeID 1;
VAL_ 134 MLU_2_E0_OtherError 0 "Ok" 1 "ERR" ;
VAL_ 134 MLU_2_W0_OtherWarning 0 "Ok" 1 "WARN" ;
VAL_ 1414 MLU_2_OD_CAN2_ErrorStatus 0 "Ok" 1 "Warn" 2 "Error Passive" 3 "Bus Off" ;
VAL_ 1414 MLU_2_OD_CAN2_Status 0 "Reset" 1 "Ready" 2 "Listening" 3 "Sleep_Pending" 4 "Sleep_Active" 5 "ERROR" ;
VAL_ 1414 MLU_2_OD_CAN2_autoErrorReset 0 "Disabled" 1 "Enabled" ;
VAL_ 1414 MLU_2_OD_CAN2_lastErrorCode 0 "No Error" 1 "Stuff Error" 2 "Form Error" 3 "Ack Error" 4 "Bit recessive Error" 5 "Bit dominant Error" 6 "CRC Error" ;
VAL_ 1414 MLU_2_OD_CAN1_ErrorStatus 0 "Ok" 1 "Warn" 2 "Error Passive" 3 "Bus Off" ;
VAL_ 1414 MLU_2_OD_CAN1_Status 0 "Reset" 1 "Ready" 2 "Listening" 3 "Sleep_Pending" 4 "Sleep_Active" 5 "ERROR" ;
VAL_ 1414 MLU_2_OD_CAN1_autoErrorReset 0 "Disabled" 1 "Enabled" ;
VAL_ 1414 MLU_2_OD_CAN1_lastErrorCode 0 "No Error" 1 "Stuff Error" 2 "Form Error" 3 "Ack Error" 4 "Bit recessive Error" 5 "Bit dominant Error" 6 "CRC Error" ;
VAL_ 1414 MLU_2_OD_SendOdOnBootup 0 "Disabled" 1 "Enabled" ;
VAL_ 1414 MLU_2_OD_NodeStatus 0 "Bootup" 4 "Stopped" 5 "Operational" 127 "Pre-Operational" 128 "Reset" ;
VAL_ 1414 MLU_2_SDO_RespCode 5 "ERR: Out of range" 4 "ERR: No access in this state" 3 "ERR: Read only object" 2 "ERR: Write only object" 1 "ERR: Non existing object" 0 "OK" ;
VAL_ 1414 MLU_2_SDO_ID 0 "Reserved" 1 "NodeID" 2 "NodeStatus" 3 "ProtocolVersion" 4 "StackVersion" 5 "DbcVersion" 16 "HeartbeatInterval" 32 "SendOdOnBootup" 33 "OdEntrySendInterval" 1040 "CpuUsage" 1041 "MemFree" 1042 "BoardTemp" 1043 "InputVoltage" 1044 "runtime" 1045 "SdcIn" 1046 "SdcOut" 1056 "ChipUID1" 1057 "ChipUID2" 1072 "BuildDate" 1073 "BuildTime" 1104 "CAN1_TxErrCnt" 1105 "CAN1_RxErrCnt" 1106 "CAN1_lastErrorCode" 1107 "CAN1_autoErrorReset" 1108 "CAN1_Baudrate" 1110 "CAN1_Status" 1111 "CAN1_DiscardedTxMessages" 1112 "CAN1_ErrorStatus" 1113 "CAN1_DelayedTxMessages" 1120 "CAN2_TxErrCnt" 1121 "CAN2_RxErrCnt" 1122 "CAN2_lastErrorCode" 1123 "CAN2_autoErrorReset" 1124 "CAN2_Baudrate" 1126 "CAN2_Status" 1127 "CAN2_DiscardedTxMessages" 1128 "CAN2_ErrorStatus" 1129 "CAN2_DelayedTxMessages" ;
VAL_ 1478 MLU_2_OD_CAN2_ErrorStatus 0 "Ok" 1 "Warn" 2 "Error Passive" 3 "Bus Off" ;
VAL_ 1478 MLU_2_OD_CAN2_Status 0 "Reset" 1 "Ready" 2 "Listening" 3 "Sleep_Pending" 4 "Sleep_Active" 5 "ERROR" ;
VAL_ 1478 MLU_2_OD_CAN2_autoErrorReset 0 "Disabled" 1 "Enabled" ;
VAL_ 1478 MLU_2_OD_CAN2_lastErrorCode 0 "No Error" 1 "Stuff Error" 2 "Form Error" 3 "Ack Error" 4 "Bit recessive Error" 5 "Bit dominant Error" 6 "CRC Error" ;
VAL_ 1478 MLU_2_OD_CAN1_ErrorStatus 0 "Ok" 1 "Warn" 2 "Error Passive" 3 "Bus Off" ;
VAL_ 1478 MLU_2_OD_CAN1_Status 0 "Reset" 1 "Ready" 2 "Listening" 3 "Sleep_Pending" 4 "Sleep_Active" 5 "ERROR" ;
VAL_ 1478 MLU_2_OD_CAN1_autoErrorReset 0 "Disabled" 1 "Enabled" ;
VAL_ 1478 MLU_2_OD_CAN1_lastErrorCode 0 "No Error" 1 "Stuff Error" 2 "Form Error" 3 "Ack Error" 4 "Bit recessive Error" 5 "Bit dominant Error" 6 "CRC Error" ;
VAL_ 1478 MLU_2_OD_SendOdOnBootup 0 "Disabled" 1 "Enabled" ;
VAL_ 1478 MLU_2_OD_NodeStatus 0 "Bootup" 4 "Stopped" 5 "Operational" 127 "Pre-Operational" 128 "Reset" ;
VAL_ 1478 MLU_2_SDO_ID 0 "Reserved" 1 "NodeID" 2 "NodeStatus" 3 "ProtocolVersion" 4 "StackVersion" 5 "DbcVersion" 16 "HeartbeatInterval" 32 "SendOdOnBootup" 33 "OdEntrySendInterval" 1040 "CpuUsage" 1041 "MemFree" 1042 "BoardTemp" 1043 "InputVoltage" 1044 "runtime" 1045 "SdcIn" 1046 "SdcOut" 1056 "ChipUID1" 1057 "ChipUID2" 1072 "BuildDate" 1073 "BuildTime" 1104 "CAN1_TxErrCnt" 1105 "CAN1_RxErrCnt" 1106 "CAN1_lastErrorCode" 1107 "CAN1_autoErrorReset" 1108 "CAN1_Baudrate" 1110 "CAN1_Status" 1111 "CAN1_DiscardedTxMessages" 1112 "CAN1_ErrorStatus" 1113 "CAN1_DelayedTxMessages" 1120 "CAN2_TxErrCnt" 1121 "CAN2_RxErrCnt" 1122 "CAN2_lastErrorCode" 1123 "CAN2_autoErrorReset" 1124 "CAN2_Baudrate" 1126 "CAN2_Status" 1127 "CAN2_DiscardedTxMessages" 1128 "CAN2_ErrorStatus" 1129 "CAN2_DelayedTxMessages" ;
VAL_ 1542 MLU_2_SDO_ID 0 "Reserved" 1 "NodeID" 2 "NodeStatus" 3 "ProtocolVersion" 4 "StackVersion" 5 "DbcVersion" 16 "HeartbeatInterval" 32 "SendOdOnBootup" 33 "OdEntrySendInterval" 1040 "CpuUsage" 1041 "MemFree" 1042 "BoardTemp" 1043 "InputVoltage" 1044 "runtime" 1045 "SdcIn" 1046 "SdcOut" 1056 "ChipUID1" 1057 "ChipUID2" 1072 "BuildDate" 1073 "BuildTime" 1104 "CAN1_TxErrCnt" 1105 "CAN1_RxErrCnt" 1106 "CAN1_lastErrorCode" 1107 "CAN1_autoErrorReset" 1108 "CAN1_Baudrate" 1110 "CAN1_Status" 1111 "CAN1_DiscardedTxMessages" 1112 "CAN1_ErrorStatus" 1113 "CAN1_DelayedTxMessages" 1120 "CAN2_TxErrCnt" 1121 "CAN2_RxErrCnt" 1122 "CAN2_lastErrorCode" 1123 "CAN2_autoErrorReset" 1124 "CAN2_Baudrate" 1126 "CAN2_Status" 1127 "CAN2_DiscardedTxMessages" 1128 "CAN2_ErrorStatus" 1129 "CAN2_DelayedTxMessages" ;
VAL_ 1798 MLU_2_NodeState 0 "Bootup" 4 "Stopped" 5 "Operational" 127 "Pre-Operational" ;
VAL_ 135 MLU_3_E0_OtherError 0 "Ok" 1 "ERR" ;
VAL_ 135 MLU_3_W0_OtherWarning 0 "Ok" 1 "WARN" ;
VAL_ 1415 MLU_3_OD_CAN2_ErrorStatus 0 "Ok" 1 "Warn" 2 "Error Passive" 3 "Bus Off" ;
VAL_ 1415 MLU_3_OD_CAN2_Status 0 "Reset" 1 "Ready" 2 "Listening" 3 "Sleep_Pending" 4 "Sleep_Active" 5 "ERROR" ;
VAL_ 1415 MLU_3_OD_CAN2_autoErrorReset 0 "Disabled" 1 "Enabled" ;
VAL_ 1415 MLU_3_OD_CAN2_lastErrorCode 0 "No Error" 1 "Stuff Error" 2 "Form Error" 3 "Ack Error" 4 "Bit recessive Error" 5 "Bit dominant Error" 6 "CRC Error" ;
VAL_ 1415 MLU_3_OD_CAN1_ErrorStatus 0 "Ok" 1 "Warn" 2 "Error Passive" 3 "Bus Off" ;
VAL_ 1415 MLU_3_OD_CAN1_Status 0 "Reset" 1 "Ready" 2 "Listening" 3 "Sleep_Pending" 4 "Sleep_Active" 5 "ERROR" ;
VAL_ 1415 MLU_3_OD_CAN1_autoErrorReset 0 "Disabled" 1 "Enabled" ;
VAL_ 1415 MLU_3_OD_CAN1_lastErrorCode 0 "No Error" 1 "Stuff Error" 2 "Form Error" 3 "Ack Error" 4 "Bit recessive Error" 5 "Bit dominant Error" 6 "CRC Error" ;
VAL_ 1415 MLU_3_OD_SendOdOnBootup 0 "Disabled" 1 "Enabled" ;
VAL_ 1415 MLU_3_OD_NodeStatus 0 "Bootup" 4 "Stopped" 5 "Operational" 127 "Pre-Operational" 128 "Reset" ;
VAL_ 1415 MLU_3_SDO_RespCode 5 "ERR: Out of range" 4 "ERR: No access in this state" 3 "ERR: Read only object" 2 "ERR: Write only object" 1 "ERR: Non existing object" 0 "OK" ;
VAL_ 1415 MLU_3_SDO_ID 0 "Reserved" 1 "NodeID" 2 "NodeStatus" 3 "ProtocolVersion" 4 "StackVersion" 5 "DbcVersion" 16 "HeartbeatInterval" 32 "SendOdOnBootup" 33 "OdEntrySendInterval" 1040 "CpuUsage" 1041 "MemFree" 1042 "BoardTemp" 1043 "InputVoltage" 1044 "runtime" 1045 "SdcIn" 1046 "SdcOut" 1056 "ChipUID1" 1057 "ChipUID2" 1072 "BuildDate" 1073 "BuildTime" 1104 "CAN1_TxErrCnt" 1105 "CAN1_RxErrCnt" 1106 "CAN1_lastErrorCode" 1107 "CAN1_autoErrorReset" 1108 "CAN1_Baudrate" 1110 "CAN1_Status" 1111 "CAN1_DiscardedTxMessages" 1112 "CAN1_ErrorStatus" 1113 "CAN1_DelayedTxMessages" 1120 "CAN2_TxErrCnt" 1121 "CAN2_RxErrCnt" 1122 "CAN2_lastErrorCode" 1123 "CAN2_autoErrorReset" 1124 "CAN2_Baudrate" 1126 "CAN2_Status" 1127 "CAN2_DiscardedTxMessages" 1128 "CAN2_ErrorStatus" 1129 "CAN2_DelayedTxMessages" ;
VAL_ 1479 MLU_3_OD_CAN2_ErrorStatus 0 "Ok" 1 "Warn" 2 "Error Passive" 3 "Bus Off" ;
VAL_ 1479 MLU_3_OD_CAN2_Status 0 "Reset" 1 "Ready" 2 "Listening" 3 "Sleep_Pending" 4 "Sleep_Active" 5 "ERROR" ;
VAL_ 1479 MLU_3_OD_CAN2_autoErrorReset 0 "Disabled" 1 "Enabled" ;
VAL_ 1479 MLU_3_OD_CAN2_lastErrorCode 0 "No Error" 1 "Stuff Error" 2 "Form Error" 3 "Ack Error" 4 "Bit recessive Error" 5 "Bit dominant Error" 6 "CRC Error" ;
VAL_ 1479 MLU_3_OD_CAN1_ErrorStatus 0 "Ok" 1 "Warn" 2 "Error Passive" 3 "Bus Off" ;
VAL_ 1479 MLU_3_OD_CAN1_Status 0 "Reset" 1 "Ready" 2 "Listening" 3 "Sleep_Pending" 4 "Sleep_Active" 5 "ERROR" ;
VAL_ 1479 MLU_3_OD_CAN1_autoErrorReset 0 "Disabled" 1 "Enabled" ;
VAL_ 1479 MLU_3_OD_CAN1_lastErrorCode 0 "No Error" 1 "Stuff Error" 2 "Form Error" 3 "Ack Error" 4 "Bit recessive Error" 5 "Bit dominant Error" 6 "CRC Error" ;
VAL_ 1479 MLU_3_OD_SendOdOnBootup 0 "Disabled" 1 "Enabled" ;
VAL_ 1479 MLU_3_OD_NodeStatus 0 "Bootup" 4 "Stopped" 5 "Operational" 127 "Pre-Operational" 128 "Reset" ;
VAL_ 1479 MLU_3_SDO_ID 0 "Reserved" 1 "NodeID" 2 "NodeStatus" 3 "ProtocolVersion" 4 "StackVersion" 5 "DbcVersion" 16 "HeartbeatInterval" 32 "SendOdOnBootup" 33 "OdEntrySendInterval" 1040 "CpuUsage" 1041 "MemFree" 1042 "BoardTemp" 1043 "InputVoltage" 1044 "runtime" 1045 "SdcIn" 1046 "SdcOut" 1056 "ChipUID1" 1057 "ChipUID2" 1072 "BuildDate" 1073 "BuildTime" 1104 "CAN1_TxErrCnt" 1105 "CAN1_RxErrCnt" 1106 "CAN1_lastErrorCode" 1107 "CAN1_autoErrorReset" 1108 "CAN1_Baudrate" 1110 "CAN1_Status" 1111 "CAN1_DiscardedTxMessages" 1112 "CAN1_ErrorStatus" 1113 "CAN1_DelayedTxMessages" 1120 "CAN2_TxErrCnt" 1121 "CAN2_RxErrCnt" 1122 "CAN2_lastErrorCode" 1123 "CAN2_autoErrorReset" 1124 "CAN2_Baudrate" 1126 "CAN2_Status" 1127 "CAN2_DiscardedTxMessages" 1128 "CAN2_ErrorStatus" 1129 "CAN2_DelayedTxMessages" ;
VAL_ 1543 MLU_3_SDO_ID 0 "Reserved" 1 "NodeID" 2 "NodeStatus" 3 "ProtocolVersion" 4 "StackVersion" 5 "DbcVersion" 16 "HeartbeatInterval" 32 "SendOdOnBootup" 33 "OdEntrySendInterval" 1040 "CpuUsage" 1041 "MemFree" 1042 "BoardTemp" 1043 "InputVoltage" 1044 "runtime" 1045 "SdcIn" 1046 "SdcOut" 1056 "ChipUID1" 1057 "ChipUID2" 1072 "BuildDate" 1073 "BuildTime" 1104 "CAN1_TxErrCnt" 1105 "CAN1_RxErrCnt" 1106 "CAN1_lastErrorCode" 1107 "CAN1_autoErrorReset" 1108 "CAN1_Baudrate" 1110 "CAN1_Status" 1111 "CAN1_DiscardedTxMessages" 1112 "CAN1_ErrorStatus" 1113 "CAN1_DelayedTxMessages" 1120 "CAN2_TxErrCnt" 1121 "CAN2_RxErrCnt" 1122 "CAN2_lastErrorCode" 1123 "CAN2_autoErrorReset" 1124 "CAN2_Baudrate" 1126 "CAN2_Status" 1127 "CAN2_DiscardedTxMessages" 1128 "CAN2_ErrorStatus" 1129 "CAN2_DelayedTxMessages" ;
VAL_ 1799 MLU_3_NodeState 0 "Bootup" 4 "Stopped" 5 "Operational" 127 "Pre-Operational" ;
VAL_ 136 MLU_4_E0_OtherError 0 "Ok" 1 "ERR" ;
VAL_ 136 MLU_4_W0_OtherWarning 0 "Ok" 1 "WARN" ;
VAL_ 1416 MLU_4_OD_CAN2_ErrorStatus 0 "Ok" 1 "Warn" 2 "Error Passive" 3 "Bus Off" ;
VAL_ 1416 MLU_4_OD_CAN2_Status 0 "Reset" 1 "Ready" 2 "Listening" 3 "Sleep_Pending" 4 "Sleep_Active" 5 "ERROR" ;
VAL_ 1416 MLU_4_OD_CAN2_autoErrorReset 0 "Disabled" 1 "Enabled" ;
VAL_ 1416 MLU_4_OD_CAN2_lastErrorCode 0 "No Error" 1 "Stuff Error" 2 "Form Error" 3 "Ack Error" 4 "Bit recessive Error" 5 "Bit dominant Error" 6 "CRC Error" ;
VAL_ 1416 MLU_4_OD_CAN1_ErrorStatus 0 "Ok" 1 "Warn" 2 "Error Passive" 3 "Bus Off" ;
VAL_ 1416 MLU_4_OD_CAN1_Status 0 "Reset" 1 "Ready" 2 "Listening" 3 "Sleep_Pending" 4 "Sleep_Active" 5 "ERROR" ;
VAL_ 1416 MLU_4_OD_CAN1_autoErrorReset 0 "Disabled" 1 "Enabled" ;
VAL_ 1416 MLU_4_OD_CAN1_lastErrorCode 0 "No Error" 1 "Stuff Error" 2 "Form Error" 3 "Ack Error" 4 "Bit recessive Error" 5 "Bit dominant Error" 6 "CRC Error" ;
VAL_ 1416 MLU_4_OD_SendOdOnBootup 0 "Disabled" 1 "Enabled" ;
VAL_ 1416 MLU_4_OD_NodeStatus 0 "Bootup" 4 "Stopped" 5 "Operational" 127 "Pre-Operational" 128 "Reset" ;
VAL_ 1416 MLU_4_SDO_RespCode 5 "ERR: Out of range" 4 "ERR: No access in this state" 3 "ERR: Read only object" 2 "ERR: Write only object" 1 "ERR: Non existing object" 0 "OK" ;
VAL_ 1416 MLU_4_SDO_ID 0 "Reserved" 1 "NodeID" 2 "NodeStatus" 3 "ProtocolVersion" 4 "StackVersion" 5 "DbcVersion" 16 "HeartbeatInterval" 32 "SendOdOnBootup" 33 "OdEntrySendInterval" 1040 "CpuUsage" 1041 "MemFree" 1042 "BoardTemp" 1043 "InputVoltage" 1044 "runtime" 1045 "SdcIn" 1046 "SdcOut" 1056 "ChipUID1" 1057 "ChipUID2" 1072 "BuildDate" 1073 "BuildTime" 1104 "CAN1_TxErrCnt" 1105 "CAN1_RxErrCnt" 1106 "CAN1_lastErrorCode" 1107 "CAN1_autoErrorReset" 1108 "CAN1_Baudrate" 1110 "CAN1_Status" 1111 "CAN1_DiscardedTxMessages" 1112 "CAN1_ErrorStatus" 1113 "CAN1_DelayedTxMessages" 1120 "CAN2_TxErrCnt" 1121 "CAN2_RxErrCnt" 1122 "CAN2_lastErrorCode" 1123 "CAN2_autoErrorReset" 1124 "CAN2_Baudrate" 1126 "CAN2_Status" 1127 "CAN2_DiscardedTxMessages" 1128 "CAN2_ErrorStatus" 1129 "CAN2_DelayedTxMessages" ;
VAL_ 1480 MLU_4_OD_CAN2_ErrorStatus 0 "Ok" 1 "Warn" 2 "Error Passive" 3 "Bus Off" ;
VAL_ 1480 MLU_4_OD_CAN2_Status 0 "Reset" 1 "Ready" 2 "Listening" 3 "Sleep_Pending" 4 "Sleep_Active" 5 "ERROR" ;
VAL_ 1480 MLU_4_OD_CAN2_autoErrorReset 0 "Disabled" 1 "Enabled" ;
VAL_ 1480 MLU_4_OD_CAN2_lastErrorCode 0 "No Error" 1 "Stuff Error" 2 "Form Error" 3 "Ack Error" 4 "Bit recessive Error" 5 "Bit dominant Error" 6 "CRC Error" ;
VAL_ 1480 MLU_4_OD_CAN1_ErrorStatus 0 "Ok" 1 "Warn" 2 "Error Passive" 3 "Bus Off" ;
VAL_ 1480 MLU_4_OD_CAN1_Status 0 "Reset" 1 "Ready" 2 "Listening" 3 "Sleep_Pending" 4 "Sleep_Active" 5 "ERROR" ;
VAL_ 1480 MLU_4_OD_CAN1_autoErrorReset 0 "Disabled" 1 "Enabled" ;
VAL_ 1480 MLU_4_OD_CAN1_lastErrorCode 0 "No Error" 1 "Stuff Error" 2 "Form Error" 3 "Ack Error" 4 "Bit recessive Error" 5 "Bit dominant Error" 6 "CRC Error" ;
VAL_ 1480 MLU_4_OD_SendOdOnBootup 0 "Disabled" 1 "Enabled" ;
VAL_ 1480 MLU_4_OD_NodeStatus 0 "Bootup" 4 "Stopped" 5 "Operational" 127 "Pre-Operational" 128 "Reset" ;
VAL_ 1480 MLU_4_SDO_ID 0 "Reserved" 1 "NodeID" 2 "NodeStatus" 3 "ProtocolVersion" 4 "StackVersion" 5 "DbcVersion" 16 "HeartbeatInterval" 32 "SendOdOnBootup" 33 "OdEntrySendInterval" 1040 "CpuUsage" 1041 "MemFree" 1042 "BoardTemp" 1043 "InputVoltage" 1044 "runtime" 1045 "SdcIn" 1046 "SdcOut" 1056 "ChipUID1" 1057 "ChipUID2" 1072 "BuildDate" 1073 "BuildTime" 1104 "CAN1_TxErrCnt" 1105 "CAN1_RxErrCnt" 1106 "CAN1_lastErrorCode" 1107 "CAN1_autoErrorReset" 1108 "CAN1_Baudrate" 1110 "CAN1_Status" 1111 "CAN1_DiscardedTxMessages" 1112 "CAN1_ErrorStatus" 1113 "CAN1_DelayedTxMessages" 1120 "CAN2_TxErrCnt" 1121 "CAN2_RxErrCnt" 1122 "CAN2_lastErrorCode" 1123 "CAN2_autoErrorReset" 1124 "CAN2_Baudrate" 1126 "CAN2_Status" 1127 "CAN2_DiscardedTxMessages" 1128 "CAN2_ErrorStatus" 1129 "CAN2_DelayedTxMessages" ;
VAL_ 1544 MLU_4_SDO_ID 0 "Reserved" 1 "NodeID" 2 "NodeStatus" 3 "ProtocolVersion" 4 "StackVersion" 5 "DbcVersion" 16 "HeartbeatInterval" 32 "SendOdOnBootup" 33 "OdEntrySendInterval" 1040 "CpuUsage" 1041 "MemFree" 1042 "BoardTemp" 1043 "InputVoltage" 1044 "runtime" 1045 "SdcIn" 1046 "SdcOut" 1056 "ChipUID1" 1057 "ChipUID2" 1072 "BuildDate" 1073 "BuildTime" 1104 "CAN1_TxErrCnt" 1105 "CAN1_RxErrCnt" 1106 "CAN1_lastErrorCode" 1107 "CAN1_autoErrorReset" 1108 "CAN1_Baudrate" 1110 "CAN1_Status" 1111 "CAN1_DiscardedTxMessages" 1112 "CAN1_ErrorStatus" 1113 "CAN1_DelayedTxMessages" 1120 "CAN2_TxErrCnt" 1121 "CAN2_RxErrCnt" 1122 "CAN2_lastErrorCode" 1123 "CAN2_autoErrorReset" 1124 "CAN2_Baudrate" 1126 "CAN2_Status" 1127 "CAN2_DiscardedTxMessages" 1128 "CAN2_ErrorStatus" 1129 "CAN2_DelayedTxMessages" ;
VAL_ 1800 MLU_4_NodeState 0 "Bootup" 4 "Stopped" 5 "Operational" 127 "Pre-Operational" ;
VAL_ 137 MLU_5_E0_OtherError 0 "Ok" 1 "ERR" ;
VAL_ 137 MLU_5_W0_OtherWarning 0 "Ok" 1 "WARN" ;
VAL_ 1417 MLU_5_OD_CAN2_ErrorStatus 0 "Ok" 1 "Warn" 2 "Error Passive" 3 "Bus Off" ;
VAL_ 1417 MLU_5_OD_CAN2_Status 0 "Reset" 1 "Ready" 2 "Listening" 3 "Sleep_Pending" 4 "Sleep_Active" 5 "ERROR" ;
VAL_ 1417 MLU_5_OD_CAN2_autoErrorReset 0 "Disabled" 1 "Enabled" ;
VAL_ 1417 MLU_5_OD_CAN2_lastErrorCode 0 "No Error" 1 "Stuff Error" 2 "Form Error" 3 "Ack Error" 4 "Bit recessive Error" 5 "Bit dominant Error" 6 "CRC Error" ;
VAL_ 1417 MLU_5_OD_CAN1_ErrorStatus 0 "Ok" 1 "Warn" 2 "Error Passive" 3 "Bus Off" ;
VAL_ 1417 MLU_5_OD_CAN1_Status 0 "Reset" 1 "Ready" 2 "Listening" 3 "Sleep_Pending" 4 "Sleep_Active" 5 "ERROR" ;
VAL_ 1417 MLU_5_OD_CAN1_autoErrorReset 0 "Disabled" 1 "Enabled" ;
VAL_ 1417 MLU_5_OD_CAN1_lastErrorCode 0 "No Error" 1 "Stuff Error" 2 "Form Error" 3 "Ack Error" 4 "Bit recessive Error" 5 "Bit dominant Error" 6 "CRC Error" ;
VAL_ 1417 MLU_5_OD_SendOdOnBootup 0 "Disabled" 1 "Enabled" ;
VAL_ 1417 MLU_5_OD_NodeStatus 0 "Bootup" 4 "Stopped" 5 "Operational" 127 "Pre-Operational" 128 "Reset" ;
VAL_ 1417 MLU_5_SDO_RespCode 5 "ERR: Out of range" 4 "ERR: No access in this state" 3 "ERR: Read only object" 2 "ERR: Write only object" 1 "ERR: Non existing object" 0 "OK" ;
VAL_ 1417 MLU_5_SDO_ID 0 "Reserved" 1 "NodeID" 2 "NodeStatus" 3 "ProtocolVersion" 4 "StackVersion" 5 "DbcVersion" 16 "HeartbeatInterval" 32 "SendOdOnBootup" 33 "OdEntrySendInterval" 1040 "CpuUsage" 1041 "MemFree" 1042 "BoardTemp" 1043 "InputVoltage" 1044 "runtime" 1045 "SdcIn" 1046 "SdcOut" 1056 "ChipUID1" 1057 "ChipUID2" 1072 "BuildDate" 1073 "BuildTime" 1104 "CAN1_TxErrCnt" 1105 "CAN1_RxErrCnt" 1106 "CAN1_lastErrorCode" 1107 "CAN1_autoErrorReset" 1108 "CAN1_Baudrate" 1110 "CAN1_Status" 1111 "CAN1_DiscardedTxMessages" 1112 "CAN1_ErrorStatus" 1113 "CAN1_DelayedTxMessages" 1120 "CAN2_TxErrCnt" 1121 "CAN2_RxErrCnt" 1122 "CAN2_lastErrorCode" 1123 "CAN2_autoErrorReset" 1124 "CAN2_Baudrate" 1126 "CAN2_Status" 1127 "CAN2_DiscardedTxMessages" 1128 "CAN2_ErrorStatus" 1129 "CAN2_DelayedTxMessages" ;
VAL_ 1481 MLU_5_OD_CAN2_ErrorStatus 0 "Ok" 1 "Warn" 2 "Error Passive" 3 "Bus Off" ;
VAL_ 1481 MLU_5_OD_CAN2_Status 0 "Reset" 1 "Ready" 2 "Listening" 3 "Sleep_Pending" 4 "Sleep_Active" 5 "ERROR" ;
VAL_ 1481 MLU_5_OD_CAN2_autoErrorReset 0 "Disabled" 1 "Enabled" ;
VAL_ 1481 MLU_5_OD_CAN2_lastErrorCode 0 "No Error" 1 "Stuff Error" 2 "Form Error" 3 "Ack Error" 4 "Bit recessive Error" 5 "Bit dominant Error" 6 "CRC Error" ;
VAL_ 1481 MLU_5_OD_CAN1_ErrorStatus 0 "Ok" 1 "Warn" 2 "Error Passive" 3 "Bus Off" ;
VAL_ 1481 MLU_5_OD_CAN1_Status 0 "Reset" 1 "Ready" 2 "Listening" 3 "Sleep_Pending" 4 "Sleep_Active" 5 "ERROR" ;
VAL_ 1481 MLU_5_OD_CAN1_autoErrorReset 0 "Disabled" 1 "Enabled" ;
VAL_ 1481 MLU_5_OD_CAN1_lastErrorCode 0 "No Error" 1 "Stuff Error" 2 "Form Error" 3 "Ack Error" 4 "Bit recessive Error" 5 "Bit dominant Error" 6 "CRC Error" ;
VAL_ 1481 MLU_5_OD_SendOdOnBootup 0 "Disabled" 1 "Enabled" ;
VAL_ 1481 MLU_5_OD_NodeStatus 0 "Bootup" 4 "Stopped" 5 "Operational" 127 "Pre-Operational" 128 "Reset" ;
VAL_ 1481 MLU_5_SDO_ID 0 "Reserved" 1 "NodeID" 2 "NodeStatus" 3 "ProtocolVersion" 4 "StackVersion" 5 "DbcVersion" 16 "HeartbeatInterval" 32 "SendOdOnBootup" 33 "OdEntrySendInterval" 1040 "CpuUsage" 1041 "MemFree" 1042 "BoardTemp" 1043 "InputVoltage" 1044 "runtime" 1045 "SdcIn" 1046 "SdcOut" 1056 "ChipUID1" 1057 "ChipUID2" 1072 "BuildDate" 1073 "BuildTime" 1104 "CAN1_TxErrCnt" 1105 "CAN1_RxErrCnt" 1106 "CAN1_lastErrorCode" 1107 "CAN1_autoErrorReset" 1108 "CAN1_Baudrate" 1110 "CAN1_Status" 1111 "CAN1_DiscardedTxMessages" 1112 "CAN1_ErrorStatus" 1113 "CAN1_DelayedTxMessages" 1120 "CAN2_TxErrCnt" 1121 "CAN2_RxErrCnt" 1122 "CAN2_lastErrorCode" 1123 "CAN2_autoErrorReset" 1124 "CAN2_Baudrate" 1126 "CAN2_Status" 1127 "CAN2_DiscardedTxMessages" 1128 "CAN2_ErrorStatus" 1129 "CAN2_DelayedTxMessages" ;
VAL_ 1545 MLU_5_SDO_ID 0 "Reserved" 1 "NodeID" 2 "NodeStatus" 3 "ProtocolVersion" 4 "StackVersion" 5 "DbcVersion" 16 "HeartbeatInterval" 32 "SendOdOnBootup" 33 "OdEntrySendInterval" 1040 "CpuUsage" 1041 "MemFree" 1042 "BoardTemp" 1043 "InputVoltage" 1044 "runtime" 1045 "SdcIn" 1046 "SdcOut" 1056 "ChipUID1" 1057 "ChipUID2" 1072 "BuildDate" 1073 "BuildTime" 1104 "CAN1_TxErrCnt" 1105 "CAN1_RxErrCnt" 1106 "CAN1_lastErrorCode" 1107 "CAN1_autoErrorReset" 1108 "CAN1_Baudrate" 1110 "CAN1_Status" 1111 "CAN1_DiscardedTxMessages" 1112 "CAN1_ErrorStatus" 1113 "CAN1_DelayedTxMessages" 1120 "CAN2_TxErrCnt" 1121 "CAN2_RxErrCnt" 1122 "CAN2_lastErrorCode" 1123 "CAN2_autoErrorReset" 1124 "CAN2_Baudrate" 1126 "CAN2_Status" 1127 "CAN2_DiscardedTxMessages" 1128 "CAN2_ErrorStatus" 1129 "CAN2_DelayedTxMessages" ;
VAL_ 1801 MLU_5_NodeState 0 "Bootup" 4 "Stopped" 5 "Operational" 127 "Pre-Operational" ;
VAL_ 144 MLU_6_E0_OtherError 0 "Ok" 1 "ERR" ;
VAL_ 144 MLU_6_W0_OtherWarning 0 "Ok" 1 "WARN" ;
VAL_ 1424 MLU_6_OD_CAN2_ErrorStatus 0 "Ok" 1 "Warn" 2 "Error Passive" 3 "Bus Off" ;
VAL_ 1424 MLU_6_OD_CAN2_Status 0 "Reset" 1 "Ready" 2 "Listening" 3 "Sleep_Pending" 4 "Sleep_Active" 5 "ERROR" ;
VAL_ 1424 MLU_6_OD_CAN2_autoErrorReset 0 "Disabled" 1 "Enabled" ;
VAL_ 1424 MLU_6_OD_CAN2_lastErrorCode 0 "No Error" 1 "Stuff Error" 2 "Form Error" 3 "Ack Error" 4 "Bit recessive Error" 5 "Bit dominant Error" 6 "CRC Error" ;
VAL_ 1424 MLU_6_OD_CAN1_ErrorStatus 0 "Ok" 1 "Warn" 2 "Error Passive" 3 "Bus Off" ;
VAL_ 1424 MLU_6_OD_CAN1_Status 0 "Reset" 1 "Ready" 2 "Listening" 3 "Sleep_Pending" 4 "Sleep_Active" 5 "ERROR" ;
VAL_ 1424 MLU_6_OD_CAN1_autoErrorReset 0 "Disabled" 1 "Enabled" ;
VAL_ 1424 MLU_6_OD_CAN1_lastErrorCode 0 "No Error" 1 "Stuff Error" 2 "Form Error" 3 "Ack Error" 4 "Bit recessive Error" 5 "Bit dominant Error" 6 "CRC Error" ;
VAL_ 1424 MLU_6_OD_SendOdOnBootup 0 "Disabled" 1 "Enabled" ;
VAL_ 1424 MLU_6_OD_NodeStatus 0 "Bootup" 4 "Stopped" 5 "Operational" 127 "Pre-Operational" 128 "Reset" ;
VAL_ 1424 MLU_6_SDO_RespCode 5 "ERR: Out of range" 4 "ERR: No access in this state" 3 "ERR: Read only object" 2 "ERR: Write only object" 1 "ERR: Non existing object" 0 "OK" ;
VAL_ 1424 MLU_6_SDO_ID 0 "Reserved" 1 "NodeID" 2 "NodeStatus" 3 "ProtocolVersion" 4 "StackVersion" 5 "DbcVersion" 16 "HeartbeatInterval" 32 "SendOdOnBootup" 33 "OdEntrySendInterval" 1040 "CpuUsage" 1041 "MemFree" 1042 "BoardTemp" 1043 "InputVoltage" 1044 "runtime" 1045 "SdcIn" 1046 "SdcOut" 1056 "ChipUID1" 1057 "ChipUID2" 1072 "BuildDate" 1073 "BuildTime" 1104 "CAN1_TxErrCnt" 1105 "CAN1_RxErrCnt" 1106 "CAN1_lastErrorCode" 1107 "CAN1_autoErrorReset" 1108 "CAN1_Baudrate" 1110 "CAN1_Status" 1111 "CAN1_DiscardedTxMessages" 1112 "CAN1_ErrorStatus" 1113 "CAN1_DelayedTxMessages" 1120 "CAN2_TxErrCnt" 1121 "CAN2_RxErrCnt" 1122 "CAN2_lastErrorCode" 1123 "CAN2_autoErrorReset" 1124 "CAN2_Baudrate" 1126 "CAN2_Status" 1127 "CAN2_DiscardedTxMessages" 1128 "CAN2_ErrorStatus" 1129 "CAN2_DelayedTxMessages" ;
VAL_ 1488 MLU_6_OD_CAN2_ErrorStatus 0 "Ok" 1 "Warn" 2 "Error Passive" 3 "Bus Off" ;
VAL_ 1488 MLU_6_OD_CAN2_Status 0 "Reset" 1 "Ready" 2 "Listening" 3 "Sleep_Pending" 4 "Sleep_Active" 5 "ERROR" ;
VAL_ 1488 MLU_6_OD_CAN2_autoErrorReset 0 "Disabled" 1 "Enabled" ;
VAL_ 1488 MLU_6_OD_CAN2_lastErrorCode 0 "No Error" 1 "Stuff Error" 2 "Form Error" 3 "Ack Error" 4 "Bit recessive Error" 5 "Bit dominant Error" 6 "CRC Error" ;
VAL_ 1488 MLU_6_OD_CAN1_ErrorStatus 0 "Ok" 1 "Warn" 2 "Error Passive" 3 "Bus Off" ;
VAL_ 1488 MLU_6_OD_CAN1_Status 0 "Reset" 1 "Ready" 2 "Listening" 3 "Sleep_Pending" 4 "Sleep_Active" 5 "ERROR" ;
VAL_ 1488 MLU_6_OD_CAN1_autoErrorReset 0 "Disabled" 1 "Enabled" ;
VAL_ 1488 MLU_6_OD_CAN1_lastErrorCode 0 "No Error" 1 "Stuff Error" 2 "Form Error" 3 "Ack Error" 4 "Bit recessive Error" 5 "Bit dominant Error" 6 "CRC Error" ;
VAL_ 1488 MLU_6_OD_SendOdOnBootup 0 "Disabled" 1 "Enabled" ;
VAL_ 1488 MLU_6_OD_NodeStatus 0 "Bootup" 4 "Stopped" 5 "Operational" 127 "Pre-Operational" 128 "Reset" ;
VAL_ 1488 MLU_6_SDO_ID 0 "Reserved" 1 "NodeID" 2 "NodeStatus" 3 "ProtocolVersion" 4 "StackVersion" 5 "DbcVersion" 16 "HeartbeatInterval" 32 "SendOdOnBootup" 33 "OdEntrySendInterval" 1040 "CpuUsage" 1041 "MemFree" 1042 "BoardTemp" 1043 "InputVoltage" 1044 "runtime" 1045 "SdcIn" 1046 "SdcOut" 1056 "ChipUID1" 1057 "ChipUID2" 1072 "BuildDate" 1073 "BuildTime" 1104 "CAN1_TxErrCnt" 1105 "CAN1_RxErrCnt" 1106 "CAN1_lastErrorCode" 1107 "CAN1_autoErrorReset" 1108 "CAN1_Baudrate" 1110 "CAN1_Status" 1111 "CAN1_DiscardedTxMessages" 1112 "CAN1_ErrorStatus" 1113 "CAN1_DelayedTxMessages" 1120 "CAN2_TxErrCnt" 1121 "CAN2_RxErrCnt" 1122 "CAN2_lastErrorCode" 1123 "CAN2_autoErrorReset" 1124 "CAN2_Baudrate" 1126 "CAN2_Status" 1127 "CAN2_DiscardedTxMessages" 1128 "CAN2_ErrorStatus" 1129 "CAN2_DelayedTxMessages" ;
VAL_ 1552 MLU_6_SDO_ID 0 "Reserved" 1 "NodeID" 2 "NodeStatus" 3 "ProtocolVersion" 4 "StackVersion" 5 "DbcVersion" 16 "HeartbeatInterval" 32 "SendOdOnBootup" 33 "OdEntrySendInterval" 1040 "CpuUsage" 1041 "MemFree" 1042 "BoardTemp" 1043 "InputVoltage" 1044 "runtime" 1045 "SdcIn" 1046 "SdcOut" 1056 "ChipUID1" 1057 "ChipUID2" 1072 "BuildDate" 1073 "BuildTime" 1104 "CAN1_TxErrCnt" 1105 "CAN1_RxErrCnt" 1106 "CAN1_lastErrorCode" 1107 "CAN1_autoErrorReset" 1108 "CAN1_Baudrate" 1110 "CAN1_Status" 1111 "CAN1_DiscardedTxMessages" 1112 "CAN1_ErrorStatus" 1113 "CAN1_DelayedTxMessages" 1120 "CAN2_TxErrCnt" 1121 "CAN2_RxErrCnt" 1122 "CAN2_lastErrorCode" 1123 "CAN2_autoErrorReset" 1124 "CAN2_Baudrate" 1126 "CAN2_Status" 1127 "CAN2_DiscardedTxMessages" 1128 "CAN2_ErrorStatus" 1129 "CAN2_DelayedTxMessages" ;
VAL_ 1808 MLU_6_NodeState 0 "Bootup" 4 "Stopped" 5 "Operational" 127 "Pre-Operational" ;
