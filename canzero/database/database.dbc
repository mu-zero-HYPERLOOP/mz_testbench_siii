VERSION ""

NS_ :

BS_:

BU_: TelemetryNode Master SENSOR PDU CLU BRAKE MLU_1 MLU_2 MLU_3 MLU_4 MLU_5 MLU_6

BO_ 3 SENSOR_IMU_ACCEL_Y: 4 SENSOR
 SG_ SENSOR_IMU_ACCEL_Y_SIGNAL : 0|32@1- (1,0) [-2147483648|2147483647] "" Vector__XXX

BO_ 1 SENSOR_Ready: 0 Vector__XXX

BO_ 0 SENSOR_HELLO_WORLD: 1 Vector__XXX

BO_ 2 CANzero_NMT: 4 Master
 SG_ CANzero_NMT_Node : 16|16@1+ (1,0) [0|63] ""  SENSOR,PDU,CLU,BRAKE,MLU_1,MLU_2,MLU_3,MLU_4,MLU_5,MLU_6
 SG_ CANzero_NMT_State : 0|16@1+ (1,0) [0|0] ""  SENSOR,PDU,CLU,BRAKE,MLU_1,MLU_2,MLU_3,MLU_4,MLU_5,MLU_6

BO_ 122 CANzero_Sync: 0 Master

BO_ 123 CANzero_Timestamp: 0 Master

BO_ 129 SENSOR_EMCY: 4 SENSOR

BO_ 385 SENSOR_TX_PDO1: 0 SENSOR

BO_ 449 SENSOR_RX_PDO1: 0 Vector__XXX

BO_ 513 SENSOR_TX_PDO2: 0 SENSOR

BO_ 577 SENSOR_RX_PDO2: 0 Vector__XXX

BO_ 641 SENSOR_TX_PDO3: 0 SENSOR

BO_ 705 SENSOR_RX_PDO3: 0 Vector__XXX

BO_ 769 SENSOR_TX_PDO4: 0 SENSOR

BO_ 833 SENSOR_RX_PDO4: 0 Vector__XXX

BO_ 897 SENSOR_TX_PDO5: 0 SENSOR

BO_ 961 SENSOR_TX_PDO6: 0 SENSOR

BO_ 1025 SENSOR_TX_PDO7: 0 SENSOR

BO_ 1089 SENSOR_TX_PDO8: 0 SENSOR

BO_ 1153 SENSOR_TX_PDO9: 0 SENSOR

BO_ 1217 SENSOR_TX_PDO10: 0 SENSOR

BO_ 1281 SENSOR_TX_PDO11: 0 SENSOR

BO_ 1345 SENSOR_TX_PDO12: 0 SENSOR

BO_ 1409 SENSOR_SDO_Resp: 8 SENSOR
 SG_ SENSOR_SDO_RespCode : 12|4@1+ (1,0) [0|0] ""  TelemetryNode
 SG_ SENSOR_SDO_ID M : 0|12@1+ (1,0) [0|4095] ""  TelemetryNode

BO_ 1473 SENSOR_SDO_Req_Up: 8 TelemetryNode
 SG_ SENSOR_SDO_ID M : 0|12@1+ (1,0) [0|4095] ""  SENSOR

BO_ 1537 SENSOR_SDO_Req_Down: 2 TelemetryNode
 SG_ SENSOR_SDO_ID M : 0|12@1+ (1,0) [0|4095] ""  SENSOR

BO_ 1793 SENSOR_Heartbeat: 1 SENSOR
 SG_ SENSOR_NodeState : 0|8@1+ (1,0) [0|0] ""  Master,TelemetryNode

BO_ 1857 SENSOR_BTL_TX: 8 SENSOR

BO_ 1921 SENSOR_BTL_RX: 8 TelemetryNode

BO_ 130 PDU_EMCY: 4 PDU

BO_ 386 PDU_TX_PDO1: 0 PDU

BO_ 450 PDU_RX_PDO1: 0 Vector__XXX

BO_ 514 PDU_TX_PDO2: 0 PDU

BO_ 578 PDU_RX_PDO2: 0 Vector__XXX

BO_ 642 PDU_TX_PDO3: 0 PDU

BO_ 706 PDU_RX_PDO3: 0 Vector__XXX

BO_ 770 PDU_TX_PDO4: 0 PDU

BO_ 834 PDU_RX_PDO4: 0 Vector__XXX

BO_ 898 PDU_TX_PDO5: 0 PDU

BO_ 962 PDU_TX_PDO6: 0 PDU

BO_ 1026 PDU_TX_PDO7: 0 PDU

BO_ 1090 PDU_TX_PDO8: 0 PDU

BO_ 1154 PDU_TX_PDO9: 0 PDU

BO_ 1218 PDU_TX_PDO10: 0 PDU

BO_ 1282 PDU_TX_PDO11: 0 PDU

BO_ 1346 PDU_TX_PDO12: 0 PDU

BO_ 1410 PDU_SDO_Resp: 8 PDU
 SG_ PDU_SDO_RespCode : 12|4@1+ (1,0) [0|0] ""  TelemetryNode
 SG_ PDU_SDO_ID M : 0|12@1+ (1,0) [0|4095] ""  TelemetryNode

BO_ 1474 PDU_SDO_Req_Up: 8 TelemetryNode
 SG_ PDU_SDO_ID M : 0|12@1+ (1,0) [0|4095] ""  PDU

BO_ 1538 PDU_SDO_Req_Down: 2 TelemetryNode
 SG_ PDU_SDO_ID M : 0|12@1+ (1,0) [0|4095] ""  PDU

BO_ 1794 PDU_Heartbeat: 1 PDU
 SG_ PDU_NodeState : 0|8@1+ (1,0) [0|0] ""  Master,TelemetryNode

BO_ 1858 PDU_BTL_TX: 8 PDU

BO_ 1922 PDU_BTL_RX: 8 TelemetryNode

BO_ 131 CLU_EMCY: 4 CLU

BO_ 387 CLU_TX_PDO1: 0 CLU

BO_ 451 CLU_RX_PDO1: 0 Vector__XXX

BO_ 515 CLU_TX_PDO2: 0 CLU

BO_ 579 CLU_RX_PDO2: 0 Vector__XXX

BO_ 643 CLU_TX_PDO3: 0 CLU

BO_ 707 CLU_RX_PDO3: 0 Vector__XXX

BO_ 771 CLU_TX_PDO4: 0 CLU

BO_ 835 CLU_RX_PDO4: 0 Vector__XXX

BO_ 899 CLU_TX_PDO5: 0 CLU

BO_ 963 CLU_TX_PDO6: 0 CLU

BO_ 1027 CLU_TX_PDO7: 0 CLU

BO_ 1091 CLU_TX_PDO8: 0 CLU

BO_ 1155 CLU_TX_PDO9: 0 CLU

BO_ 1219 CLU_TX_PDO10: 0 CLU

BO_ 1283 CLU_TX_PDO11: 0 CLU

BO_ 1347 CLU_TX_PDO12: 0 CLU

BO_ 1411 CLU_SDO_Resp: 8 CLU
 SG_ CLU_SDO_RespCode : 12|4@1+ (1,0) [0|0] ""  TelemetryNode
 SG_ CLU_SDO_ID M : 0|12@1+ (1,0) [0|4095] ""  TelemetryNode

BO_ 1475 CLU_SDO_Req_Up: 8 TelemetryNode
 SG_ CLU_SDO_ID M : 0|12@1+ (1,0) [0|4095] ""  CLU

BO_ 1539 CLU_SDO_Req_Down: 2 TelemetryNode
 SG_ CLU_SDO_ID M : 0|12@1+ (1,0) [0|4095] ""  CLU

BO_ 1795 CLU_Heartbeat: 1 CLU
 SG_ CLU_NodeState : 0|8@1+ (1,0) [0|0] ""  Master,TelemetryNode

BO_ 1859 CLU_BTL_TX: 8 CLU

BO_ 1923 CLU_BTL_RX: 8 TelemetryNode

BO_ 132 BRAKE_EMCY: 4 BRAKE

BO_ 388 BRAKE_TX_PDO1: 0 BRAKE

BO_ 452 BRAKE_RX_PDO1: 0 Vector__XXX

BO_ 516 BRAKE_TX_PDO2: 0 BRAKE

BO_ 580 BRAKE_RX_PDO2: 0 Vector__XXX

BO_ 644 BRAKE_TX_PDO3: 0 BRAKE

BO_ 708 BRAKE_RX_PDO3: 0 Vector__XXX

BO_ 772 BRAKE_TX_PDO4: 0 BRAKE

BO_ 836 BRAKE_RX_PDO4: 0 Vector__XXX

BO_ 900 BRAKE_TX_PDO5: 0 BRAKE

BO_ 964 BRAKE_TX_PDO6: 0 BRAKE

BO_ 1028 BRAKE_TX_PDO7: 0 BRAKE

BO_ 1092 BRAKE_TX_PDO8: 0 BRAKE

BO_ 1156 BRAKE_TX_PDO9: 0 BRAKE

BO_ 1220 BRAKE_TX_PDO10: 0 BRAKE

BO_ 1284 BRAKE_TX_PDO11: 0 BRAKE

BO_ 1348 BRAKE_TX_PDO12: 0 BRAKE

BO_ 1412 BRAKE_SDO_Resp: 8 BRAKE
 SG_ BRAKE_SDO_RespCode : 12|4@1+ (1,0) [0|0] ""  TelemetryNode
 SG_ BRAKE_SDO_ID M : 0|12@1+ (1,0) [0|4095] ""  TelemetryNode

BO_ 1476 BRAKE_SDO_Req_Up: 8 TelemetryNode
 SG_ BRAKE_SDO_ID M : 0|12@1+ (1,0) [0|4095] ""  BRAKE

BO_ 1540 BRAKE_SDO_Req_Down: 2 TelemetryNode
 SG_ BRAKE_SDO_ID M : 0|12@1+ (1,0) [0|4095] ""  BRAKE

BO_ 1796 BRAKE_Heartbeat: 1 BRAKE
 SG_ BRAKE_NodeState : 0|8@1+ (1,0) [0|0] ""  Master,TelemetryNode

BO_ 1860 BRAKE_BTL_TX: 8 BRAKE

BO_ 1924 BRAKE_BTL_RX: 8 TelemetryNode

BO_ 133 MLU_1_EMCY: 4 MLU_1

BO_ 389 MLU_1_TX_PDO1: 0 MLU_1

BO_ 453 MLU_1_RX_PDO1: 0 Vector__XXX

BO_ 517 MLU_1_TX_PDO2: 0 MLU_1

BO_ 581 MLU_1_RX_PDO2: 0 Vector__XXX

BO_ 645 MLU_1_TX_PDO3: 0 MLU_1

BO_ 709 MLU_1_RX_PDO3: 0 Vector__XXX

BO_ 773 MLU_1_TX_PDO4: 0 MLU_1

BO_ 837 MLU_1_RX_PDO4: 0 Vector__XXX

BO_ 901 MLU_1_TX_PDO5: 0 MLU_1

BO_ 965 MLU_1_TX_PDO6: 0 MLU_1

BO_ 1029 MLU_1_TX_PDO7: 0 MLU_1

BO_ 1093 MLU_1_TX_PDO8: 0 MLU_1

BO_ 1157 MLU_1_TX_PDO9: 0 MLU_1

BO_ 1221 MLU_1_TX_PDO10: 0 MLU_1

BO_ 1285 MLU_1_TX_PDO11: 0 MLU_1

BO_ 1349 MLU_1_TX_PDO12: 0 MLU_1

BO_ 1413 MLU_1_SDO_Resp: 8 MLU_1
 SG_ MLU_1_SDO_RespCode : 12|4@1+ (1,0) [0|0] ""  TelemetryNode
 SG_ MLU_1_SDO_ID M : 0|12@1+ (1,0) [0|4095] ""  TelemetryNode

BO_ 1477 MLU_1_SDO_Req_Up: 8 TelemetryNode
 SG_ MLU_1_SDO_ID M : 0|12@1+ (1,0) [0|4095] ""  MLU_1

BO_ 1541 MLU_1_SDO_Req_Down: 2 TelemetryNode
 SG_ MLU_1_SDO_ID M : 0|12@1+ (1,0) [0|4095] ""  MLU_1

BO_ 1797 MLU_1_Heartbeat: 1 MLU_1
 SG_ MLU_1_NodeState : 0|8@1+ (1,0) [0|0] ""  Master,TelemetryNode

BO_ 1861 MLU_1_BTL_TX: 8 MLU_1

BO_ 1925 MLU_1_BTL_RX: 8 TelemetryNode

BO_ 134 MLU_2_EMCY: 4 MLU_2

BO_ 390 MLU_2_TX_PDO1: 0 MLU_2

BO_ 454 MLU_2_RX_PDO1: 0 Vector__XXX

BO_ 518 MLU_2_TX_PDO2: 0 MLU_2

BO_ 582 MLU_2_RX_PDO2: 0 Vector__XXX

BO_ 646 MLU_2_TX_PDO3: 0 MLU_2

BO_ 710 MLU_2_RX_PDO3: 0 Vector__XXX

BO_ 774 MLU_2_TX_PDO4: 0 MLU_2

BO_ 838 MLU_2_RX_PDO4: 0 Vector__XXX

BO_ 902 MLU_2_TX_PDO5: 0 MLU_2

BO_ 966 MLU_2_TX_PDO6: 0 MLU_2

BO_ 1030 MLU_2_TX_PDO7: 0 MLU_2

BO_ 1094 MLU_2_TX_PDO8: 0 MLU_2

BO_ 1158 MLU_2_TX_PDO9: 0 MLU_2

BO_ 1222 MLU_2_TX_PDO10: 0 MLU_2

BO_ 1286 MLU_2_TX_PDO11: 0 MLU_2

BO_ 1350 MLU_2_TX_PDO12: 0 MLU_2

BO_ 1414 MLU_2_SDO_Resp: 8 MLU_2
 SG_ MLU_2_SDO_RespCode : 12|4@1+ (1,0) [0|0] ""  TelemetryNode
 SG_ MLU_2_SDO_ID M : 0|12@1+ (1,0) [0|4095] ""  TelemetryNode

BO_ 1478 MLU_2_SDO_Req_Up: 8 TelemetryNode
 SG_ MLU_2_SDO_ID M : 0|12@1+ (1,0) [0|4095] ""  MLU_2

BO_ 1542 MLU_2_SDO_Req_Down: 2 TelemetryNode
 SG_ MLU_2_SDO_ID M : 0|12@1+ (1,0) [0|4095] ""  MLU_2

BO_ 1798 MLU_2_Heartbeat: 1 MLU_2
 SG_ MLU_2_NodeState : 0|8@1+ (1,0) [0|0] ""  Master,TelemetryNode

BO_ 1862 MLU_2_BTL_TX: 8 MLU_2

BO_ 1926 MLU_2_BTL_RX: 8 TelemetryNode

BO_ 135 MLU_3_EMCY: 4 MLU_3

BO_ 391 MLU_3_TX_PDO1: 0 MLU_3

BO_ 455 MLU_3_RX_PDO1: 0 Vector__XXX

BO_ 519 MLU_3_TX_PDO2: 0 MLU_3

BO_ 583 MLU_3_RX_PDO2: 0 Vector__XXX

BO_ 647 MLU_3_TX_PDO3: 0 MLU_3

BO_ 711 MLU_3_RX_PDO3: 0 Vector__XXX

BO_ 775 MLU_3_TX_PDO4: 0 MLU_3

BO_ 839 MLU_3_RX_PDO4: 0 Vector__XXX

BO_ 903 MLU_3_TX_PDO5: 0 MLU_3

BO_ 967 MLU_3_TX_PDO6: 0 MLU_3

BO_ 1031 MLU_3_TX_PDO7: 0 MLU_3

BO_ 1095 MLU_3_TX_PDO8: 0 MLU_3

BO_ 1159 MLU_3_TX_PDO9: 0 MLU_3

BO_ 1223 MLU_3_TX_PDO10: 0 MLU_3

BO_ 1287 MLU_3_TX_PDO11: 0 MLU_3

BO_ 1351 MLU_3_TX_PDO12: 0 MLU_3

BO_ 1415 MLU_3_SDO_Resp: 8 MLU_3
 SG_ MLU_3_SDO_RespCode : 12|4@1+ (1,0) [0|0] ""  TelemetryNode
 SG_ MLU_3_SDO_ID M : 0|12@1+ (1,0) [0|4095] ""  TelemetryNode

BO_ 1479 MLU_3_SDO_Req_Up: 8 TelemetryNode
 SG_ MLU_3_SDO_ID M : 0|12@1+ (1,0) [0|4095] ""  MLU_3

BO_ 1543 MLU_3_SDO_Req_Down: 2 TelemetryNode
 SG_ MLU_3_SDO_ID M : 0|12@1+ (1,0) [0|4095] ""  MLU_3

BO_ 1799 MLU_3_Heartbeat: 1 MLU_3
 SG_ MLU_3_NodeState : 0|8@1+ (1,0) [0|0] ""  Master,TelemetryNode

BO_ 1863 MLU_3_BTL_TX: 8 MLU_3

BO_ 1927 MLU_3_BTL_RX: 8 TelemetryNode

BO_ 136 MLU_4_EMCY: 4 MLU_4

BO_ 392 MLU_4_TX_PDO1: 0 MLU_4

BO_ 456 MLU_4_RX_PDO1: 0 Vector__XXX

BO_ 520 MLU_4_TX_PDO2: 0 MLU_4

BO_ 584 MLU_4_RX_PDO2: 0 Vector__XXX

BO_ 648 MLU_4_TX_PDO3: 0 MLU_4

BO_ 712 MLU_4_RX_PDO3: 0 Vector__XXX

BO_ 776 MLU_4_TX_PDO4: 0 MLU_4

BO_ 840 MLU_4_RX_PDO4: 0 Vector__XXX

BO_ 904 MLU_4_TX_PDO5: 0 MLU_4

BO_ 968 MLU_4_TX_PDO6: 0 MLU_4

BO_ 1032 MLU_4_TX_PDO7: 0 MLU_4

BO_ 1096 MLU_4_TX_PDO8: 0 MLU_4

BO_ 1160 MLU_4_TX_PDO9: 0 MLU_4

BO_ 1224 MLU_4_TX_PDO10: 0 MLU_4

BO_ 1288 MLU_4_TX_PDO11: 0 MLU_4

BO_ 1352 MLU_4_TX_PDO12: 0 MLU_4

BO_ 1416 MLU_4_SDO_Resp: 8 MLU_4
 SG_ MLU_4_SDO_RespCode : 12|4@1+ (1,0) [0|0] ""  TelemetryNode
 SG_ MLU_4_SDO_ID M : 0|12@1+ (1,0) [0|4095] ""  TelemetryNode

BO_ 1480 MLU_4_SDO_Req_Up: 8 TelemetryNode
 SG_ MLU_4_SDO_ID M : 0|12@1+ (1,0) [0|4095] ""  MLU_4

BO_ 1544 MLU_4_SDO_Req_Down: 2 TelemetryNode
 SG_ MLU_4_SDO_ID M : 0|12@1+ (1,0) [0|4095] ""  MLU_4

BO_ 1800 MLU_4_Heartbeat: 1 MLU_4
 SG_ MLU_4_NodeState : 0|8@1+ (1,0) [0|0] ""  Master,TelemetryNode

BO_ 1864 MLU_4_BTL_TX: 8 MLU_4

BO_ 1928 MLU_4_BTL_RX: 8 TelemetryNode

BO_ 137 MLU_5_EMCY: 4 MLU_5

BO_ 393 MLU_5_TX_PDO1: 0 MLU_5

BO_ 457 MLU_5_RX_PDO1: 0 Vector__XXX

BO_ 521 MLU_5_TX_PDO2: 0 MLU_5

BO_ 585 MLU_5_RX_PDO2: 0 Vector__XXX

BO_ 649 MLU_5_TX_PDO3: 0 MLU_5

BO_ 713 MLU_5_RX_PDO3: 0 Vector__XXX

BO_ 777 MLU_5_TX_PDO4: 0 MLU_5

BO_ 841 MLU_5_RX_PDO4: 0 Vector__XXX

BO_ 905 MLU_5_TX_PDO5: 0 MLU_5

BO_ 969 MLU_5_TX_PDO6: 0 MLU_5

BO_ 1033 MLU_5_TX_PDO7: 0 MLU_5

BO_ 1097 MLU_5_TX_PDO8: 0 MLU_5

BO_ 1161 MLU_5_TX_PDO9: 0 MLU_5

BO_ 1225 MLU_5_TX_PDO10: 0 MLU_5

BO_ 1289 MLU_5_TX_PDO11: 0 MLU_5

BO_ 1353 MLU_5_TX_PDO12: 0 MLU_5

BO_ 1417 MLU_5_SDO_Resp: 8 MLU_5
 SG_ MLU_5_SDO_RespCode : 12|4@1+ (1,0) [0|0] ""  TelemetryNode
 SG_ MLU_5_SDO_ID M : 0|12@1+ (1,0) [0|4095] ""  TelemetryNode

BO_ 1481 MLU_5_SDO_Req_Up: 8 TelemetryNode
 SG_ MLU_5_SDO_ID M : 0|12@1+ (1,0) [0|4095] ""  MLU_5

BO_ 1545 MLU_5_SDO_Req_Down: 2 TelemetryNode
 SG_ MLU_5_SDO_ID M : 0|12@1+ (1,0) [0|4095] ""  MLU_5

BO_ 1801 MLU_5_Heartbeat: 1 MLU_5
 SG_ MLU_5_NodeState : 0|8@1+ (1,0) [0|0] ""  Master,TelemetryNode

BO_ 1865 MLU_5_BTL_TX: 8 MLU_5

BO_ 1929 MLU_5_BTL_RX: 8 TelemetryNode

BO_ 144 MLU_6_EMCY: 4 MLU_6

BO_ 400 MLU_6_TX_PDO1: 0 MLU_6

BO_ 464 MLU_6_RX_PDO1: 0 Vector__XXX

BO_ 528 MLU_6_TX_PDO2: 0 MLU_6

BO_ 592 MLU_6_RX_PDO2: 0 Vector__XXX

BO_ 656 MLU_6_TX_PDO3: 0 MLU_6

BO_ 720 MLU_6_RX_PDO3: 0 Vector__XXX

BO_ 784 MLU_6_TX_PDO4: 0 MLU_6

BO_ 848 MLU_6_RX_PDO4: 0 Vector__XXX

BO_ 912 MLU_6_TX_PDO5: 0 MLU_6

BO_ 976 MLU_6_TX_PDO6: 0 MLU_6

BO_ 1040 MLU_6_TX_PDO7: 0 MLU_6

BO_ 1104 MLU_6_TX_PDO8: 0 MLU_6

BO_ 1168 MLU_6_TX_PDO9: 0 MLU_6

BO_ 1232 MLU_6_TX_PDO10: 0 MLU_6

BO_ 1296 MLU_6_TX_PDO11: 0 MLU_6

BO_ 1360 MLU_6_TX_PDO12: 0 MLU_6

BO_ 1424 MLU_6_SDO_Resp: 8 MLU_6
 SG_ MLU_6_SDO_RespCode : 12|4@1+ (1,0) [0|0] ""  TelemetryNode
 SG_ MLU_6_SDO_ID M : 0|12@1+ (1,0) [0|4095] ""  TelemetryNode

BO_ 1488 MLU_6_SDO_Req_Up: 8 TelemetryNode
 SG_ MLU_6_SDO_ID M : 0|12@1+ (1,0) [0|4095] ""  MLU_6

BO_ 1552 MLU_6_SDO_Req_Down: 2 TelemetryNode
 SG_ MLU_6_SDO_ID M : 0|12@1+ (1,0) [0|4095] ""  MLU_6

BO_ 1808 MLU_6_Heartbeat: 1 MLU_6
 SG_ MLU_6_NodeState : 0|8@1+ (1,0) [0|0] ""  Master,TelemetryNode

BO_ 1872 MLU_6_BTL_TX: 8 MLU_6

BO_ 1936 MLU_6_BTL_RX: 8 TelemetryNode

CM_ BU_ TelemetryNode "CANzero SDO Client Node.";
CM_ BU_ Master "CANzero NMT Master Node.";
CM_ BU_ SENSOR "SENSOR:0x1
Node-ID 0x1";
CM_ BU_ PDU "PowerDistributionUnit
Node-ID 0x2";
CM_ BU_ CLU "CentralLevitationalUnit
Node-ID 0x3";
CM_ BU_ BRAKE "BrakeECU
Node-ID 0x4";
CM_ BU_ MLU_1 "ModularLevitationalUnit-1
Node-ID 0x5";
CM_ BU_ MLU_2 "ModularLevitationalUnit-2
Node-ID 0x6";
CM_ BU_ MLU_3 "ModularLevitationalUnit-3
Node-ID 0x7";
CM_ BU_ MLU_4 "ModularLevitationalUnit-4
Node-ID 0x8";
CM_ BU_ MLU_5 "ModularLevitationalUnit-5
Node-ID 0x9";
CM_ BU_ MLU_6 "ModularLevitationalUnit-6
Node-ID 0x10";
CM_ BO_ 2 "CANzero NMT message sent by NMT master.";
CM_ SG_ 2 CANzero_NMT_Node "CANzero NMT Node-ID of master request.";
CM_ SG_ 2 CANzero_NMT_State "CANzero NMT State Request by master.";
CM_ BO_ 122 "CANzero Sync message. Not used yet, just a placeholder for future versions.";
CM_ BO_ 123 "CANzero Timestamp message. Not used yet, just a placeholder for future versions.";
CM_ BO_ 129 "Emergency message of node SENSOR with Node-ID 0x1";
CM_ BO_ 385 "Transmit PDO 1 of node SENSOR with Node-ID 0x1";
CM_ BO_ 449 "Receive PDO 1 of node SENSOR with Node-ID 0x1";
CM_ BO_ 513 "Transmit PDO 2 of node SENSOR with Node-ID 0x1";
CM_ BO_ 577 "Receive PDO 2 of node SENSOR with Node-ID 0x1";
CM_ BO_ 641 "Transmit PDO 3 of node SENSOR with Node-ID 0x1";
CM_ BO_ 705 "Receive PDO 3 of node SENSOR with Node-ID 0x1";
CM_ BO_ 769 "Transmit PDO 4 of node SENSOR with Node-ID 0x1";
CM_ BO_ 833 "Receive PDO 4 of node SENSOR with Node-ID 0x1";
CM_ BO_ 897 "Transmit PDO 5 of node SENSOR with Node-ID 0x1";
CM_ BO_ 961 "Transmit PDO 6 of node SENSOR with Node-ID 0x1";
CM_ BO_ 1025 "Transmit PDO 7 of node SENSOR with Node-ID 0x1";
CM_ BO_ 1089 "Transmit PDO 8 of node SENSOR with Node-ID 0x1";
CM_ BO_ 1153 "Transmit PDO 9 of node SENSOR with Node-ID 0x1";
CM_ BO_ 1217 "Transmit PDO 10 of node SENSOR with Node-ID 0x1";
CM_ BO_ 1281 "Transmit PDO 11 of node SENSOR with Node-ID 0x1";
CM_ BO_ 1345 "Transmit PDO 12 of node SENSOR with Node-ID 0x1";
CM_ BO_ 1409 "DO NOT CHANGE ANYTHING HERE!
SDO Response of node SENSOR with Node-ID 0x1";
CM_ SG_ 1409 SENSOR_SDO_RespCode "Response code of SDO access.";
CM_ SG_ 1409 SENSOR_SDO_ID "Specifies SDO-ID of SENSOR";
CM_ BO_ 1473 "DO NOT CHANGE ANYTHING HERE!
SDO Request Upload to node SENSOR with Node-ID 0x1";
CM_ SG_ 1473 SENSOR_SDO_ID "Specifies SDO-ID of SENSOR";
CM_ BO_ 1537 "DO NOT CHANGE ANYTHING HERE!
SDO Request Download from node SENSOR with Node-ID 0x1";
CM_ SG_ 1537 SENSOR_SDO_ID "Specifies SDO-ID of SENSOR";
CM_ BO_ 1793 "Heartbeat of node SENSOR with Node-ID 0x1";
CM_ SG_ 1793 SENSOR_NodeState "Heartbeat status of node SENSOR";
CM_ BO_ 1857 "Bootloader transmit from node SENSOR with Node-ID 0x1";
CM_ BO_ 1921 "Bootloader receive by node SENSOR with Node-ID 0x1";
CM_ BO_ 130 "Emergency message of node PDU with Node-ID 0x2";
CM_ BO_ 386 "Transmit PDO 1 of node PDU with Node-ID 0x2";
CM_ BO_ 450 "Receive PDO 1 of node PDU with Node-ID 0x2";
CM_ BO_ 514 "Transmit PDO 2 of node PDU with Node-ID 0x2";
CM_ BO_ 578 "Receive PDO 2 of node PDU with Node-ID 0x2";
CM_ BO_ 642 "Transmit PDO 3 of node PDU with Node-ID 0x2";
CM_ BO_ 706 "Receive PDO 3 of node PDU with Node-ID 0x2";
CM_ BO_ 770 "Transmit PDO 4 of node PDU with Node-ID 0x2";
CM_ BO_ 834 "Receive PDO 4 of node PDU with Node-ID 0x2";
CM_ BO_ 898 "Transmit PDO 5 of node PDU with Node-ID 0x2";
CM_ BO_ 962 "Transmit PDO 6 of node PDU with Node-ID 0x2";
CM_ BO_ 1026 "Transmit PDO 7 of node PDU with Node-ID 0x2";
CM_ BO_ 1090 "Transmit PDO 8 of node PDU with Node-ID 0x2";
CM_ BO_ 1154 "Transmit PDO 9 of node PDU with Node-ID 0x2";
CM_ BO_ 1218 "Transmit PDO 10 of node PDU with Node-ID 0x2";
CM_ BO_ 1282 "Transmit PDO 11 of node PDU with Node-ID 0x2";
CM_ BO_ 1346 "Transmit PDO 12 of node PDU with Node-ID 0x2";
CM_ BO_ 1410 "DO NOT CHANGE ANYTHING HERE!
SDO Response of node PDU with Node-ID 0x2";
CM_ SG_ 1410 PDU_SDO_RespCode "Response code of SDO access.";
CM_ SG_ 1410 PDU_SDO_ID "Specifies SDO-ID of PDU";
CM_ BO_ 1474 "DO NOT CHANGE ANYTHING HERE!
SDO Request Upload to node PDU with Node-ID 0x2";
CM_ SG_ 1474 PDU_SDO_ID "Specifies SDO-ID of PDU";
CM_ BO_ 1538 "DO NOT CHANGE ANYTHING HERE!
SDO Request Download from node PDU with Node-ID 0x2";
CM_ SG_ 1538 PDU_SDO_ID "Specifies SDO-ID of PDU";
CM_ BO_ 1794 "Heartbeat of node PDU with Node-ID 0x2";
CM_ SG_ 1794 PDU_NodeState "Heartbeat status of node PDU";
CM_ BO_ 1858 "Bootloader transmit from node PDU with Node-ID 0x2";
CM_ BO_ 1922 "Bootloader receive by node PDU with Node-ID 0x2";
CM_ BO_ 131 "Emergency message of node CLU with Node-ID 0x3";
CM_ BO_ 387 "Transmit PDO 1 of node CLU with Node-ID 0x3";
CM_ BO_ 451 "Receive PDO 1 of node CLU with Node-ID 0x3";
CM_ BO_ 515 "Transmit PDO 2 of node CLU with Node-ID 0x3";
CM_ BO_ 579 "Receive PDO 2 of node CLU with Node-ID 0x3";
CM_ BO_ 643 "Transmit PDO 3 of node CLU with Node-ID 0x3";
CM_ BO_ 707 "Receive PDO 3 of node CLU with Node-ID 0x3";
CM_ BO_ 771 "Transmit PDO 4 of node CLU with Node-ID 0x3";
CM_ BO_ 835 "Receive PDO 4 of node CLU with Node-ID 0x3";
CM_ BO_ 899 "Transmit PDO 5 of node CLU with Node-ID 0x3";
CM_ BO_ 963 "Transmit PDO 6 of node CLU with Node-ID 0x3";
CM_ BO_ 1027 "Transmit PDO 7 of node CLU with Node-ID 0x3";
CM_ BO_ 1091 "Transmit PDO 8 of node CLU with Node-ID 0x3";
CM_ BO_ 1155 "Transmit PDO 9 of node CLU with Node-ID 0x3";
CM_ BO_ 1219 "Transmit PDO 10 of node CLU with Node-ID 0x3";
CM_ BO_ 1283 "Transmit PDO 11 of node CLU with Node-ID 0x3";
CM_ BO_ 1347 "Transmit PDO 12 of node CLU with Node-ID 0x3";
CM_ BO_ 1411 "DO NOT CHANGE ANYTHING HERE!
SDO Response of node CLU with Node-ID 0x3";
CM_ SG_ 1411 CLU_SDO_RespCode "Response code of SDO access.";
CM_ SG_ 1411 CLU_SDO_ID "Specifies SDO-ID of CLU";
CM_ BO_ 1475 "DO NOT CHANGE ANYTHING HERE!
SDO Request Upload to node CLU with Node-ID 0x3";
CM_ SG_ 1475 CLU_SDO_ID "Specifies SDO-ID of CLU";
CM_ BO_ 1539 "DO NOT CHANGE ANYTHING HERE!
SDO Request Download from node CLU with Node-ID 0x3";
CM_ SG_ 1539 CLU_SDO_ID "Specifies SDO-ID of CLU";
CM_ BO_ 1795 "Heartbeat of node CLU with Node-ID 0x3";
CM_ SG_ 1795 CLU_NodeState "Heartbeat status of node CLU";
CM_ BO_ 1859 "Bootloader transmit from node CLU with Node-ID 0x3";
CM_ BO_ 1923 "Bootloader receive by node CLU with Node-ID 0x3";
CM_ BO_ 132 "Emergency message of node BRAKE with Node-ID 0x4";
CM_ BO_ 388 "Transmit PDO 1 of node BRAKE with Node-ID 0x4";
CM_ BO_ 452 "Receive PDO 1 of node BRAKE with Node-ID 0x4";
CM_ BO_ 516 "Transmit PDO 2 of node BRAKE with Node-ID 0x4";
CM_ BO_ 580 "Receive PDO 2 of node BRAKE with Node-ID 0x4";
CM_ BO_ 644 "Transmit PDO 3 of node BRAKE with Node-ID 0x4";
CM_ BO_ 708 "Receive PDO 3 of node BRAKE with Node-ID 0x4";
CM_ BO_ 772 "Transmit PDO 4 of node BRAKE with Node-ID 0x4";
CM_ BO_ 836 "Receive PDO 4 of node BRAKE with Node-ID 0x4";
CM_ BO_ 900 "Transmit PDO 5 of node BRAKE with Node-ID 0x4";
CM_ BO_ 964 "Transmit PDO 6 of node BRAKE with Node-ID 0x4";
CM_ BO_ 1028 "Transmit PDO 7 of node BRAKE with Node-ID 0x4";
CM_ BO_ 1092 "Transmit PDO 8 of node BRAKE with Node-ID 0x4";
CM_ BO_ 1156 "Transmit PDO 9 of node BRAKE with Node-ID 0x4";
CM_ BO_ 1220 "Transmit PDO 10 of node BRAKE with Node-ID 0x4";
CM_ BO_ 1284 "Transmit PDO 11 of node BRAKE with Node-ID 0x4";
CM_ BO_ 1348 "Transmit PDO 12 of node BRAKE with Node-ID 0x4";
CM_ BO_ 1412 "DO NOT CHANGE ANYTHING HERE!
SDO Response of node BRAKE with Node-ID 0x4";
CM_ SG_ 1412 BRAKE_SDO_RespCode "Response code of SDO access.";
CM_ SG_ 1412 BRAKE_SDO_ID "Specifies SDO-ID of BRAKE";
CM_ BO_ 1476 "DO NOT CHANGE ANYTHING HERE!
SDO Request Upload to node BRAKE with Node-ID 0x4";
CM_ SG_ 1476 BRAKE_SDO_ID "Specifies SDO-ID of BRAKE";
CM_ BO_ 1540 "DO NOT CHANGE ANYTHING HERE!
SDO Request Download from node BRAKE with Node-ID 0x4";
CM_ SG_ 1540 BRAKE_SDO_ID "Specifies SDO-ID of BRAKE";
CM_ BO_ 1796 "Heartbeat of node BRAKE with Node-ID 0x4";
CM_ SG_ 1796 BRAKE_NodeState "Heartbeat status of node BRAKE";
CM_ BO_ 1860 "Bootloader transmit from node BRAKE with Node-ID 0x4";
CM_ BO_ 1924 "Bootloader receive by node BRAKE with Node-ID 0x4";
CM_ BO_ 133 "Emergency message of node MLU_1 with Node-ID 0x5";
CM_ BO_ 389 "Transmit PDO 1 of node MLU_1 with Node-ID 0x5";
CM_ BO_ 453 "Receive PDO 1 of node MLU_1 with Node-ID 0x5";
CM_ BO_ 517 "Transmit PDO 2 of node MLU_1 with Node-ID 0x5";
CM_ BO_ 581 "Receive PDO 2 of node MLU_1 with Node-ID 0x5";
CM_ BO_ 645 "Transmit PDO 3 of node MLU_1 with Node-ID 0x5";
CM_ BO_ 709 "Receive PDO 3 of node MLU_1 with Node-ID 0x5";
CM_ BO_ 773 "Transmit PDO 4 of node MLU_1 with Node-ID 0x5";
CM_ BO_ 837 "Receive PDO 4 of node MLU_1 with Node-ID 0x5";
CM_ BO_ 901 "Transmit PDO 5 of node MLU_1 with Node-ID 0x5";
CM_ BO_ 965 "Transmit PDO 6 of node MLU_1 with Node-ID 0x5";
CM_ BO_ 1029 "Transmit PDO 7 of node MLU_1 with Node-ID 0x5";
CM_ BO_ 1093 "Transmit PDO 8 of node MLU_1 with Node-ID 0x5";
CM_ BO_ 1157 "Transmit PDO 9 of node MLU_1 with Node-ID 0x5";
CM_ BO_ 1221 "Transmit PDO 10 of node MLU_1 with Node-ID 0x5";
CM_ BO_ 1285 "Transmit PDO 11 of node MLU_1 with Node-ID 0x5";
CM_ BO_ 1349 "Transmit PDO 12 of node MLU_1 with Node-ID 0x5";
CM_ BO_ 1413 "DO NOT CHANGE ANYTHING HERE!
SDO Response of node MLU_1 with Node-ID 0x5";
CM_ SG_ 1413 MLU_1_SDO_RespCode "Response code of SDO access.";
CM_ SG_ 1413 MLU_1_SDO_ID "Specifies SDO-ID of MLU_1";
CM_ BO_ 1477 "DO NOT CHANGE ANYTHING HERE!
SDO Request Upload to node MLU_1 with Node-ID 0x5";
CM_ SG_ 1477 MLU_1_SDO_ID "Specifies SDO-ID of MLU_1";
CM_ BO_ 1541 "DO NOT CHANGE ANYTHING HERE!
SDO Request Download from node MLU_1 with Node-ID 0x5";
CM_ SG_ 1541 MLU_1_SDO_ID "Specifies SDO-ID of MLU_1";
CM_ BO_ 1797 "Heartbeat of node MLU_1 with Node-ID 0x5";
CM_ SG_ 1797 MLU_1_NodeState "Heartbeat status of node MLU_1";
CM_ BO_ 1861 "Bootloader transmit from node MLU_1 with Node-ID 0x5";
CM_ BO_ 1925 "Bootloader receive by node MLU_1 with Node-ID 0x5";
CM_ BO_ 134 "Emergency message of node MLU_2 with Node-ID 0x6";
CM_ BO_ 390 "Transmit PDO 1 of node MLU_2 with Node-ID 0x6";
CM_ BO_ 454 "Receive PDO 1 of node MLU_2 with Node-ID 0x6";
CM_ BO_ 518 "Transmit PDO 2 of node MLU_2 with Node-ID 0x6";
CM_ BO_ 582 "Receive PDO 2 of node MLU_2 with Node-ID 0x6";
CM_ BO_ 646 "Transmit PDO 3 of node MLU_2 with Node-ID 0x6";
CM_ BO_ 710 "Receive PDO 3 of node MLU_2 with Node-ID 0x6";
CM_ BO_ 774 "Transmit PDO 4 of node MLU_2 with Node-ID 0x6";
CM_ BO_ 838 "Receive PDO 4 of node MLU_2 with Node-ID 0x6";
CM_ BO_ 902 "Transmit PDO 5 of node MLU_2 with Node-ID 0x6";
CM_ BO_ 966 "Transmit PDO 6 of node MLU_2 with Node-ID 0x6";
CM_ BO_ 1030 "Transmit PDO 7 of node MLU_2 with Node-ID 0x6";
CM_ BO_ 1094 "Transmit PDO 8 of node MLU_2 with Node-ID 0x6";
CM_ BO_ 1158 "Transmit PDO 9 of node MLU_2 with Node-ID 0x6";
CM_ BO_ 1222 "Transmit PDO 10 of node MLU_2 with Node-ID 0x6";
CM_ BO_ 1286 "Transmit PDO 11 of node MLU_2 with Node-ID 0x6";
CM_ BO_ 1350 "Transmit PDO 12 of node MLU_2 with Node-ID 0x6";
CM_ BO_ 1414 "DO NOT CHANGE ANYTHING HERE!
SDO Response of node MLU_2 with Node-ID 0x6";
CM_ SG_ 1414 MLU_2_SDO_RespCode "Response code of SDO access.";
CM_ SG_ 1414 MLU_2_SDO_ID "Specifies SDO-ID of MLU_2";
CM_ BO_ 1478 "DO NOT CHANGE ANYTHING HERE!
SDO Request Upload to node MLU_2 with Node-ID 0x6";
CM_ SG_ 1478 MLU_2_SDO_ID "Specifies SDO-ID of MLU_2";
CM_ BO_ 1542 "DO NOT CHANGE ANYTHING HERE!
SDO Request Download from node MLU_2 with Node-ID 0x6";
CM_ SG_ 1542 MLU_2_SDO_ID "Specifies SDO-ID of MLU_2";
CM_ BO_ 1798 "Heartbeat of node MLU_2 with Node-ID 0x6";
CM_ SG_ 1798 MLU_2_NodeState "Heartbeat status of node MLU_2";
CM_ BO_ 1862 "Bootloader transmit from node MLU_2 with Node-ID 0x6";
CM_ BO_ 1926 "Bootloader receive by node MLU_2 with Node-ID 0x6";
CM_ BO_ 135 "Emergency message of node MLU_3 with Node-ID 0x7";
CM_ BO_ 391 "Transmit PDO 1 of node MLU_3 with Node-ID 0x7";
CM_ BO_ 455 "Receive PDO 1 of node MLU_3 with Node-ID 0x7";
CM_ BO_ 519 "Transmit PDO 2 of node MLU_3 with Node-ID 0x7";
CM_ BO_ 583 "Receive PDO 2 of node MLU_3 with Node-ID 0x7";
CM_ BO_ 647 "Transmit PDO 3 of node MLU_3 with Node-ID 0x7";
CM_ BO_ 711 "Receive PDO 3 of node MLU_3 with Node-ID 0x7";
CM_ BO_ 775 "Transmit PDO 4 of node MLU_3 with Node-ID 0x7";
CM_ BO_ 839 "Receive PDO 4 of node MLU_3 with Node-ID 0x7";
CM_ BO_ 903 "Transmit PDO 5 of node MLU_3 with Node-ID 0x7";
CM_ BO_ 967 "Transmit PDO 6 of node MLU_3 with Node-ID 0x7";
CM_ BO_ 1031 "Transmit PDO 7 of node MLU_3 with Node-ID 0x7";
CM_ BO_ 1095 "Transmit PDO 8 of node MLU_3 with Node-ID 0x7";
CM_ BO_ 1159 "Transmit PDO 9 of node MLU_3 with Node-ID 0x7";
CM_ BO_ 1223 "Transmit PDO 10 of node MLU_3 with Node-ID 0x7";
CM_ BO_ 1287 "Transmit PDO 11 of node MLU_3 with Node-ID 0x7";
CM_ BO_ 1351 "Transmit PDO 12 of node MLU_3 with Node-ID 0x7";
CM_ BO_ 1415 "DO NOT CHANGE ANYTHING HERE!
SDO Response of node MLU_3 with Node-ID 0x7";
CM_ SG_ 1415 MLU_3_SDO_RespCode "Response code of SDO access.";
CM_ SG_ 1415 MLU_3_SDO_ID "Specifies SDO-ID of MLU_3";
CM_ BO_ 1479 "DO NOT CHANGE ANYTHING HERE!
SDO Request Upload to node MLU_3 with Node-ID 0x7";
CM_ SG_ 1479 MLU_3_SDO_ID "Specifies SDO-ID of MLU_3";
CM_ BO_ 1543 "DO NOT CHANGE ANYTHING HERE!
SDO Request Download from node MLU_3 with Node-ID 0x7";
CM_ SG_ 1543 MLU_3_SDO_ID "Specifies SDO-ID of MLU_3";
CM_ BO_ 1799 "Heartbeat of node MLU_3 with Node-ID 0x7";
CM_ SG_ 1799 MLU_3_NodeState "Heartbeat status of node MLU_3";
CM_ BO_ 1863 "Bootloader transmit from node MLU_3 with Node-ID 0x7";
CM_ BO_ 1927 "Bootloader receive by node MLU_3 with Node-ID 0x7";
CM_ BO_ 136 "Emergency message of node MLU_4 with Node-ID 0x8";
CM_ BO_ 392 "Transmit PDO 1 of node MLU_4 with Node-ID 0x8";
CM_ BO_ 456 "Receive PDO 1 of node MLU_4 with Node-ID 0x8";
CM_ BO_ 520 "Transmit PDO 2 of node MLU_4 with Node-ID 0x8";
CM_ BO_ 584 "Receive PDO 2 of node MLU_4 with Node-ID 0x8";
CM_ BO_ 648 "Transmit PDO 3 of node MLU_4 with Node-ID 0x8";
CM_ BO_ 712 "Receive PDO 3 of node MLU_4 with Node-ID 0x8";
CM_ BO_ 776 "Transmit PDO 4 of node MLU_4 with Node-ID 0x8";
CM_ BO_ 840 "Receive PDO 4 of node MLU_4 with Node-ID 0x8";
CM_ BO_ 904 "Transmit PDO 5 of node MLU_4 with Node-ID 0x8";
CM_ BO_ 968 "Transmit PDO 6 of node MLU_4 with Node-ID 0x8";
CM_ BO_ 1032 "Transmit PDO 7 of node MLU_4 with Node-ID 0x8";
CM_ BO_ 1096 "Transmit PDO 8 of node MLU_4 with Node-ID 0x8";
CM_ BO_ 1160 "Transmit PDO 9 of node MLU_4 with Node-ID 0x8";
CM_ BO_ 1224 "Transmit PDO 10 of node MLU_4 with Node-ID 0x8";
CM_ BO_ 1288 "Transmit PDO 11 of node MLU_4 with Node-ID 0x8";
CM_ BO_ 1352 "Transmit PDO 12 of node MLU_4 with Node-ID 0x8";
CM_ BO_ 1416 "DO NOT CHANGE ANYTHING HERE!
SDO Response of node MLU_4 with Node-ID 0x8";
CM_ SG_ 1416 MLU_4_SDO_RespCode "Response code of SDO access.";
CM_ SG_ 1416 MLU_4_SDO_ID "Specifies SDO-ID of MLU_4";
CM_ BO_ 1480 "DO NOT CHANGE ANYTHING HERE!
SDO Request Upload to node MLU_4 with Node-ID 0x8";
CM_ SG_ 1480 MLU_4_SDO_ID "Specifies SDO-ID of MLU_4";
CM_ BO_ 1544 "DO NOT CHANGE ANYTHING HERE!
SDO Request Download from node MLU_4 with Node-ID 0x8";
CM_ SG_ 1544 MLU_4_SDO_ID "Specifies SDO-ID of MLU_4";
CM_ BO_ 1800 "Heartbeat of node MLU_4 with Node-ID 0x8";
CM_ SG_ 1800 MLU_4_NodeState "Heartbeat status of node MLU_4";
CM_ BO_ 1864 "Bootloader transmit from node MLU_4 with Node-ID 0x8";
CM_ BO_ 1928 "Bootloader receive by node MLU_4 with Node-ID 0x8";
CM_ BO_ 137 "Emergency message of node MLU_5 with Node-ID 0x9";
CM_ BO_ 393 "Transmit PDO 1 of node MLU_5 with Node-ID 0x9";
CM_ BO_ 457 "Receive PDO 1 of node MLU_5 with Node-ID 0x9";
CM_ BO_ 521 "Transmit PDO 2 of node MLU_5 with Node-ID 0x9";
CM_ BO_ 585 "Receive PDO 2 of node MLU_5 with Node-ID 0x9";
CM_ BO_ 649 "Transmit PDO 3 of node MLU_5 with Node-ID 0x9";
CM_ BO_ 713 "Receive PDO 3 of node MLU_5 with Node-ID 0x9";
CM_ BO_ 777 "Transmit PDO 4 of node MLU_5 with Node-ID 0x9";
CM_ BO_ 841 "Receive PDO 4 of node MLU_5 with Node-ID 0x9";
CM_ BO_ 905 "Transmit PDO 5 of node MLU_5 with Node-ID 0x9";
CM_ BO_ 969 "Transmit PDO 6 of node MLU_5 with Node-ID 0x9";
CM_ BO_ 1033 "Transmit PDO 7 of node MLU_5 with Node-ID 0x9";
CM_ BO_ 1097 "Transmit PDO 8 of node MLU_5 with Node-ID 0x9";
CM_ BO_ 1161 "Transmit PDO 9 of node MLU_5 with Node-ID 0x9";
CM_ BO_ 1225 "Transmit PDO 10 of node MLU_5 with Node-ID 0x9";
CM_ BO_ 1289 "Transmit PDO 11 of node MLU_5 with Node-ID 0x9";
CM_ BO_ 1353 "Transmit PDO 12 of node MLU_5 with Node-ID 0x9";
CM_ BO_ 1417 "DO NOT CHANGE ANYTHING HERE!
SDO Response of node MLU_5 with Node-ID 0x9";
CM_ SG_ 1417 MLU_5_SDO_RespCode "Response code of SDO access.";
CM_ SG_ 1417 MLU_5_SDO_ID "Specifies SDO-ID of MLU_5";
CM_ BO_ 1481 "DO NOT CHANGE ANYTHING HERE!
SDO Request Upload to node MLU_5 with Node-ID 0x9";
CM_ SG_ 1481 MLU_5_SDO_ID "Specifies SDO-ID of MLU_5";
CM_ BO_ 1545 "DO NOT CHANGE ANYTHING HERE!
SDO Request Download from node MLU_5 with Node-ID 0x9";
CM_ SG_ 1545 MLU_5_SDO_ID "Specifies SDO-ID of MLU_5";
CM_ BO_ 1801 "Heartbeat of node MLU_5 with Node-ID 0x9";
CM_ SG_ 1801 MLU_5_NodeState "Heartbeat status of node MLU_5";
CM_ BO_ 1865 "Bootloader transmit from node MLU_5 with Node-ID 0x9";
CM_ BO_ 1929 "Bootloader receive by node MLU_5 with Node-ID 0x9";
CM_ BO_ 144 "Emergency message of node MLU_6 with Node-ID 0x10";
CM_ BO_ 400 "Transmit PDO 1 of node MLU_6 with Node-ID 0x10";
CM_ BO_ 464 "Receive PDO 1 of node MLU_6 with Node-ID 0x10";
CM_ BO_ 528 "Transmit PDO 2 of node MLU_6 with Node-ID 0x10";
CM_ BO_ 592 "Receive PDO 2 of node MLU_6 with Node-ID 0x10";
CM_ BO_ 656 "Transmit PDO 3 of node MLU_6 with Node-ID 0x10";
CM_ BO_ 720 "Receive PDO 3 of node MLU_6 with Node-ID 0x10";
CM_ BO_ 784 "Transmit PDO 4 of node MLU_6 with Node-ID 0x10";
CM_ BO_ 848 "Receive PDO 4 of node MLU_6 with Node-ID 0x10";
CM_ BO_ 912 "Transmit PDO 5 of node MLU_6 with Node-ID 0x10";
CM_ BO_ 976 "Transmit PDO 6 of node MLU_6 with Node-ID 0x10";
CM_ BO_ 1040 "Transmit PDO 7 of node MLU_6 with Node-ID 0x10";
CM_ BO_ 1104 "Transmit PDO 8 of node MLU_6 with Node-ID 0x10";
CM_ BO_ 1168 "Transmit PDO 9 of node MLU_6 with Node-ID 0x10";
CM_ BO_ 1232 "Transmit PDO 10 of node MLU_6 with Node-ID 0x10";
CM_ BO_ 1296 "Transmit PDO 11 of node MLU_6 with Node-ID 0x10";
CM_ BO_ 1360 "Transmit PDO 12 of node MLU_6 with Node-ID 0x10";
CM_ BO_ 1424 "DO NOT CHANGE ANYTHING HERE!
SDO Response of node MLU_6 with Node-ID 0x10";
CM_ SG_ 1424 MLU_6_SDO_RespCode "Response code of SDO access.";
CM_ SG_ 1424 MLU_6_SDO_ID "Specifies SDO-ID of MLU_6";
CM_ BO_ 1488 "DO NOT CHANGE ANYTHING HERE!
SDO Request Upload to node MLU_6 with Node-ID 0x10";
CM_ SG_ 1488 MLU_6_SDO_ID "Specifies SDO-ID of MLU_6";
CM_ BO_ 1552 "DO NOT CHANGE ANYTHING HERE!
SDO Request Download from node MLU_6 with Node-ID 0x10";
CM_ SG_ 1552 MLU_6_SDO_ID "Specifies SDO-ID of MLU_6";
CM_ BO_ 1808 "Heartbeat of node MLU_6 with Node-ID 0x10";
CM_ SG_ 1808 MLU_6_NodeState "Heartbeat status of node MLU_6";
CM_ BO_ 1872 "Bootloader transmit from node MLU_6 with Node-ID 0x10";
CM_ BO_ 1936 "Bootloader receive by node MLU_6 with Node-ID 0x10";
BA_DEF_ SG_  "GenSigSendType" ENUM  "Cyclic","OnWrite","OnWriteWithRepetition","OnChange","OnChangeWithRepetition","IfActive","IfActiveWithRepetition","NoSigSendType";
BA_DEF_ BO_  "GenMsgSendType" ENUM  "Cyclic","not_used","not_used","not_used","not_used","Cyclic","not_used","IfActive","NoMsgSendType";
BA_DEF_  "BusType" STRING ;
BA_DEF_  "DBName" STRING ;
BA_DEF_ BO_  "GenMsgCycleTime" INT 2 50000;
BA_DEF_ BO_  "GenMsgDelayTime" INT 1 1000;
BA_DEF_ BO_  "GenMsgNrOfRepetitions" INT 1 999999;
BA_DEF_  "CANzero_ProtocolVersion" STRING ;
BA_DEF_  "CANzero_DBCVersion" INT 0 16777215;
BA_DEF_  "CANzero_SDOClientName" STRING ;
BA_DEF_  "CANzero_NMTMasterName" STRING ;
BA_DEF_ BU_  "CANzero_NodeID" HEX 0 63;
BA_DEF_ SG_  "CANzero_SDO_AccessType" ENUM  "Read Write","Read Only","Write Only";
BA_DEF_DEF_  "GenSigSendType" "Cyclic";
BA_DEF_DEF_  "GenMsgSendType" "NoMsgSendType";
BA_DEF_DEF_  "BusType" "";
BA_DEF_DEF_  "DBName" "";
BA_DEF_DEF_  "GenMsgCycleTime" 100;
BA_DEF_DEF_  "GenMsgDelayTime" 1;
BA_DEF_DEF_  "GenMsgNrOfRepetitions" 1;
BA_DEF_DEF_  "CANzero_ProtocolVersion" "";
BA_DEF_DEF_  "CANzero_DBCVersion" 0;
BA_DEF_DEF_  "CANzero_SDOClientName" "Master";
BA_DEF_DEF_  "CANzero_NMTMasterName" "Master";
BA_DEF_DEF_  "CANzero_NodeID" 0;
BA_DEF_DEF_  "CANzero_SDO_AccessType" "Read Write";
BA_ "CANzero_SDOClientName" "TelemetryNode";
BA_ "CANzero_DBCVersion" 27;
BA_ "CANzero_ProtocolVersion" "V1.0";
BA_ "BusType" "CAN";
BA_ "DBName" "database";
BA_ "CANzero_NodeID" BU_ SENSOR 1;
BA_ "CANzero_NodeID" BU_ PDU 2;
BA_ "CANzero_NodeID" BU_ CLU 3;
BA_ "CANzero_NodeID" BU_ BRAKE 4;
BA_ "CANzero_NodeID" BU_ MLU_1 5;
BA_ "CANzero_NodeID" BU_ MLU_2 6;
BA_ "CANzero_NodeID" BU_ MLU_3 7;
BA_ "CANzero_NodeID" BU_ MLU_4 8;
BA_ "CANzero_NodeID" BU_ MLU_5 9;
BA_ "CANzero_NodeID" BU_ MLU_6 16;
VAL_ 2 CANzero_NMT_Node 0 "All" 1 "SENSOR" 2 "PDU" 3 "CLU" 4 "BRAKE" 5 "MLU_1" 6 "MLU_2" 7 "MLU_3" 8 "MLU_4" 9 "MLU_5" 16 "MLU_6" ;
VAL_ 2 CANzero_NMT_State 1 "Start Remote Node" 2 "Stop Remote Node" 128 "Enter Pre-Operational" 129 "Reset" ;
VAL_ 1409 SENSOR_SDO_RespCode 5 "ERR: Out of range" 4 "ERR: No access in this state" 3 "ERR: Read only object" 2 "ERR: Write only object" 1 "ERR: Non existing object" 0 "OK" ;
VAL_ 1409 SENSOR_SDO_ID 0 "Reserved" ;
VAL_ 1473 SENSOR_SDO_ID 0 "Reserved" ;
VAL_ 1537 SENSOR_SDO_ID 0 "Reserved" ;
VAL_ 1793 SENSOR_NodeState 0 "Bootup" 4 "Stopped" 5 "Operational" 127 "Pre-Operational" ;
VAL_ 1410 PDU_SDO_RespCode 5 "ERR: Out of range" 4 "ERR: No access in this state" 3 "ERR: Read only object" 2 "ERR: Write only object" 1 "ERR: Non existing object" 0 "OK" ;
VAL_ 1410 PDU_SDO_ID 0 "Reserved" ;
VAL_ 1474 PDU_SDO_ID 0 "Reserved" ;
VAL_ 1538 PDU_SDO_ID 0 "Reserved" ;
VAL_ 1794 PDU_NodeState 0 "Bootup" 4 "Stopped" 5 "Operational" 127 "Pre-Operational" ;
VAL_ 1411 CLU_SDO_RespCode 5 "ERR: Out of range" 4 "ERR: No access in this state" 3 "ERR: Read only object" 2 "ERR: Write only object" 1 "ERR: Non existing object" 0 "OK" ;
VAL_ 1411 CLU_SDO_ID 0 "Reserved" ;
VAL_ 1475 CLU_SDO_ID 0 "Reserved" ;
VAL_ 1539 CLU_SDO_ID 0 "Reserved" ;
VAL_ 1795 CLU_NodeState 0 "Bootup" 4 "Stopped" 5 "Operational" 127 "Pre-Operational" ;
VAL_ 1412 BRAKE_SDO_RespCode 5 "ERR: Out of range" 4 "ERR: No access in this state" 3 "ERR: Read only object" 2 "ERR: Write only object" 1 "ERR: Non existing object" 0 "OK" ;
VAL_ 1412 BRAKE_SDO_ID 0 "Reserved" ;
VAL_ 1476 BRAKE_SDO_ID 0 "Reserved" ;
VAL_ 1540 BRAKE_SDO_ID 0 "Reserved" ;
VAL_ 1796 BRAKE_NodeState 0 "Bootup" 4 "Stopped" 5 "Operational" 127 "Pre-Operational" ;
VAL_ 1413 MLU_1_SDO_RespCode 5 "ERR: Out of range" 4 "ERR: No access in this state" 3 "ERR: Read only object" 2 "ERR: Write only object" 1 "ERR: Non existing object" 0 "OK" ;
VAL_ 1413 MLU_1_SDO_ID 0 "Reserved" ;
VAL_ 1477 MLU_1_SDO_ID 0 "Reserved" ;
VAL_ 1541 MLU_1_SDO_ID 0 "Reserved" ;
VAL_ 1797 MLU_1_NodeState 0 "Bootup" 4 "Stopped" 5 "Operational" 127 "Pre-Operational" ;
VAL_ 1414 MLU_2_SDO_RespCode 5 "ERR: Out of range" 4 "ERR: No access in this state" 3 "ERR: Read only object" 2 "ERR: Write only object" 1 "ERR: Non existing object" 0 "OK" ;
VAL_ 1414 MLU_2_SDO_ID 0 "Reserved" ;
VAL_ 1478 MLU_2_SDO_ID 0 "Reserved" ;
VAL_ 1542 MLU_2_SDO_ID 0 "Reserved" ;
VAL_ 1798 MLU_2_NodeState 0 "Bootup" 4 "Stopped" 5 "Operational" 127 "Pre-Operational" ;
VAL_ 1415 MLU_3_SDO_RespCode 5 "ERR: Out of range" 4 "ERR: No access in this state" 3 "ERR: Read only object" 2 "ERR: Write only object" 1 "ERR: Non existing object" 0 "OK" ;
VAL_ 1415 MLU_3_SDO_ID 0 "Reserved" ;
VAL_ 1479 MLU_3_SDO_ID 0 "Reserved" ;
VAL_ 1543 MLU_3_SDO_ID 0 "Reserved" ;
VAL_ 1799 MLU_3_NodeState 0 "Bootup" 4 "Stopped" 5 "Operational" 127 "Pre-Operational" ;
VAL_ 1416 MLU_4_SDO_RespCode 5 "ERR: Out of range" 4 "ERR: No access in this state" 3 "ERR: Read only object" 2 "ERR: Write only object" 1 "ERR: Non existing object" 0 "OK" ;
VAL_ 1416 MLU_4_SDO_ID 0 "Reserved" ;
VAL_ 1480 MLU_4_SDO_ID 0 "Reserved" ;
VAL_ 1544 MLU_4_SDO_ID 0 "Reserved" ;
VAL_ 1800 MLU_4_NodeState 0 "Bootup" 4 "Stopped" 5 "Operational" 127 "Pre-Operational" ;
VAL_ 1417 MLU_5_SDO_RespCode 5 "ERR: Out of range" 4 "ERR: No access in this state" 3 "ERR: Read only object" 2 "ERR: Write only object" 1 "ERR: Non existing object" 0 "OK" ;
VAL_ 1417 MLU_5_SDO_ID 0 "Reserved" ;
VAL_ 1481 MLU_5_SDO_ID 0 "Reserved" ;
VAL_ 1545 MLU_5_SDO_ID 0 "Reserved" ;
VAL_ 1801 MLU_5_NodeState 0 "Bootup" 4 "Stopped" 5 "Operational" 127 "Pre-Operational" ;
VAL_ 1424 MLU_6_SDO_RespCode 5 "ERR: Out of range" 4 "ERR: No access in this state" 3 "ERR: Read only object" 2 "ERR: Write only object" 1 "ERR: Non existing object" 0 "OK" ;
VAL_ 1424 MLU_6_SDO_ID 0 "Reserved" ;
VAL_ 1488 MLU_6_SDO_ID 0 "Reserved" ;
VAL_ 1552 MLU_6_SDO_ID 0 "Reserved" ;
VAL_ 1808 MLU_6_NodeState 0 "Bootup" 4 "Stopped" 5 "Operational" 127 "Pre-Operational" ;
