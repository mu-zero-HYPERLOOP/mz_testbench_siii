VERSION ""

NS_ :

BS_:

BU_:

BO_ 2148592864 BMS_Status: 2 Vector__XXX
 SG_ BMS_Payload : 0|64@1+ (1,0) [0|1.84467440737096E+019] "" Vector__XXX
