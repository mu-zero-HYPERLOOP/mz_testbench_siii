VERSION ""

NS_ :

BS_:

BU_: Bat1 OpticalSensor EMUS_BMS SCIMO_PE TelemetryNode Master SensorF SensorR BrakeF BrakeR PDU HVCU HVTU TestBench MDB1 MDB2 MDB3 MDB4 MDB5 MDB6 Track CLU

BO_ 1447 MDB3_SDO_Resp: 8 MDB3
 SG_ MDB3_OD_CAN2_DelayedTxMessages m1129 : 16|24@1+ (1,0) [0|16777215] ""  TelemetryNode
 SG_ MDB3_OD_CAN2_ErrorStatus m1128 : 16|8@1+ (1,0) [0|255] ""  TelemetryNode
 SG_ MDB3_OD_CAN2_DiscardedTxMessages m1127 : 16|24@1+ (1,0) [0|16777215] ""  TelemetryNode
 SG_ MDB3_OD_CAN2_Status m1126 : 16|8@1+ (1,0) [0|255] ""  TelemetryNode
 SG_ MDB3_OD_CAN2_Baudrate m1124 : 16|16@1+ (1,0) [125|1000] "kbps"  TelemetryNode
 SG_ MDB3_OD_CAN2_autoErrorReset m1123 : 16|8@1+ (1,0) [0|255] ""  TelemetryNode
 SG_ MDB3_OD_CAN2_lastErrorCode m1122 : 16|32@1+ (1,0) [0|4294967295] ""  TelemetryNode
 SG_ MDB3_OD_CAN2_RxErrCnt m1121 : 16|8@1+ (1,0) [0|255] ""  TelemetryNode
 SG_ MDB3_OD_CAN2_TxErrCnt m1120 : 16|8@1+ (1,0) [0|255] ""  TelemetryNode
 SG_ MDB3_OD_CAN1_DelayedTxMessages m1113 : 16|24@1+ (1,0) [0|16777215] ""  TelemetryNode
 SG_ MDB3_OD_CAN1_ErrorStatus m1112 : 16|8@1+ (1,0) [0|255] ""  TelemetryNode
 SG_ MDB3_OD_CAN1_DiscardedTxMessages m1111 : 16|24@1+ (1,0) [0|16777215] ""  TelemetryNode
 SG_ MDB3_OD_CAN1_Status m1110 : 16|8@1+ (1,0) [0|255] ""  TelemetryNode
 SG_ MDB3_OD_CAN1_Baudrate m1108 : 16|16@1+ (1,0) [125|1000] "kbps"  TelemetryNode
 SG_ MDB3_OD_CAN1_autoErrorReset m1107 : 16|8@1+ (1,0) [0|255] ""  TelemetryNode
 SG_ MDB3_OD_CAN1_lastErrorCode m1106 : 16|32@1+ (1,0) [0|4294967295] ""  TelemetryNode
 SG_ MDB3_OD_CAN1_RxErrCnt m1105 : 16|8@1+ (1,0) [0|255] ""  TelemetryNode
 SG_ MDB3_OD_CAN1_TxErrCnt m1104 : 16|8@1+ (1,0) [0|255] ""  TelemetryNode
 SG_ MDB3_OD_BuildTime m1073 : 16|24@1+ (1,0) [0|16777215] ""  TelemetryNode
 SG_ MDB3_OD_BuildDate m1072 : 16|32@1+ (1,0) [0|4294967295] ""  TelemetryNode
 SG_ MDB3_OD_ChipUID2 m1057 : 16|48@1+ (1,0) [0|281474976710655] ""  TelemetryNode
 SG_ MDB3_OD_ChipUID1 m1056 : 16|48@1+ (1,0) [0|281474976710655] ""  TelemetryNode
 SG_ MDB3_OD_SdcOut m1046 : 16|8@1+ (1,0) [0|255] ""  TelemetryNode
 SG_ MDB3_OD_SdcIn m1045 : 16|8@1+ (1,0) [0|255] ""  TelemetryNode
 SG_ MDB3_OD_runtime m1044 : 16|24@1+ (1,0) [0|16777215] "ms"  TelemetryNode
 SG_ MDB3_OD_InputVoltage m1043 : 16|16@1+ (0.001,0) [0|65.535] "V"  TelemetryNode
 SG_ MDB3_OD_BoardTemp m1042 : 16|16@1+ (0.01,-30) [-30|625.35] "°C"  TelemetryNode
 SG_ MDB3_OD_MemFree m1041 : 16|16@1+ (4,0) [0|262140] "bytes"  TelemetryNode
 SG_ MDB3_OD_CpuUsage m1040 : 16|8@1+ (0.5,0) [0|100] "%"  TelemetryNode
 SG_ MDB3_OD_OdEntrySendInterval m33 : 16|16@1+ (1,0) [0|65535] "ms"  TelemetryNode
 SG_ MDB3_OD_SendOdOnBootup m32 : 16|8@1+ (1,0) [0|255] ""  TelemetryNode
 SG_ MDB3_OD_HeartbeatInterval m16 : 16|16@1+ (1,0) [0|65535] "ms"  TelemetryNode
 SG_ MDB3_OD_DbcVersion m5 : 16|16@1+ (1,0) [0|65535] ""  TelemetryNode
 SG_ MDB3_OD_StackVersion m4 : 16|16@1+ (1,0) [0|65535] ""  TelemetryNode
 SG_ MDB3_OD_ProtocolVersion m3 : 16|16@1+ (1,0) [0|65535] ""  TelemetryNode
 SG_ MDB3_OD_NodeStatus m2 : 16|8@1+ (1,0) [0|255] ""  TelemetryNode
 SG_ MDB3_OD_NodeID m1 : 16|8@1+ (1,0) [0|255] ""  TelemetryNode
 SG_ MDB3_SDO_RespCode : 12|4@1+ (1,0) [0|0] ""  TelemetryNode
 SG_ MDB3_SDO_ID M : 0|12@1+ (1,0) [0|4095] ""  TelemetryNode

BO_ 1511 MDB3_SDO_Req_Up: 8 TelemetryNode
 SG_ MDB3_OD_CAN2_DelayedTxMessages m1129 : 16|24@1+ (1,0) [0|16777215] ""  MDB3
 SG_ MDB3_OD_CAN2_ErrorStatus m1128 : 16|8@1+ (1,0) [0|255] ""  MDB3
 SG_ MDB3_OD_CAN2_DiscardedTxMessages m1127 : 16|24@1+ (1,0) [0|16777215] ""  MDB3
 SG_ MDB3_OD_CAN2_Status m1126 : 16|8@1+ (1,0) [0|255] ""  MDB3
 SG_ MDB3_OD_CAN2_Baudrate m1124 : 16|16@1+ (1,0) [125|1000] "kbps"  MDB3
 SG_ MDB3_OD_CAN2_autoErrorReset m1123 : 16|8@1+ (1,0) [0|255] ""  MDB3
 SG_ MDB3_OD_CAN2_lastErrorCode m1122 : 16|32@1+ (1,0) [0|4294967295] ""  MDB3
 SG_ MDB3_OD_CAN2_RxErrCnt m1121 : 16|8@1+ (1,0) [0|255] ""  MDB3
 SG_ MDB3_OD_CAN2_TxErrCnt m1120 : 16|8@1+ (1,0) [0|255] ""  MDB3
 SG_ MDB3_OD_CAN1_DelayedTxMessages m1113 : 16|24@1+ (1,0) [0|16777215] ""  MDB3
 SG_ MDB3_OD_CAN1_ErrorStatus m1112 : 16|8@1+ (1,0) [0|255] ""  MDB3
 SG_ MDB3_OD_CAN1_DiscardedTxMessages m1111 : 16|24@1+ (1,0) [0|16777215] ""  MDB3
 SG_ MDB3_OD_CAN1_Status m1110 : 16|8@1+ (1,0) [0|255] ""  MDB3
 SG_ MDB3_OD_CAN1_Baudrate m1108 : 16|16@1+ (1,0) [125|1000] "kbps"  MDB3
 SG_ MDB3_OD_CAN1_autoErrorReset m1107 : 16|8@1+ (1,0) [0|255] ""  MDB3
 SG_ MDB3_OD_CAN1_lastErrorCode m1106 : 16|32@1+ (1,0) [0|4294967295] ""  MDB3
 SG_ MDB3_OD_CAN1_RxErrCnt m1105 : 16|8@1+ (1,0) [0|255] ""  MDB3
 SG_ MDB3_OD_CAN1_TxErrCnt m1104 : 16|8@1+ (1,0) [0|255] ""  MDB3
 SG_ MDB3_OD_BuildTime m1073 : 16|24@1+ (1,0) [0|16777215] ""  MDB3
 SG_ MDB3_OD_BuildDate m1072 : 16|32@1+ (1,0) [0|4294967295] ""  MDB3
 SG_ MDB3_OD_ChipUID2 m1057 : 16|48@1+ (1,0) [0|281474976710655] ""  MDB3
 SG_ MDB3_OD_ChipUID1 m1056 : 16|48@1+ (1,0) [0|281474976710655] ""  MDB3
 SG_ MDB3_OD_SdcOut m1046 : 16|8@1+ (1,0) [0|255] ""  MDB3
 SG_ MDB3_OD_SdcIn m1045 : 16|8@1+ (1,0) [0|255] ""  MDB3
 SG_ MDB3_OD_runtime m1044 : 16|24@1+ (1,0) [0|16777215] "ms"  MDB3
 SG_ MDB3_OD_InputVoltage m1043 : 16|16@1+ (0.001,0) [0|65.535] "V"  MDB3
 SG_ MDB3_OD_BoardTemp m1042 : 16|16@1+ (0.01,-30) [-30|625.35] "°C"  MDB3
 SG_ MDB3_OD_MemFree m1041 : 16|16@1+ (4,0) [0|262140] "bytes"  MDB3
 SG_ MDB3_OD_CpuUsage m1040 : 16|8@1+ (0.5,0) [0|100] "%"  MDB3
 SG_ MDB3_OD_OdEntrySendInterval m33 : 16|16@1+ (1,0) [0|65535] "ms"  MDB3
 SG_ MDB3_OD_SendOdOnBootup m32 : 16|8@1+ (1,0) [0|255] ""  MDB3
 SG_ MDB3_OD_HeartbeatInterval m16 : 16|16@1+ (1,0) [0|65535] "ms"  MDB3
 SG_ MDB3_OD_DbcVersion m5 : 16|16@1+ (1,0) [0|65535] ""  MDB3
 SG_ MDB3_OD_StackVersion m4 : 16|16@1+ (1,0) [0|65535] ""  MDB3
 SG_ MDB3_OD_ProtocolVersion m3 : 16|16@1+ (1,0) [0|65535] ""  MDB3
 SG_ MDB3_OD_NodeStatus m2 : 16|8@1+ (1,0) [0|255] ""  MDB3
 SG_ MDB3_OD_NodeID m1 : 16|8@1+ (1,0) [0|255] ""  MDB3
 SG_ MDB3_SDO_ID M : 0|12@1+ (1,0) [0|4095] ""  MDB3

BO_ 1575 MDB3_SDO_Req_Down: 2 TelemetryNode
 SG_ MDB3_SDO_ID M : 0|12@1+ (1,0) [0|4095] ""  MDB3

BO_ 1831 MDB3_Heartbeat: 1 MDB3
 SG_ MDB3_NodeState : 0|8@1+ (1,0) [0|0] ""  Master,TelemetryNode

BO_ 1895 MDB3_BTL_TX: 8 MDB3

BO_ 1959 MDB3_BTL_RX: 8 TelemetryNode

BO_ 168 MDB4_EMCY: 4 MDB4
 SG_ MDB4_E0_OtherError : 12|1@1+ (1,0) [0|0] ""  Master,TelemetryNode
 SG_ MDB4_W0_OtherWarning : 0|1@1+ (1,0) [0|0] ""  Master,TelemetryNode

BO_ 424 MDB4_TX_PDO1: 0 MDB4

BO_ 488 MDB4_RX_PDO1: 0 Vector__XXX

BO_ 552 MDB4_TX_PDO2: 0 MDB4

BO_ 616 MDB4_RX_PDO2: 0 Vector__XXX

BO_ 680 MDB4_TX_PDO3: 0 MDB4

BO_ 744 MDB4_RX_PDO3: 0 Vector__XXX

BO_ 808 MDB4_TX_PDO4: 0 MDB4

BO_ 872 MDB4_RX_PDO4: 0 Vector__XXX

BO_ 936 MDB4_TX_PDO5: 0 MDB4

BO_ 1000 MDB4_TX_PDO6: 0 MDB4

BO_ 1064 MDB4_TX_PDO7: 0 MDB4

BO_ 1128 MDB4_TX_PDO8: 0 MDB4

BO_ 1192 MDB4_TX_PDO9: 0 MDB4

BO_ 1256 MDB4_TX_PDO10: 0 MDB4

BO_ 1320 MDB4_TX_PDO11: 0 MDB4

BO_ 1384 MDB4_TX_PDO12: 0 MDB4

BO_ 1448 MDB4_SDO_Resp: 8 MDB4
 SG_ MDB4_OD_CAN2_DelayedTxMessages m1129 : 16|24@1+ (1,0) [0|16777215] ""  TelemetryNode
 SG_ MDB4_OD_CAN2_ErrorStatus m1128 : 16|8@1+ (1,0) [0|255] ""  TelemetryNode
 SG_ MDB4_OD_CAN2_DiscardedTxMessages m1127 : 16|24@1+ (1,0) [0|16777215] ""  TelemetryNode
 SG_ MDB4_OD_CAN2_Status m1126 : 16|8@1+ (1,0) [0|255] ""  TelemetryNode
 SG_ MDB4_OD_CAN2_Baudrate m1124 : 16|16@1+ (1,0) [125|1000] "kbps"  TelemetryNode
 SG_ MDB4_OD_CAN2_autoErrorReset m1123 : 16|8@1+ (1,0) [0|255] ""  TelemetryNode
 SG_ MDB4_OD_CAN2_lastErrorCode m1122 : 16|32@1+ (1,0) [0|4294967295] ""  TelemetryNode
 SG_ MDB4_OD_CAN2_RxErrCnt m1121 : 16|8@1+ (1,0) [0|255] ""  TelemetryNode
 SG_ MDB4_OD_CAN2_TxErrCnt m1120 : 16|8@1+ (1,0) [0|255] ""  TelemetryNode
 SG_ MDB4_OD_CAN1_DelayedTxMessages m1113 : 16|24@1+ (1,0) [0|16777215] ""  TelemetryNode
 SG_ MDB4_OD_CAN1_ErrorStatus m1112 : 16|8@1+ (1,0) [0|255] ""  TelemetryNode
 SG_ MDB4_OD_CAN1_DiscardedTxMessages m1111 : 16|24@1+ (1,0) [0|16777215] ""  TelemetryNode
 SG_ MDB4_OD_CAN1_Status m1110 : 16|8@1+ (1,0) [0|255] ""  TelemetryNode
 SG_ MDB4_OD_CAN1_Baudrate m1108 : 16|16@1+ (1,0) [125|1000] "kbps"  TelemetryNode
 SG_ MDB4_OD_CAN1_autoErrorReset m1107 : 16|8@1+ (1,0) [0|255] ""  TelemetryNode
 SG_ MDB4_OD_CAN1_lastErrorCode m1106 : 16|32@1+ (1,0) [0|4294967295] ""  TelemetryNode
 SG_ MDB4_OD_CAN1_RxErrCnt m1105 : 16|8@1+ (1,0) [0|255] ""  TelemetryNode
 SG_ MDB4_OD_CAN1_TxErrCnt m1104 : 16|8@1+ (1,0) [0|255] ""  TelemetryNode
 SG_ MDB4_OD_BuildTime m1073 : 16|24@1+ (1,0) [0|16777215] ""  TelemetryNode
 SG_ MDB4_OD_BuildDate m1072 : 16|32@1+ (1,0) [0|4294967295] ""  TelemetryNode
 SG_ MDB4_OD_ChipUID2 m1057 : 16|48@1+ (1,0) [0|281474976710655] ""  TelemetryNode
 SG_ MDB4_OD_ChipUID1 m1056 : 16|48@1+ (1,0) [0|281474976710655] ""  TelemetryNode
 SG_ MDB4_OD_SdcOut m1046 : 16|8@1+ (1,0) [0|255] ""  TelemetryNode
 SG_ MDB4_OD_SdcIn m1045 : 16|8@1+ (1,0) [0|255] ""  TelemetryNode
 SG_ MDB4_OD_runtime m1044 : 16|24@1+ (1,0) [0|16777215] "ms"  TelemetryNode
 SG_ MDB4_OD_InputVoltage m1043 : 16|16@1+ (0.001,0) [0|65.535] "V"  TelemetryNode
 SG_ MDB4_OD_BoardTemp m1042 : 16|16@1+ (0.01,-30) [-30|625.35] "°C"  TelemetryNode
 SG_ MDB4_OD_MemFree m1041 : 16|16@1+ (4,0) [0|262140] "bytes"  TelemetryNode
 SG_ MDB4_OD_CpuUsage m1040 : 16|8@1+ (0.5,0) [0|100] "%"  TelemetryNode
 SG_ MDB4_OD_OdEntrySendInterval m33 : 16|16@1+ (1,0) [0|65535] "ms"  TelemetryNode
 SG_ MDB4_OD_SendOdOnBootup m32 : 16|8@1+ (1,0) [0|255] ""  TelemetryNode
 SG_ MDB4_OD_HeartbeatInterval m16 : 16|16@1+ (1,0) [0|65535] "ms"  TelemetryNode
 SG_ MDB4_OD_DbcVersion m5 : 16|16@1+ (1,0) [0|65535] ""  TelemetryNode
 SG_ MDB4_OD_StackVersion m4 : 16|16@1+ (1,0) [0|65535] ""  TelemetryNode
 SG_ MDB4_OD_ProtocolVersion m3 : 16|16@1+ (1,0) [0|65535] ""  TelemetryNode
 SG_ MDB4_OD_NodeStatus m2 : 16|8@1+ (1,0) [0|255] ""  TelemetryNode
 SG_ MDB4_OD_NodeID m1 : 16|8@1+ (1,0) [0|255] ""  TelemetryNode
 SG_ MDB4_SDO_RespCode : 12|4@1+ (1,0) [0|0] ""  TelemetryNode
 SG_ MDB4_SDO_ID M : 0|12@1+ (1,0) [0|4095] ""  TelemetryNode

BO_ 1512 MDB4_SDO_Req_Up: 8 TelemetryNode
 SG_ MDB4_OD_CAN2_DelayedTxMessages m1129 : 16|24@1+ (1,0) [0|16777215] ""  MDB4
 SG_ MDB4_OD_CAN2_ErrorStatus m1128 : 16|8@1+ (1,0) [0|255] ""  MDB4
 SG_ MDB4_OD_CAN2_DiscardedTxMessages m1127 : 16|24@1+ (1,0) [0|16777215] ""  MDB4
 SG_ MDB4_OD_CAN2_Status m1126 : 16|8@1+ (1,0) [0|255] ""  MDB4
 SG_ MDB4_OD_CAN2_Baudrate m1124 : 16|16@1+ (1,0) [125|1000] "kbps"  MDB4
 SG_ MDB4_OD_CAN2_autoErrorReset m1123 : 16|8@1+ (1,0) [0|255] ""  MDB4
 SG_ MDB4_OD_CAN2_lastErrorCode m1122 : 16|32@1+ (1,0) [0|4294967295] ""  MDB4
 SG_ MDB4_OD_CAN2_RxErrCnt m1121 : 16|8@1+ (1,0) [0|255] ""  MDB4
 SG_ MDB4_OD_CAN2_TxErrCnt m1120 : 16|8@1+ (1,0) [0|255] ""  MDB4
 SG_ MDB4_OD_CAN1_DelayedTxMessages m1113 : 16|24@1+ (1,0) [0|16777215] ""  MDB4
 SG_ MDB4_OD_CAN1_ErrorStatus m1112 : 16|8@1+ (1,0) [0|255] ""  MDB4
 SG_ MDB4_OD_CAN1_DiscardedTxMessages m1111 : 16|24@1+ (1,0) [0|16777215] ""  MDB4
 SG_ MDB4_OD_CAN1_Status m1110 : 16|8@1+ (1,0) [0|255] ""  MDB4
 SG_ MDB4_OD_CAN1_Baudrate m1108 : 16|16@1+ (1,0) [125|1000] "kbps"  MDB4
 SG_ MDB4_OD_CAN1_autoErrorReset m1107 : 16|8@1+ (1,0) [0|255] ""  MDB4
 SG_ MDB4_OD_CAN1_lastErrorCode m1106 : 16|32@1+ (1,0) [0|4294967295] ""  MDB4
 SG_ MDB4_OD_CAN1_RxErrCnt m1105 : 16|8@1+ (1,0) [0|255] ""  MDB4
 SG_ MDB4_OD_CAN1_TxErrCnt m1104 : 16|8@1+ (1,0) [0|255] ""  MDB4
 SG_ MDB4_OD_BuildTime m1073 : 16|24@1+ (1,0) [0|16777215] ""  MDB4
 SG_ MDB4_OD_BuildDate m1072 : 16|32@1+ (1,0) [0|4294967295] ""  MDB4
 SG_ MDB4_OD_ChipUID2 m1057 : 16|48@1+ (1,0) [0|281474976710655] ""  MDB4
 SG_ MDB4_OD_ChipUID1 m1056 : 16|48@1+ (1,0) [0|281474976710655] ""  MDB4
 SG_ MDB4_OD_SdcOut m1046 : 16|8@1+ (1,0) [0|255] ""  MDB4
 SG_ MDB4_OD_SdcIn m1045 : 16|8@1+ (1,0) [0|255] ""  MDB4
 SG_ MDB4_OD_runtime m1044 : 16|24@1+ (1,0) [0|16777215] "ms"  MDB4
 SG_ MDB4_OD_InputVoltage m1043 : 16|16@1+ (0.001,0) [0|65.535] "V"  MDB4
 SG_ MDB4_OD_BoardTemp m1042 : 16|16@1+ (0.01,-30) [-30|625.35] "°C"  MDB4
 SG_ MDB4_OD_MemFree m1041 : 16|16@1+ (4,0) [0|262140] "bytes"  MDB4
 SG_ MDB4_OD_CpuUsage m1040 : 16|8@1+ (0.5,0) [0|100] "%"  MDB4
 SG_ MDB4_OD_OdEntrySendInterval m33 : 16|16@1+ (1,0) [0|65535] "ms"  MDB4
 SG_ MDB4_OD_SendOdOnBootup m32 : 16|8@1+ (1,0) [0|255] ""  MDB4
 SG_ MDB4_OD_HeartbeatInterval m16 : 16|16@1+ (1,0) [0|65535] "ms"  MDB4
 SG_ MDB4_OD_DbcVersion m5 : 16|16@1+ (1,0) [0|65535] ""  MDB4
 SG_ MDB4_OD_StackVersion m4 : 16|16@1+ (1,0) [0|65535] ""  MDB4
 SG_ MDB4_OD_ProtocolVersion m3 : 16|16@1+ (1,0) [0|65535] ""  MDB4
 SG_ MDB4_OD_NodeStatus m2 : 16|8@1+ (1,0) [0|255] ""  MDB4
 SG_ MDB4_OD_NodeID m1 : 16|8@1+ (1,0) [0|255] ""  MDB4
 SG_ MDB4_SDO_ID M : 0|12@1+ (1,0) [0|4095] ""  MDB4

BO_ 1576 MDB4_SDO_Req_Down: 2 TelemetryNode
 SG_ MDB4_SDO_ID M : 0|12@1+ (1,0) [0|4095] ""  MDB4

BO_ 1832 MDB4_Heartbeat: 1 MDB4
 SG_ MDB4_NodeState : 0|8@1+ (1,0) [0|0] ""  Master,TelemetryNode

BO_ 1896 MDB4_BTL_TX: 8 MDB4

BO_ 1960 MDB4_BTL_RX: 8 TelemetryNode

BO_ 169 MDB5_EMCY: 4 MDB5
 SG_ MDB5_E0_OtherError : 12|1@1+ (1,0) [0|0] ""  Master,TelemetryNode
 SG_ MDB5_W0_OtherWarning : 0|1@1+ (1,0) [0|0] ""  Master,TelemetryNode

BO_ 425 MDB5_TX_PDO1: 0 MDB5

BO_ 489 MDB5_RX_PDO1: 0 Vector__XXX

BO_ 553 MDB5_TX_PDO2: 0 MDB5

BO_ 617 MDB5_RX_PDO2: 0 Vector__XXX

BO_ 681 MDB5_TX_PDO3: 0 MDB5

BO_ 745 MDB5_RX_PDO3: 0 Vector__XXX

BO_ 809 MDB5_TX_PDO4: 0 MDB5

BO_ 873 MDB5_RX_PDO4: 0 Vector__XXX

BO_ 937 MDB5_TX_PDO5: 0 MDB5

BO_ 1001 MDB5_TX_PDO6: 0 MDB5

BO_ 1065 MDB5_TX_PDO7: 0 MDB5

BO_ 1129 MDB5_TX_PDO8: 0 MDB5

BO_ 1193 MDB5_TX_PDO9: 0 MDB5

BO_ 1257 MDB5_TX_PDO10: 0 MDB5

BO_ 1321 MDB5_TX_PDO11: 0 MDB5

BO_ 1385 MDB5_TX_PDO12: 0 MDB5

BO_ 1449 MDB5_SDO_Resp: 8 MDB5
 SG_ MDB5_OD_CAN2_DelayedTxMessages m1129 : 16|24@1+ (1,0) [0|16777215] ""  TelemetryNode
 SG_ MDB5_OD_CAN2_ErrorStatus m1128 : 16|8@1+ (1,0) [0|255] ""  TelemetryNode
 SG_ MDB5_OD_CAN2_DiscardedTxMessages m1127 : 16|24@1+ (1,0) [0|16777215] ""  TelemetryNode
 SG_ MDB5_OD_CAN2_Status m1126 : 16|8@1+ (1,0) [0|255] ""  TelemetryNode
 SG_ MDB5_OD_CAN2_Baudrate m1124 : 16|16@1+ (1,0) [125|1000] "kbps"  TelemetryNode
 SG_ MDB5_OD_CAN2_autoErrorReset m1123 : 16|8@1+ (1,0) [0|255] ""  TelemetryNode
 SG_ MDB5_OD_CAN2_lastErrorCode m1122 : 16|32@1+ (1,0) [0|4294967295] ""  TelemetryNode
 SG_ MDB5_OD_CAN2_RxErrCnt m1121 : 16|8@1+ (1,0) [0|255] ""  TelemetryNode
 SG_ MDB5_OD_CAN2_TxErrCnt m1120 : 16|8@1+ (1,0) [0|255] ""  TelemetryNode
 SG_ MDB5_OD_CAN1_DelayedTxMessages m1113 : 16|24@1+ (1,0) [0|16777215] ""  TelemetryNode
 SG_ MDB5_OD_CAN1_ErrorStatus m1112 : 16|8@1+ (1,0) [0|255] ""  TelemetryNode
 SG_ MDB5_OD_CAN1_DiscardedTxMessages m1111 : 16|24@1+ (1,0) [0|16777215] ""  TelemetryNode
 SG_ MDB5_OD_CAN1_Status m1110 : 16|8@1+ (1,0) [0|255] ""  TelemetryNode
 SG_ MDB5_OD_CAN1_Baudrate m1108 : 16|16@1+ (1,0) [125|1000] "kbps"  TelemetryNode
 SG_ MDB5_OD_CAN1_autoErrorReset m1107 : 16|8@1+ (1,0) [0|255] ""  TelemetryNode
 SG_ MDB5_OD_CAN1_lastErrorCode m1106 : 16|32@1+ (1,0) [0|4294967295] ""  TelemetryNode
 SG_ MDB5_OD_CAN1_RxErrCnt m1105 : 16|8@1+ (1,0) [0|255] ""  TelemetryNode
 SG_ MDB5_OD_CAN1_TxErrCnt m1104 : 16|8@1+ (1,0) [0|255] ""  TelemetryNode
 SG_ MDB5_OD_BuildTime m1073 : 16|24@1+ (1,0) [0|16777215] ""  TelemetryNode
 SG_ MDB5_OD_BuildDate m1072 : 16|32@1+ (1,0) [0|4294967295] ""  TelemetryNode
 SG_ MDB5_OD_ChipUID2 m1057 : 16|48@1+ (1,0) [0|281474976710655] ""  TelemetryNode
 SG_ MDB5_OD_ChipUID1 m1056 : 16|48@1+ (1,0) [0|281474976710655] ""  TelemetryNode
 SG_ MDB5_OD_SdcOut m1046 : 16|8@1+ (1,0) [0|255] ""  TelemetryNode
 SG_ MDB5_OD_SdcIn m1045 : 16|8@1+ (1,0) [0|255] ""  TelemetryNode
 SG_ MDB5_OD_runtime m1044 : 16|24@1+ (1,0) [0|16777215] "ms"  TelemetryNode
 SG_ MDB5_OD_InputVoltage m1043 : 16|16@1+ (0.001,0) [0|65.535] "V"  TelemetryNode
 SG_ MDB5_OD_BoardTemp m1042 : 16|16@1+ (0.01,-30) [-30|625.35] "°C"  TelemetryNode
 SG_ MDB5_OD_MemFree m1041 : 16|16@1+ (4,0) [0|262140] "bytes"  TelemetryNode
 SG_ MDB5_OD_CpuUsage m1040 : 16|8@1+ (0.5,0) [0|100] "%"  TelemetryNode
 SG_ MDB5_OD_OdEntrySendInterval m33 : 16|16@1+ (1,0) [0|65535] "ms"  TelemetryNode
 SG_ MDB5_OD_SendOdOnBootup m32 : 16|8@1+ (1,0) [0|255] ""  TelemetryNode
 SG_ MDB5_OD_HeartbeatInterval m16 : 16|16@1+ (1,0) [0|65535] "ms"  TelemetryNode
 SG_ MDB5_OD_DbcVersion m5 : 16|16@1+ (1,0) [0|65535] ""  TelemetryNode
 SG_ MDB5_OD_StackVersion m4 : 16|16@1+ (1,0) [0|65535] ""  TelemetryNode
 SG_ MDB5_OD_ProtocolVersion m3 : 16|16@1+ (1,0) [0|65535] ""  TelemetryNode
 SG_ MDB5_OD_NodeStatus m2 : 16|8@1+ (1,0) [0|255] ""  TelemetryNode
 SG_ MDB5_OD_NodeID m1 : 16|8@1+ (1,0) [0|255] ""  TelemetryNode
 SG_ MDB5_SDO_RespCode : 12|4@1+ (1,0) [0|0] ""  TelemetryNode
 SG_ MDB5_SDO_ID M : 0|12@1+ (1,0) [0|4095] ""  TelemetryNode

BO_ 1513 MDB5_SDO_Req_Up: 8 TelemetryNode
 SG_ MDB5_OD_CAN2_DelayedTxMessages m1129 : 16|24@1+ (1,0) [0|16777215] ""  MDB5
 SG_ MDB5_OD_CAN2_ErrorStatus m1128 : 16|8@1+ (1,0) [0|255] ""  MDB5
 SG_ MDB5_OD_CAN2_DiscardedTxMessages m1127 : 16|24@1+ (1,0) [0|16777215] ""  MDB5
 SG_ MDB5_OD_CAN2_Status m1126 : 16|8@1+ (1,0) [0|255] ""  MDB5
 SG_ MDB5_OD_CAN2_Baudrate m1124 : 16|16@1+ (1,0) [125|1000] "kbps"  MDB5
 SG_ MDB5_OD_CAN2_autoErrorReset m1123 : 16|8@1+ (1,0) [0|255] ""  MDB5
 SG_ MDB5_OD_CAN2_lastErrorCode m1122 : 16|32@1+ (1,0) [0|4294967295] ""  MDB5
 SG_ MDB5_OD_CAN2_RxErrCnt m1121 : 16|8@1+ (1,0) [0|255] ""  MDB5
 SG_ MDB5_OD_CAN2_TxErrCnt m1120 : 16|8@1+ (1,0) [0|255] ""  MDB5
 SG_ MDB5_OD_CAN1_DelayedTxMessages m1113 : 16|24@1+ (1,0) [0|16777215] ""  MDB5
 SG_ MDB5_OD_CAN1_ErrorStatus m1112 : 16|8@1+ (1,0) [0|255] ""  MDB5
 SG_ MDB5_OD_CAN1_DiscardedTxMessages m1111 : 16|24@1+ (1,0) [0|16777215] ""  MDB5
 SG_ MDB5_OD_CAN1_Status m1110 : 16|8@1+ (1,0) [0|255] ""  MDB5
 SG_ MDB5_OD_CAN1_Baudrate m1108 : 16|16@1+ (1,0) [125|1000] "kbps"  MDB5
 SG_ MDB5_OD_CAN1_autoErrorReset m1107 : 16|8@1+ (1,0) [0|255] ""  MDB5
 SG_ MDB5_OD_CAN1_lastErrorCode m1106 : 16|32@1+ (1,0) [0|4294967295] ""  MDB5
 SG_ MDB5_OD_CAN1_RxErrCnt m1105 : 16|8@1+ (1,0) [0|255] ""  MDB5
 SG_ MDB5_OD_CAN1_TxErrCnt m1104 : 16|8@1+ (1,0) [0|255] ""  MDB5
 SG_ MDB5_OD_BuildTime m1073 : 16|24@1+ (1,0) [0|16777215] ""  MDB5
 SG_ MDB5_OD_BuildDate m1072 : 16|32@1+ (1,0) [0|4294967295] ""  MDB5
 SG_ MDB5_OD_ChipUID2 m1057 : 16|48@1+ (1,0) [0|281474976710655] ""  MDB5
 SG_ MDB5_OD_ChipUID1 m1056 : 16|48@1+ (1,0) [0|281474976710655] ""  MDB5
 SG_ MDB5_OD_SdcOut m1046 : 16|8@1+ (1,0) [0|255] ""  MDB5
 SG_ MDB5_OD_SdcIn m1045 : 16|8@1+ (1,0) [0|255] ""  MDB5
 SG_ MDB5_OD_runtime m1044 : 16|24@1+ (1,0) [0|16777215] "ms"  MDB5
 SG_ MDB5_OD_InputVoltage m1043 : 16|16@1+ (0.001,0) [0|65.535] "V"  MDB5
 SG_ MDB5_OD_BoardTemp m1042 : 16|16@1+ (0.01,-30) [-30|625.35] "°C"  MDB5
 SG_ MDB5_OD_MemFree m1041 : 16|16@1+ (4,0) [0|262140] "bytes"  MDB5
 SG_ MDB5_OD_CpuUsage m1040 : 16|8@1+ (0.5,0) [0|100] "%"  MDB5
 SG_ MDB5_OD_OdEntrySendInterval m33 : 16|16@1+ (1,0) [0|65535] "ms"  MDB5
 SG_ MDB5_OD_SendOdOnBootup m32 : 16|8@1+ (1,0) [0|255] ""  MDB5
 SG_ MDB5_OD_HeartbeatInterval m16 : 16|16@1+ (1,0) [0|65535] "ms"  MDB5
 SG_ MDB5_OD_DbcVersion m5 : 16|16@1+ (1,0) [0|65535] ""  MDB5
 SG_ MDB5_OD_StackVersion m4 : 16|16@1+ (1,0) [0|65535] ""  MDB5
 SG_ MDB5_OD_ProtocolVersion m3 : 16|16@1+ (1,0) [0|65535] ""  MDB5
 SG_ MDB5_OD_NodeStatus m2 : 16|8@1+ (1,0) [0|255] ""  MDB5
 SG_ MDB5_OD_NodeID m1 : 16|8@1+ (1,0) [0|255] ""  MDB5
 SG_ MDB5_SDO_ID M : 0|12@1+ (1,0) [0|4095] ""  MDB5

BO_ 1577 MDB5_SDO_Req_Down: 2 TelemetryNode
 SG_ MDB5_SDO_ID M : 0|12@1+ (1,0) [0|4095] ""  MDB5

BO_ 1833 MDB5_Heartbeat: 1 MDB5
 SG_ MDB5_NodeState : 0|8@1+ (1,0) [0|0] ""  Master,TelemetryNode

BO_ 1897 MDB5_BTL_TX: 8 MDB5

BO_ 1961 MDB5_BTL_RX: 8 TelemetryNode

BO_ 177 MDB6_EMCY: 4 MDB6
 SG_ MDB6_E0_OtherError : 12|1@1+ (1,0) [0|0] ""  Master,TelemetryNode
 SG_ MDB6_W0_OtherWarning : 0|1@1+ (1,0) [0|0] ""  Master,TelemetryNode

BO_ 433 MDB6_TX_PDO1: 0 MDB6

BO_ 497 MDB6_RX_PDO1: 0 Vector__XXX

BO_ 561 MDB6_TX_PDO2: 0 MDB6

BO_ 625 MDB6_RX_PDO2: 0 Vector__XXX

BO_ 689 MDB6_TX_PDO3: 0 MDB6

BO_ 753 MDB6_RX_PDO3: 0 Vector__XXX

BO_ 817 MDB6_TX_PDO4: 0 MDB6

BO_ 881 MDB6_RX_PDO4: 0 Vector__XXX

BO_ 945 MDB6_TX_PDO5: 0 MDB6

BO_ 1009 MDB6_TX_PDO6: 0 MDB6

BO_ 1073 MDB6_TX_PDO7: 0 MDB6

BO_ 1137 MDB6_TX_PDO8: 0 MDB6

BO_ 1201 MDB6_TX_PDO9: 0 MDB6

BO_ 1265 MDB6_TX_PDO10: 0 MDB6

BO_ 1329 MDB6_TX_PDO11: 0 MDB6

BO_ 1393 MDB6_TX_PDO12: 0 MDB6

BO_ 1457 MDB6_SDO_Resp: 8 MDB6
 SG_ MDB6_OD_CAN2_DelayedTxMessages m1129 : 16|24@1+ (1,0) [0|16777215] ""  TelemetryNode
 SG_ MDB6_OD_CAN2_ErrorStatus m1128 : 16|8@1+ (1,0) [0|255] ""  TelemetryNode
 SG_ MDB6_OD_CAN2_DiscardedTxMessages m1127 : 16|24@1+ (1,0) [0|16777215] ""  TelemetryNode
 SG_ MDB6_OD_CAN2_Status m1126 : 16|8@1+ (1,0) [0|255] ""  TelemetryNode
 SG_ MDB6_OD_CAN2_Baudrate m1124 : 16|16@1+ (1,0) [125|1000] "kbps"  TelemetryNode
 SG_ MDB6_OD_CAN2_autoErrorReset m1123 : 16|8@1+ (1,0) [0|255] ""  TelemetryNode
 SG_ MDB6_OD_CAN2_lastErrorCode m1122 : 16|32@1+ (1,0) [0|4294967295] ""  TelemetryNode
 SG_ MDB6_OD_CAN2_RxErrCnt m1121 : 16|8@1+ (1,0) [0|255] ""  TelemetryNode
 SG_ MDB6_OD_CAN2_TxErrCnt m1120 : 16|8@1+ (1,0) [0|255] ""  TelemetryNode
 SG_ MDB6_OD_CAN1_DelayedTxMessages m1113 : 16|24@1+ (1,0) [0|16777215] ""  TelemetryNode
 SG_ MDB6_OD_CAN1_ErrorStatus m1112 : 16|8@1+ (1,0) [0|255] ""  TelemetryNode
 SG_ MDB6_OD_CAN1_DiscardedTxMessages m1111 : 16|24@1+ (1,0) [0|16777215] ""  TelemetryNode
 SG_ MDB6_OD_CAN1_Status m1110 : 16|8@1+ (1,0) [0|255] ""  TelemetryNode
 SG_ MDB6_OD_CAN1_Baudrate m1108 : 16|16@1+ (1,0) [125|1000] "kbps"  TelemetryNode
 SG_ MDB6_OD_CAN1_autoErrorReset m1107 : 16|8@1+ (1,0) [0|255] ""  TelemetryNode
 SG_ MDB6_OD_CAN1_lastErrorCode m1106 : 16|32@1+ (1,0) [0|4294967295] ""  TelemetryNode
 SG_ MDB6_OD_CAN1_RxErrCnt m1105 : 16|8@1+ (1,0) [0|255] ""  TelemetryNode
 SG_ MDB6_OD_CAN1_TxErrCnt m1104 : 16|8@1+ (1,0) [0|255] ""  TelemetryNode
 SG_ MDB6_OD_BuildTime m1073 : 16|24@1+ (1,0) [0|16777215] ""  TelemetryNode
 SG_ MDB6_OD_BuildDate m1072 : 16|32@1+ (1,0) [0|4294967295] ""  TelemetryNode
 SG_ MDB6_OD_ChipUID2 m1057 : 16|48@1+ (1,0) [0|281474976710655] ""  TelemetryNode
 SG_ MDB6_OD_ChipUID1 m1056 : 16|48@1+ (1,0) [0|281474976710655] ""  TelemetryNode
 SG_ MDB6_OD_SdcOut m1046 : 16|8@1+ (1,0) [0|255] ""  TelemetryNode
 SG_ MDB6_OD_SdcIn m1045 : 16|8@1+ (1,0) [0|255] ""  TelemetryNode
 SG_ MDB6_OD_runtime m1044 : 16|24@1+ (1,0) [0|16777215] "ms"  TelemetryNode
 SG_ MDB6_OD_InputVoltage m1043 : 16|16@1+ (0.001,0) [0|65.535] "V"  TelemetryNode
 SG_ MDB6_OD_BoardTemp m1042 : 16|16@1+ (0.01,-30) [-30|625.35] "°C"  TelemetryNode
 SG_ MDB6_OD_MemFree m1041 : 16|16@1+ (4,0) [0|262140] "bytes"  TelemetryNode
 SG_ MDB6_OD_CpuUsage m1040 : 16|8@1+ (0.5,0) [0|100] "%"  TelemetryNode
 SG_ MDB6_OD_OdEntrySendInterval m33 : 16|16@1+ (1,0) [0|65535] "ms"  TelemetryNode
 SG_ MDB6_OD_SendOdOnBootup m32 : 16|8@1+ (1,0) [0|255] ""  TelemetryNode
 SG_ MDB6_OD_HeartbeatInterval m16 : 16|16@1+ (1,0) [0|65535] "ms"  TelemetryNode
 SG_ MDB6_OD_DbcVersion m5 : 16|16@1+ (1,0) [0|65535] ""  TelemetryNode
 SG_ MDB6_OD_StackVersion m4 : 16|16@1+ (1,0) [0|65535] ""  TelemetryNode
 SG_ MDB6_OD_ProtocolVersion m3 : 16|16@1+ (1,0) [0|65535] ""  TelemetryNode
 SG_ MDB6_OD_NodeStatus m2 : 16|8@1+ (1,0) [0|255] ""  TelemetryNode
 SG_ MDB6_OD_NodeID m1 : 16|8@1+ (1,0) [0|255] ""  TelemetryNode
 SG_ MDB6_SDO_RespCode : 12|4@1+ (1,0) [0|0] ""  TelemetryNode
 SG_ MDB6_SDO_ID M : 0|12@1+ (1,0) [0|4095] ""  TelemetryNode

BO_ 1521 MDB6_SDO_Req_Up: 8 TelemetryNode
 SG_ MDB6_OD_CAN2_DelayedTxMessages m1129 : 16|24@1+ (1,0) [0|16777215] ""  MDB6
 SG_ MDB6_OD_CAN2_ErrorStatus m1128 : 16|8@1+ (1,0) [0|255] ""  MDB6
 SG_ MDB6_OD_CAN2_DiscardedTxMessages m1127 : 16|24@1+ (1,0) [0|16777215] ""  MDB6
 SG_ MDB6_OD_CAN2_Status m1126 : 16|8@1+ (1,0) [0|255] ""  MDB6
 SG_ MDB6_OD_CAN2_Baudrate m1124 : 16|16@1+ (1,0) [125|1000] "kbps"  MDB6
 SG_ MDB6_OD_CAN2_autoErrorReset m1123 : 16|8@1+ (1,0) [0|255] ""  MDB6
 SG_ MDB6_OD_CAN2_lastErrorCode m1122 : 16|32@1+ (1,0) [0|4294967295] ""  MDB6
 SG_ MDB6_OD_CAN2_RxErrCnt m1121 : 16|8@1+ (1,0) [0|255] ""  MDB6
 SG_ MDB6_OD_CAN2_TxErrCnt m1120 : 16|8@1+ (1,0) [0|255] ""  MDB6
 SG_ MDB6_OD_CAN1_DelayedTxMessages m1113 : 16|24@1+ (1,0) [0|16777215] ""  MDB6
 SG_ MDB6_OD_CAN1_ErrorStatus m1112 : 16|8@1+ (1,0) [0|255] ""  MDB6
 SG_ MDB6_OD_CAN1_DiscardedTxMessages m1111 : 16|24@1+ (1,0) [0|16777215] ""  MDB6
 SG_ MDB6_OD_CAN1_Status m1110 : 16|8@1+ (1,0) [0|255] ""  MDB6
 SG_ MDB6_OD_CAN1_Baudrate m1108 : 16|16@1+ (1,0) [125|1000] "kbps"  MDB6
 SG_ MDB6_OD_CAN1_autoErrorReset m1107 : 16|8@1+ (1,0) [0|255] ""  MDB6
 SG_ MDB6_OD_CAN1_lastErrorCode m1106 : 16|32@1+ (1,0) [0|4294967295] ""  MDB6
 SG_ MDB6_OD_CAN1_RxErrCnt m1105 : 16|8@1+ (1,0) [0|255] ""  MDB6
 SG_ MDB6_OD_CAN1_TxErrCnt m1104 : 16|8@1+ (1,0) [0|255] ""  MDB6
 SG_ MDB6_OD_BuildTime m1073 : 16|24@1+ (1,0) [0|16777215] ""  MDB6
 SG_ MDB6_OD_BuildDate m1072 : 16|32@1+ (1,0) [0|4294967295] ""  MDB6
 SG_ MDB6_OD_ChipUID2 m1057 : 16|48@1+ (1,0) [0|281474976710655] ""  MDB6
 SG_ MDB6_OD_ChipUID1 m1056 : 16|48@1+ (1,0) [0|281474976710655] ""  MDB6
 SG_ MDB6_OD_SdcOut m1046 : 16|8@1+ (1,0) [0|255] ""  MDB6
 SG_ MDB6_OD_SdcIn m1045 : 16|8@1+ (1,0) [0|255] ""  MDB6
 SG_ MDB6_OD_runtime m1044 : 16|24@1+ (1,0) [0|16777215] "ms"  MDB6
 SG_ MDB6_OD_InputVoltage m1043 : 16|16@1+ (0.001,0) [0|65.535] "V"  MDB6
 SG_ MDB6_OD_BoardTemp m1042 : 16|16@1+ (0.01,-30) [-30|625.35] "°C"  MDB6
 SG_ MDB6_OD_MemFree m1041 : 16|16@1+ (4,0) [0|262140] "bytes"  MDB6
 SG_ MDB6_OD_CpuUsage m1040 : 16|8@1+ (0.5,0) [0|100] "%"  MDB6
 SG_ MDB6_OD_OdEntrySendInterval m33 : 16|16@1+ (1,0) [0|65535] "ms"  MDB6
 SG_ MDB6_OD_SendOdOnBootup m32 : 16|8@1+ (1,0) [0|255] ""  MDB6
 SG_ MDB6_OD_HeartbeatInterval m16 : 16|16@1+ (1,0) [0|65535] "ms"  MDB6
 SG_ MDB6_OD_DbcVersion m5 : 16|16@1+ (1,0) [0|65535] ""  MDB6
 SG_ MDB6_OD_StackVersion m4 : 16|16@1+ (1,0) [0|65535] ""  MDB6
 SG_ MDB6_OD_ProtocolVersion m3 : 16|16@1+ (1,0) [0|65535] ""  MDB6
 SG_ MDB6_OD_NodeStatus m2 : 16|8@1+ (1,0) [0|255] ""  MDB6
 SG_ MDB6_OD_NodeID m1 : 16|8@1+ (1,0) [0|255] ""  MDB6
 SG_ MDB6_SDO_ID M : 0|12@1+ (1,0) [0|4095] ""  MDB6

BO_ 1585 MDB6_SDO_Req_Down: 2 TelemetryNode
 SG_ MDB6_SDO_ID M : 0|12@1+ (1,0) [0|4095] ""  MDB6

BO_ 1841 MDB6_Heartbeat: 1 MDB6
 SG_ MDB6_NodeState : 0|8@1+ (1,0) [0|0] ""  Master,TelemetryNode

BO_ 1905 MDB6_BTL_TX: 8 MDB6

BO_ 1969 MDB6_BTL_RX: 8 TelemetryNode

BO_ 178 Track_EMCY: 4 Track
 SG_ Track_E0_OtherError : 12|1@1+ (1,0) [0|0] ""  Master,TelemetryNode
 SG_ Track_W0_OtherWarning : 0|1@1+ (1,0) [0|0] ""  Master,TelemetryNode

BO_ 434 Track_TX_PDO1: 0 Track

BO_ 498 Track_RX_PDO1: 0 Vector__XXX

BO_ 562 Track_TX_PDO2: 0 Track

BO_ 626 Track_RX_PDO2: 0 Vector__XXX

BO_ 690 Track_TX_PDO3: 0 Track

BO_ 754 Track_RX_PDO3: 0 Vector__XXX

BO_ 818 Track_TX_PDO4: 0 Track

BO_ 882 Track_RX_PDO4: 0 Vector__XXX

BO_ 946 Track_TX_PDO5: 0 Track

BO_ 1010 Track_TX_PDO6: 0 Track

BO_ 1074 Track_TX_PDO7: 0 Track

BO_ 1138 Track_TX_PDO8: 0 Track

BO_ 1202 Track_TX_PDO9: 0 Track

BO_ 1266 Track_TX_PDO10: 0 Track

BO_ 1330 Track_TX_PDO11: 0 Track

BO_ 1394 Track_TX_PDO12: 0 Track

BO_ 1458 Track_SDO_Resp: 8 Track
 SG_ Track_OD_PropulsionDistance m2560 : 16|16@1+ (0.01,-100) [-100|555.35] ""  TelemetryNode
 SG_ Track_OD_PropulsionPressure m2816 : 16|16@1+ (0.01,-100) [-100|555.35] ""  TelemetryNode
 SG_ Track_OD_PistonStatus m2304 : 16|8@1+ (1,0) [0|255] ""  TelemetryNode
 SG_ Track_OD_CAN2_DelayedTxMessages m1129 : 16|24@1+ (1,0) [0|16777215] ""  TelemetryNode
 SG_ Track_OD_CAN2_ErrorStatus m1128 : 16|8@1+ (1,0) [0|255] ""  TelemetryNode
 SG_ Track_OD_CAN2_DiscardedTxMessage m1127 : 16|24@1+ (1,0) [0|16777215] ""  TelemetryNode
 SG_ Track_OD_CAN2_Status m1126 : 16|8@1+ (1,0) [0|255] ""  TelemetryNode
 SG_ Track_OD_CAN2_Baudrate m1124 : 16|16@1+ (1,0) [125|1000] "kbps"  TelemetryNode
 SG_ Track_OD_CAN2_autoErrorReset m1123 : 16|8@1+ (1,0) [0|255] ""  TelemetryNode
 SG_ Track_OD_CAN2_lastErrorCode m1122 : 16|32@1+ (1,0) [0|4294967295] ""  TelemetryNode
 SG_ Track_OD_CAN2_RxErrCnt m1121 : 16|8@1+ (1,0) [0|255] ""  TelemetryNode
 SG_ Track_OD_CAN2_TxErrCnt m1120 : 16|8@1+ (1,0) [0|255] ""  TelemetryNode
 SG_ Track_OD_CAN1_DelayedTxMessages m1113 : 16|24@1+ (1,0) [0|16777215] ""  TelemetryNode
 SG_ Track_OD_CAN1_ErrorStatus m1112 : 16|8@1+ (1,0) [0|255] ""  TelemetryNode
 SG_ Track_OD_CAN1_DiscardedTxMessage m1111 : 16|24@1+ (1,0) [0|16777215] ""  TelemetryNode
 SG_ Track_OD_CAN1_Status m1110 : 16|8@1+ (1,0) [0|255] ""  TelemetryNode
 SG_ Track_OD_CAN1_Baudrate m1108 : 16|16@1+ (1,0) [125|1000] "kbps"  TelemetryNode
 SG_ Track_OD_CAN1_autoErrorReset m1107 : 16|8@1+ (1,0) [0|255] ""  TelemetryNode
 SG_ Track_OD_CAN1_lastErrorCode m1106 : 16|32@1+ (1,0) [0|4294967295] ""  TelemetryNode
 SG_ Track_OD_CAN1_RxErrCnt m1105 : 16|8@1+ (1,0) [0|255] ""  TelemetryNode
 SG_ Track_OD_CAN1_TxErrCnt m1104 : 16|8@1+ (1,0) [0|255] ""  TelemetryNode
 SG_ Track_OD_BuildTime m1073 : 16|24@1+ (1,0) [0|16777215] ""  TelemetryNode
 SG_ Track_OD_BuildDate m1072 : 16|32@1+ (1,0) [0|4294967295] ""  TelemetryNode
 SG_ Track_OD_ChipUID2 m1057 : 16|48@1+ (1,0) [0|281474976710655] ""  TelemetryNode
 SG_ Track_OD_ChipUID1 m1056 : 16|48@1+ (1,0) [0|281474976710655] ""  TelemetryNode
 SG_ Track_OD_SdcOut m1046 : 16|8@1+ (1,0) [0|255] ""  TelemetryNode
 SG_ Track_OD_SdcIn m1045 : 16|8@1+ (1,0) [0|255] ""  TelemetryNode
 SG_ Track_OD_runtime m1044 : 16|24@1+ (1,0) [0|16777215] "ms"  TelemetryNode
 SG_ Track_OD_InputVoltage m1043 : 16|16@1+ (0.001,0) [0|65.535] "V"  TelemetryNode
 SG_ Track_OD_BoardTemp m1042 : 16|16@1+ (0.01,-30) [-30|625.35] "°C"  TelemetryNode
 SG_ Track_OD_MemFree m1041 : 16|16@1+ (4,0) [0|262140] "bytes"  TelemetryNode
 SG_ Track_OD_CpuUsage m1040 : 16|8@1+ (0.5,0) [0|100] "%"  TelemetryNode
 SG_ Track_OD_OdEntrySendInterval m33 : 16|16@1+ (1,0) [0|65535] "ms"  TelemetryNode
 SG_ Track_OD_SendOdOnBootup m32 : 16|8@1+ (1,0) [0|255] ""  TelemetryNode
 SG_ Track_OD_HeartbeatInterval m16 : 16|16@1+ (1,0) [0|65535] "ms"  TelemetryNode
 SG_ Track_OD_DbcVersion m5 : 16|16@1+ (1,0) [0|65535] ""  TelemetryNode
 SG_ Track_OD_StackVersion m4 : 16|16@1+ (1,0) [0|65535] ""  TelemetryNode
 SG_ Track_OD_ProtocolVersion m3 : 16|16@1+ (1,0) [0|65535] ""  TelemetryNode
 SG_ Track_OD_NodeStatus m2 : 16|8@1+ (1,0) [0|255] ""  TelemetryNode
 SG_ Track_OD_NodeID m1 : 16|8@1+ (1,0) [0|255] ""  TelemetryNode
 SG_ Track_SDO_RespCode : 12|4@1+ (1,0) [0|0] ""  TelemetryNode
 SG_ Track_SDO_ID M : 0|12@1+ (1,0) [0|4095] ""  TelemetryNode

BO_ 1522 Track_SDO_Req_Up: 8 TelemetryNode
 SG_ Track_OD_PropulsionDistance m2560 : 16|16@1+ (0.01,-100) [-100|555.35] ""  Track
 SG_ Track_OD_PropulsionPressure m2816 : 16|16@1+ (0.01,-100) [-100|555.35] ""  Track
 SG_ Track_OD_PistonStatus m2304 : 16|8@1+ (1,0) [0|255] ""  Track
 SG_ Track_OD_CAN2_DelayedTxMessages m1129 : 16|24@1+ (1,0) [0|16777215] ""  Track
 SG_ Track_OD_CAN2_ErrorStatus m1128 : 16|8@1+ (1,0) [0|255] ""  Track
 SG_ Track_OD_CAN2_DiscardedTxMe_0000 m1127 : 16|24@1+ (1,0) [0|16777215] ""  Track
 SG_ Track_OD_CAN2_Status m1126 : 16|8@1+ (1,0) [0|255] ""  Track
 SG_ Track_OD_CAN2_Baudrate m1124 : 16|16@1+ (1,0) [125|1000] "kbps"  Track
 SG_ Track_OD_CAN2_autoErrorReset m1123 : 16|8@1+ (1,0) [0|255] ""  Track
 SG_ Track_OD_CAN2_lastErrorCode m1122 : 16|32@1+ (1,0) [0|4294967295] ""  Track
 SG_ Track_OD_CAN2_RxErrCnt m1121 : 16|8@1+ (1,0) [0|255] ""  Track
 SG_ Track_OD_CAN2_TxErrCnt m1120 : 16|8@1+ (1,0) [0|255] ""  Track
 SG_ Track_OD_CAN1_DelayedTxMessages m1113 : 16|24@1+ (1,0) [0|16777215] ""  Track
 SG_ Track_OD_CAN1_ErrorStatus m1112 : 16|8@1+ (1,0) [0|255] ""  Track
 SG_ Track_OD_CAN1_DiscardedTxMe_0000 m1111 : 16|24@1+ (1,0) [0|16777215] ""  Track
 SG_ Track_OD_CAN1_Status m1110 : 16|8@1+ (1,0) [0|255] ""  Track
 SG_ Track_OD_CAN1_Baudrate m1108 : 16|16@1+ (1,0) [125|1000] "kbps"  Track
 SG_ Track_OD_CAN1_autoErrorReset m1107 : 16|8@1+ (1,0) [0|255] ""  Track
 SG_ Track_OD_CAN1_lastErrorCode m1106 : 16|32@1+ (1,0) [0|4294967295] ""  Track
 SG_ Track_OD_CAN1_RxErrCnt m1105 : 16|8@1+ (1,0) [0|255] ""  Track
 SG_ Track_OD_CAN1_TxErrCnt m1104 : 16|8@1+ (1,0) [0|255] ""  Track
 SG_ Track_OD_BuildTime m1073 : 16|24@1+ (1,0) [0|16777215] ""  Track
 SG_ Track_OD_BuildDate m1072 : 16|32@1+ (1,0) [0|4294967295] ""  Track
 SG_ Track_OD_ChipUID2 m1057 : 16|48@1+ (1,0) [0|281474976710655] ""  Track
 SG_ Track_OD_ChipUID1 m1056 : 16|48@1+ (1,0) [0|281474976710655] ""  Track
 SG_ Track_OD_SdcOut m1046 : 16|8@1+ (1,0) [0|255] ""  Track
 SG_ Track_OD_SdcIn m1045 : 16|8@1+ (1,0) [0|255] ""  Track
 SG_ Track_OD_runtime m1044 : 16|24@1+ (1,0) [0|16777215] "ms"  Track
 SG_ Track_OD_InputVoltage m1043 : 16|16@1+ (0.001,0) [0|65.535] "V"  Track
 SG_ Track_OD_BoardTemp m1042 : 16|16@1+ (0.01,-30) [-30|625.35] "°C"  Track
 SG_ Track_OD_MemFree m1041 : 16|16@1+ (4,0) [0|262140] "bytes"  Track
 SG_ Track_OD_CpuUsage m1040 : 16|8@1+ (0.5,0) [0|100] "%"  Track
 SG_ Track_OD_OdEntrySendInterval m33 : 16|16@1+ (1,0) [0|65535] "ms"  Track
 SG_ Track_OD_SendOdOnBootup m32 : 16|8@1+ (1,0) [0|255] ""  Track
 SG_ Track_OD_HeartbeatInterval m16 : 16|16@1+ (1,0) [0|65535] "ms"  Track
 SG_ Track_OD_DbcVersion m5 : 16|16@1+ (1,0) [0|65535] ""  Track
 SG_ Track_OD_StackVersion m4 : 16|16@1+ (1,0) [0|65535] ""  Track
 SG_ Track_OD_ProtocolVersion m3 : 16|16@1+ (1,0) [0|65535] ""  Track
 SG_ Track_OD_NodeStatus m2 : 16|8@1+ (1,0) [0|255] ""  Track
 SG_ Track_OD_NodeID m1 : 16|8@1+ (1,0) [0|255] ""  Track
 SG_ Track_SDO_ID M : 0|12@1+ (1,0) [0|4095] ""  Track

BO_ 1586 Track_SDO_Req_Down: 2 TelemetryNode
 SG_ Track_SDO_ID M : 0|12@1+ (1,0) [0|4095] ""  Track

BO_ 1842 Track_Heartbeat: 1 Track
 SG_ Track_NodeState : 0|8@1+ (1,0) [0|0] ""  Master,TelemetryNode

BO_ 1906 Track_BTL_TX: 8 Track

BO_ 1970 Track_BTL_RX: 8 TelemetryNode

BO_ 148 CLU_EMCY: 4 CLU
 SG_ CLU_E0_OtherError : 12|1@1+ (1,0) [0|0] ""  Master,TelemetryNode
 SG_ CLU_W0_OtherWarning : 0|1@1+ (1,0) [0|0] ""  Master,TelemetryNode

BO_ 404 CLU_TX_PDO1: 0 CLU

BO_ 468 CLU_RX_PDO1: 0 Vector__XXX

BO_ 532 CLU_TX_PDO2: 0 CLU

BO_ 596 CLU_RX_PDO2: 0 Vector__XXX

BO_ 660 CLU_TX_PDO3: 0 CLU

BO_ 724 CLU_RX_PDO3: 0 Vector__XXX

BO_ 788 CLU_TX_PDO4: 0 CLU

BO_ 852 CLU_RX_PDO4: 0 Vector__XXX

BO_ 916 CLU_TX_PDO5: 0 CLU

BO_ 980 CLU_TX_PDO6: 0 CLU

BO_ 1044 CLU_TX_PDO7: 0 CLU

BO_ 1108 CLU_TX_PDO8: 0 CLU

BO_ 1172 CLU_TX_PDO9: 0 CLU

BO_ 1236 CLU_TX_PDO10: 0 CLU

BO_ 1300 CLU_TX_PDO11: 0 CLU

BO_ 1364 CLU_TX_PDO12: 0 CLU

BO_ 1428 CLU_SDO_Resp: 8 CLU
 SG_ CLU_OD_CAN2_DelayedTxMessages m1129 : 16|24@1+ (1,0) [0|16777215] ""  TelemetryNode
 SG_ CLU_OD_CAN2_ErrorStatus m1128 : 16|8@1+ (1,0) [0|255] ""  TelemetryNode
 SG_ CLU_OD_CAN2_DiscardedTxMessages m1127 : 16|24@1+ (1,0) [0|16777215] ""  TelemetryNode
 SG_ CLU_OD_CAN2_Status m1126 : 16|8@1+ (1,0) [0|255] ""  TelemetryNode
 SG_ CLU_OD_CAN2_Baudrate m1124 : 16|16@1+ (1,0) [125|1000] "kbps"  TelemetryNode
 SG_ CLU_OD_CAN2_autoErrorReset m1123 : 16|8@1+ (1,0) [0|255] ""  TelemetryNode
 SG_ CLU_OD_CAN2_lastErrorCode m1122 : 16|32@1+ (1,0) [0|4294967295] ""  TelemetryNode
 SG_ CLU_OD_CAN2_RxErrCnt m1121 : 16|8@1+ (1,0) [0|255] ""  TelemetryNode
 SG_ CLU_OD_CAN2_TxErrCnt m1120 : 16|8@1+ (1,0) [0|255] ""  TelemetryNode
 SG_ CLU_OD_CAN1_DelayedTxMessages m1113 : 16|24@1+ (1,0) [0|16777215] ""  TelemetryNode
 SG_ CLU_OD_CAN1_ErrorStatus m1112 : 16|8@1+ (1,0) [0|255] ""  TelemetryNode
 SG_ CLU_OD_CAN1_DiscardedTxMessages m1111 : 16|24@1+ (1,0) [0|16777215] ""  TelemetryNode
 SG_ CLU_OD_CAN1_Status m1110 : 16|8@1+ (1,0) [0|255] ""  TelemetryNode
 SG_ CLU_OD_CAN1_Baudrate m1108 : 16|16@1+ (1,0) [125|1000] "kbps"  TelemetryNode
 SG_ CLU_OD_CAN1_autoErrorReset m1107 : 16|8@1+ (1,0) [0|255] ""  TelemetryNode
 SG_ CLU_OD_CAN1_lastErrorCode m1106 : 16|32@1+ (1,0) [0|4294967295] ""  TelemetryNode
 SG_ CLU_OD_CAN1_RxErrCnt m1105 : 16|8@1+ (1,0) [0|255] ""  TelemetryNode
 SG_ CLU_OD_CAN1_TxErrCnt m1104 : 16|8@1+ (1,0) [0|255] ""  TelemetryNode
 SG_ CLU_OD_BuildTime m1073 : 16|24@1+ (1,0) [0|16777215] ""  TelemetryNode
 SG_ CLU_OD_BuildDate m1072 : 16|32@1+ (1,0) [0|4294967295] ""  TelemetryNode
 SG_ CLU_OD_ChipUID2 m1057 : 16|48@1+ (1,0) [0|281474976710655] ""  TelemetryNode
 SG_ CLU_OD_ChipUID1 m1056 : 16|48@1+ (1,0) [0|281474976710655] ""  TelemetryNode
 SG_ CLU_OD_SdcOut m1046 : 16|8@1+ (1,0) [0|255] ""  TelemetryNode
 SG_ CLU_OD_SdcIn m1045 : 16|8@1+ (1,0) [0|255] ""  TelemetryNode
 SG_ CLU_OD_runtime m1044 : 16|24@1+ (1,0) [0|16777215] "ms"  TelemetryNode
 SG_ CLU_OD_InputVoltage m1043 : 16|16@1+ (0.001,0) [0|65.535] "V"  TelemetryNode
 SG_ CLU_OD_BoardTemp m1042 : 16|16@1+ (0.01,-30) [-30|625.35] "°C"  TelemetryNode
 SG_ CLU_OD_MemFree m1041 : 16|16@1+ (4,0) [0|262140] "bytes"  TelemetryNode
 SG_ CLU_OD_CpuUsage m1040 : 16|8@1+ (0.5,0) [0|100] "%"  TelemetryNode
 SG_ CLU_OD_OdEntrySendInterval m33 : 16|16@1+ (1,0) [0|65535] "ms"  TelemetryNode
 SG_ CLU_OD_SendOdOnBootup m32 : 16|8@1+ (1,0) [0|255] ""  TelemetryNode
 SG_ CLU_OD_HeartbeatInterval m16 : 16|16@1+ (1,0) [0|65535] "ms"  TelemetryNode
 SG_ CLU_OD_DbcVersion m5 : 16|16@1+ (1,0) [0|65535] ""  TelemetryNode
 SG_ CLU_OD_StackVersion m4 : 16|16@1+ (1,0) [0|65535] ""  TelemetryNode
 SG_ CLU_OD_ProtocolVersion m3 : 16|16@1+ (1,0) [0|65535] ""  TelemetryNode
 SG_ CLU_OD_NodeStatus m2 : 16|8@1+ (1,0) [0|255] ""  TelemetryNode
 SG_ CLU_OD_NodeID m1 : 16|8@1+ (1,0) [0|255] ""  TelemetryNode
 SG_ CLU_SDO_RespCode : 12|4@1+ (1,0) [0|0] ""  TelemetryNode
 SG_ CLU_SDO_ID M : 0|12@1+ (1,0) [0|4095] ""  TelemetryNode

BO_ 1492 CLU_SDO_Req_Up: 8 TelemetryNode
 SG_ CLU_OD_CAN2_DelayedTxMessages m1129 : 16|24@1+ (1,0) [0|16777215] ""  CLU
 SG_ CLU_OD_CAN2_ErrorStatus m1128 : 16|8@1+ (1,0) [0|255] ""  CLU
 SG_ CLU_OD_CAN2_DiscardedTxMessages m1127 : 16|24@1+ (1,0) [0|16777215] ""  CLU
 SG_ CLU_OD_CAN2_Status m1126 : 16|8@1+ (1,0) [0|255] ""  CLU
 SG_ CLU_OD_CAN2_Baudrate m1124 : 16|16@1+ (1,0) [125|1000] "kbps"  CLU
 SG_ CLU_OD_CAN2_autoErrorReset m1123 : 16|8@1+ (1,0) [0|255] ""  CLU
 SG_ CLU_OD_CAN2_lastErrorCode m1122 : 16|32@1+ (1,0) [0|4294967295] ""  CLU
 SG_ CLU_OD_CAN2_RxErrCnt m1121 : 16|8@1+ (1,0) [0|255] ""  CLU
 SG_ CLU_OD_CAN2_TxErrCnt m1120 : 16|8@1+ (1,0) [0|255] ""  CLU
 SG_ CLU_OD_CAN1_DelayedTxMessages m1113 : 16|24@1+ (1,0) [0|16777215] ""  CLU
 SG_ CLU_OD_CAN1_ErrorStatus m1112 : 16|8@1+ (1,0) [0|255] ""  CLU
 SG_ CLU_OD_CAN1_DiscardedTxMessages m1111 : 16|24@1+ (1,0) [0|16777215] ""  CLU
 SG_ CLU_OD_CAN1_Status m1110 : 16|8@1+ (1,0) [0|255] ""  CLU
 SG_ CLU_OD_CAN1_Baudrate m1108 : 16|16@1+ (1,0) [125|1000] "kbps"  CLU
 SG_ CLU_OD_CAN1_autoErrorReset m1107 : 16|8@1+ (1,0) [0|255] ""  CLU
 SG_ CLU_OD_CAN1_lastErrorCode m1106 : 16|32@1+ (1,0) [0|4294967295] ""  CLU
 SG_ CLU_OD_CAN1_RxErrCnt m1105 : 16|8@1+ (1,0) [0|255] ""  CLU
 SG_ CLU_OD_CAN1_TxErrCnt m1104 : 16|8@1+ (1,0) [0|255] ""  CLU
 SG_ CLU_OD_BuildTime m1073 : 16|24@1+ (1,0) [0|16777215] ""  CLU
 SG_ CLU_OD_BuildDate m1072 : 16|32@1+ (1,0) [0|4294967295] ""  CLU
 SG_ CLU_OD_ChipUID2 m1057 : 16|48@1+ (1,0) [0|281474976710655] ""  CLU
 SG_ CLU_OD_ChipUID1 m1056 : 16|48@1+ (1,0) [0|281474976710655] ""  CLU
 SG_ CLU_OD_SdcOut m1046 : 16|8@1+ (1,0) [0|255] ""  CLU
 SG_ CLU_OD_SdcIn m1045 : 16|8@1+ (1,0) [0|255] ""  CLU
 SG_ CLU_OD_runtime m1044 : 16|24@1+ (1,0) [0|16777215] "ms"  CLU
 SG_ CLU_OD_InputVoltage m1043 : 16|16@1+ (0.001,0) [0|65.535] "V"  CLU
 SG_ CLU_OD_BoardTemp m1042 : 16|16@1+ (0.01,-30) [-30|625.35] "°C"  CLU
 SG_ CLU_OD_MemFree m1041 : 16|16@1+ (4,0) [0|262140] "bytes"  CLU
 SG_ CLU_OD_CpuUsage m1040 : 16|8@1+ (0.5,0) [0|100] "%"  CLU
 SG_ CLU_OD_OdEntrySendInterval m33 : 16|16@1+ (1,0) [0|65535] "ms"  CLU
 SG_ CLU_OD_SendOdOnBootup m32 : 16|8@1+ (1,0) [0|255] ""  CLU
 SG_ CLU_OD_HeartbeatInterval m16 : 16|16@1+ (1,0) [0|65535] "ms"  CLU
 SG_ CLU_OD_DbcVersion m5 : 16|16@1+ (1,0) [0|65535] ""  CLU
 SG_ CLU_OD_StackVersion m4 : 16|16@1+ (1,0) [0|65535] ""  CLU
 SG_ CLU_OD_ProtocolVersion m3 : 16|16@1+ (1,0) [0|65535] ""  CLU
 SG_ CLU_OD_NodeStatus m2 : 16|8@1+ (1,0) [0|255] ""  CLU
 SG_ CLU_OD_NodeID m1 : 16|8@1+ (1,0) [0|255] ""  CLU
 SG_ CLU_SDO_ID M : 0|12@1+ (1,0) [0|4095] ""  CLU

BO_ 1556 CLU_SDO_Req_Down: 2 TelemetryNode
 SG_ CLU_SDO_ID M : 0|12@1+ (1,0) [0|4095] ""  CLU

BO_ 1812 CLU_Heartbeat: 1 CLU
 SG_ CLU_NodeState : 0|8@1+ (1,0) [0|0] ""  Master,TelemetryNode

BO_ 1876 CLU_BTL_TX: 8 CLU

BO_ 1940 CLU_BTL_RX: 8 TelemetryNode

CM_ BO_ 1447 "DO NOT CHANGE ANYTHING HERE!
SDO Response of node MDB3 with Node-ID 0x27";
CM_ SG_ 1447 MDB3_OD_CAN2_DelayedTxMessages "Number of delayed TX messages on CAN2 because no messagebox was free.";
CM_ SG_ 1447 MDB3_OD_CAN2_ErrorStatus "Internal error status (e.g. Error active, Error passive, Bus Off)";
CM_ SG_ 1447 MDB3_OD_CAN2_DiscardedTxMessages "Number of discarded TX messages on CAN2 because all messageboxes were full";
CM_ SG_ 1447 MDB3_OD_CAN2_Status "Status of CAN2.";
CM_ SG_ 1447 MDB3_OD_CAN2_Baudrate "Baudrate of CAN.";
CM_ SG_ 1447 MDB3_OD_CAN2_autoErrorReset "Automatic reset of errors.";
CM_ SG_ 1447 MDB3_OD_CAN2_lastErrorCode "Last error code.";
CM_ SG_ 1447 MDB3_OD_CAN2_RxErrCnt "Receive error count of CAN1.";
CM_ SG_ 1447 MDB3_OD_CAN2_TxErrCnt "Transmit error count of CAN1.";
CM_ SG_ 1447 MDB3_OD_CAN1_DelayedTxMessages "Number of delayed TX messages on CAN1 because no messagebox was free.";
CM_ SG_ 1447 MDB3_OD_CAN1_ErrorStatus "Internal error status (e.g. Error active, Error passive, Bus Off)";
CM_ SG_ 1447 MDB3_OD_CAN1_DiscardedTxMessages "Number of discarded TX messages on CAN1 because all messageboxes were full";
CM_ SG_ 1447 MDB3_OD_CAN1_Status "Status of CAN1.";
CM_ SG_ 1447 MDB3_OD_CAN1_Baudrate "Baudrate of CAN.";
CM_ SG_ 1447 MDB3_OD_CAN1_autoErrorReset "Automatic reset of errors.";
CM_ SG_ 1447 MDB3_OD_CAN1_lastErrorCode "Last error code.";
CM_ SG_ 1447 MDB3_OD_CAN1_RxErrCnt "Receive error count of CAN1.";
CM_ SG_ 1447 MDB3_OD_CAN1_TxErrCnt "Transmit error count of CAN1.";
CM_ SG_ 1447 MDB3_OD_BuildTime "Software build time in the format HHMMSS.";
CM_ SG_ 1447 MDB3_OD_BuildDate "Software build date in the format YYYYMMDD.";
CM_ SG_ 1447 MDB3_OD_ChipUID2 "Seccond part of unique ID of microcontroller.";
CM_ SG_ 1447 MDB3_OD_ChipUID1 "First part of unique ID of microcontroller.";
CM_ SG_ 1447 MDB3_OD_SdcOut "Measurement of Shutdown Circuit Output";
CM_ SG_ 1447 MDB3_OD_SdcIn "Measurement of Shutdown Circuit Input";
CM_ SG_ 1447 MDB3_OD_runtime "Runtime of chip in milliseconds.";
CM_ SG_ 1447 MDB3_OD_InputVoltage "Board supply voltage.";
CM_ SG_ 1447 MDB3_OD_BoardTemp "Temperature of board";
CM_ SG_ 1447 MDB3_OD_MemFree "Free memory in bytes.";
CM_ SG_ 1447 MDB3_OD_CpuUsage "Current CPU usage in %.";
CM_ SG_ 1447 MDB3_OD_OdEntrySendInterval "Interval for sending all readable OD entries. Sending is disabled if less than 5 ms.";
CM_ SG_ 1447 MDB3_OD_SendOdOnBootup "Whether to send all OD entries on bootup.";
CM_ SG_ 1447 MDB3_OD_HeartbeatInterval "Heartbeat Interval in milliseconds.";
CM_ SG_ 1447 MDB3_OD_DbcVersion "CANzero DBC version.";
CM_ SG_ 1447 MDB3_OD_StackVersion "CANzero stack version.";
CM_ SG_ 1447 MDB3_OD_ProtocolVersion "CANzero Protocol Version.";
CM_ SG_ 1447 MDB3_OD_NodeStatus "State of the node.";
CM_ SG_ 1447 MDB3_OD_NodeID "CANzero Node-ID.";
CM_ SG_ 1447 MDB3_SDO_RespCode "Response code of SDO access.";
CM_ SG_ 1447 MDB3_SDO_ID "Specifies SDO-ID of MDB3";
CM_ BO_ 1511 "DO NOT CHANGE ANYTHING HERE!
SDO Request Upload to node MDB3 with Node-ID 0x27";
CM_ SG_ 1511 MDB3_OD_CAN2_DelayedTxMessages "Number of delayed TX messages on CAN2 because no messagebox was free.";
CM_ SG_ 1511 MDB3_OD_CAN2_ErrorStatus "Internal error status (e.g. Error active, Error passive, Bus Off)";
CM_ SG_ 1511 MDB3_OD_CAN2_DiscardedTxMessages "Number of discarded TX messages on CAN2 because all messageboxes were full";
CM_ SG_ 1511 MDB3_OD_CAN2_Status "Status of CAN2.";
CM_ SG_ 1511 MDB3_OD_CAN2_Baudrate "Baudrate of CAN.";
CM_ SG_ 1511 MDB3_OD_CAN2_autoErrorReset "Automatic reset of errors.";
CM_ SG_ 1511 MDB3_OD_CAN2_lastErrorCode "Last error code.";
CM_ SG_ 1511 MDB3_OD_CAN2_RxErrCnt "Receive error count of CAN1.";
CM_ SG_ 1511 MDB3_OD_CAN2_TxErrCnt "Transmit error count of CAN1.";
CM_ SG_ 1511 MDB3_OD_CAN1_DelayedTxMessages "Number of delayed TX messages on CAN1 because no messagebox was free.";
CM_ SG_ 1511 MDB3_OD_CAN1_ErrorStatus "Internal error status (e.g. Error active, Error passive, Bus Off)";
CM_ SG_ 1511 MDB3_OD_CAN1_DiscardedTxMessages "Number of discarded TX messages on CAN1 because all messageboxes were full";
CM_ SG_ 1511 MDB3_OD_CAN1_Status "Status of CAN1.";
CM_ SG_ 1511 MDB3_OD_CAN1_Baudrate "Baudrate of CAN.";
CM_ SG_ 1511 MDB3_OD_CAN1_autoErrorReset "Automatic reset of errors.";
CM_ SG_ 1511 MDB3_OD_CAN1_lastErrorCode "Last error code.";
CM_ SG_ 1511 MDB3_OD_CAN1_RxErrCnt "Receive error count of CAN1.";
CM_ SG_ 1511 MDB3_OD_CAN1_TxErrCnt "Transmit error count of CAN1.";
CM_ SG_ 1511 MDB3_OD_BuildTime "Software build time in the format HHMMSS.";
CM_ SG_ 1511 MDB3_OD_BuildDate "Software build date in the format YYYYMMDD.";
CM_ SG_ 1511 MDB3_OD_ChipUID2 "Seccond part of unique ID of microcontroller.";
CM_ SG_ 1511 MDB3_OD_ChipUID1 "First part of unique ID of microcontroller.";
CM_ SG_ 1511 MDB3_OD_SdcOut "Measurement of Shutdown Circuit Output";
CM_ SG_ 1511 MDB3_OD_SdcIn "Measurement of Shutdown Circuit Input";
CM_ SG_ 1511 MDB3_OD_runtime "Runtime of chip in milliseconds.";
CM_ SG_ 1511 MDB3_OD_InputVoltage "Board supply voltage.";
CM_ SG_ 1511 MDB3_OD_BoardTemp "Temperature of board";
CM_ SG_ 1511 MDB3_OD_MemFree "Free memory in bytes.";
CM_ SG_ 1511 MDB3_OD_CpuUsage "Current CPU usage in %.";
CM_ SG_ 1511 MDB3_OD_OdEntrySendInterval "Interval for sending all readable OD entries. Sending is disabled if less than 5 ms.";
CM_ SG_ 1511 MDB3_OD_SendOdOnBootup "Whether to send all OD entries on bootup.";
CM_ SG_ 1511 MDB3_OD_HeartbeatInterval "Heartbeat Interval in milliseconds.";
CM_ SG_ 1511 MDB3_OD_DbcVersion "CANzero DBC version.";
CM_ SG_ 1511 MDB3_OD_StackVersion "CANzero stack version.";
CM_ SG_ 1511 MDB3_OD_ProtocolVersion "CANzero Protocol Version.";
CM_ SG_ 1511 MDB3_OD_NodeStatus "State of the node.";
CM_ SG_ 1511 MDB3_OD_NodeID "CANzero Node-ID.";
CM_ SG_ 1511 MDB3_SDO_ID "Specifies SDO-ID of MDB3";
CM_ BO_ 1575 "DO NOT CHANGE ANYTHING HERE!
SDO Request Download from node MDB3 with Node-ID 0x27";
CM_ SG_ 1575 MDB3_SDO_ID "Specifies SDO-ID of MDB3";
CM_ BO_ 1831 "Heartbeat of node MDB3 with Node-ID 0x27";
CM_ SG_ 1831 MDB3_NodeState "Heartbeat status of node MDB3";
CM_ BO_ 1895 "Bootloader transmit from node MDB3 with Node-ID 0x27";
CM_ BO_ 1959 "Bootloader receive by node MDB3 with Node-ID 0x27";
CM_ BO_ 168 "Emergency message of node MDB4 with Node-ID 0x28";
CM_ SG_ 168 MDB4_E0_OtherError "Other error.";
CM_ SG_ 168 MDB4_W0_OtherWarning "Other warning.";
CM_ BO_ 424 "Transmit PDO 1 of node MDB4 with Node-ID 0x28";
CM_ BO_ 488 "Receive PDO 1 of node MDB4 with Node-ID 0x28";
CM_ BO_ 552 "Transmit PDO 2 of node MDB4 with Node-ID 0x28";
CM_ BO_ 616 "Receive PDO 2 of node MDB4 with Node-ID 0x28";
CM_ BO_ 680 "Transmit PDO 3 of node MDB4 with Node-ID 0x28";
CM_ BO_ 744 "Receive PDO 3 of node MDB4 with Node-ID 0x28";
CM_ BO_ 808 "Transmit PDO 4 of node MDB4 with Node-ID 0x28";
CM_ BO_ 872 "Receive PDO 4 of node MDB4 with Node-ID 0x28";
CM_ BO_ 936 "Transmit PDO 5 of node MDB4 with Node-ID 0x28";
CM_ BO_ 1000 "Transmit PDO 6 of node MDB4 with Node-ID 0x28";
CM_ BO_ 1064 "Transmit PDO 7 of node MDB4 with Node-ID 0x28";
CM_ BO_ 1128 "Transmit PDO 8 of node MDB4 with Node-ID 0x28";
CM_ BO_ 1192 "Transmit PDO 9 of node MDB4 with Node-ID 0x28";
CM_ BO_ 1256 "Transmit PDO 10 of node MDB4 with Node-ID 0x28";
CM_ BO_ 1320 "Transmit PDO 11 of node MDB4 with Node-ID 0x28";
CM_ BO_ 1384 "Transmit PDO 12 of node MDB4 with Node-ID 0x28";
CM_ BO_ 1448 "DO NOT CHANGE ANYTHING HERE!
SDO Response of node MDB4 with Node-ID 0x28";
CM_ SG_ 1448 MDB4_OD_CAN2_DelayedTxMessages "Number of delayed TX messages on CAN2 because no messagebox was free.";
CM_ SG_ 1448 MDB4_OD_CAN2_ErrorStatus "Internal error status (e.g. Error active, Error passive, Bus Off)";
CM_ SG_ 1448 MDB4_OD_CAN2_DiscardedTxMessages "Number of discarded TX messages on CAN2 because all messageboxes were full";
CM_ SG_ 1448 MDB4_OD_CAN2_Status "Status of CAN2.";
CM_ SG_ 1448 MDB4_OD_CAN2_Baudrate "Baudrate of CAN.";
CM_ SG_ 1448 MDB4_OD_CAN2_autoErrorReset "Automatic reset of errors.";
CM_ SG_ 1448 MDB4_OD_CAN2_lastErrorCode "Last error code.";
CM_ SG_ 1448 MDB4_OD_CAN2_RxErrCnt "Receive error count of CAN1.";
CM_ SG_ 1448 MDB4_OD_CAN2_TxErrCnt "Transmit error count of CAN1.";
CM_ SG_ 1448 MDB4_OD_CAN1_DelayedTxMessages "Number of delayed TX messages on CAN1 because no messagebox was free.";
CM_ SG_ 1448 MDB4_OD_CAN1_ErrorStatus "Internal error status (e.g. Error active, Error passive, Bus Off)";
CM_ SG_ 1448 MDB4_OD_CAN1_DiscardedTxMessages "Number of discarded TX messages on CAN1 because all messageboxes were full";
CM_ SG_ 1448 MDB4_OD_CAN1_Status "Status of CAN1.";
CM_ SG_ 1448 MDB4_OD_CAN1_Baudrate "Baudrate of CAN.";
CM_ SG_ 1448 MDB4_OD_CAN1_autoErrorReset "Automatic reset of errors.";
CM_ SG_ 1448 MDB4_OD_CAN1_lastErrorCode "Last error code.";
CM_ SG_ 1448 MDB4_OD_CAN1_RxErrCnt "Receive error count of CAN1.";
CM_ SG_ 1448 MDB4_OD_CAN1_TxErrCnt "Transmit error count of CAN1.";
CM_ SG_ 1448 MDB4_OD_BuildTime "Software build time in the format HHMMSS.";
CM_ SG_ 1448 MDB4_OD_BuildDate "Software build date in the format YYYYMMDD.";
CM_ SG_ 1448 MDB4_OD_ChipUID2 "Seccond part of unique ID of microcontroller.";
CM_ SG_ 1448 MDB4_OD_ChipUID1 "First part of unique ID of microcontroller.";
CM_ SG_ 1448 MDB4_OD_SdcOut "Measurement of Shutdown Circuit Output";
CM_ SG_ 1448 MDB4_OD_SdcIn "Measurement of Shutdown Circuit Input";
CM_ SG_ 1448 MDB4_OD_runtime "Runtime of chip in milliseconds.";
CM_ SG_ 1448 MDB4_OD_InputVoltage "Board supply voltage.";
CM_ SG_ 1448 MDB4_OD_BoardTemp "Temperature of board";
CM_ SG_ 1448 MDB4_OD_MemFree "Free memory in bytes.";
CM_ SG_ 1448 MDB4_OD_CpuUsage "Current CPU usage in %.";
CM_ SG_ 1448 MDB4_OD_OdEntrySendInterval "Interval for sending all readable OD entries. Sending is disabled if less than 5 ms.";
CM_ SG_ 1448 MDB4_OD_SendOdOnBootup "Whether to send all OD entries on bootup.";
CM_ SG_ 1448 MDB4_OD_HeartbeatInterval "Heartbeat Interval in milliseconds.";
CM_ SG_ 1448 MDB4_OD_DbcVersion "CANzero DBC version.";
CM_ SG_ 1448 MDB4_OD_StackVersion "CANzero stack version.";
CM_ SG_ 1448 MDB4_OD_ProtocolVersion "CANzero Protocol Version.";
CM_ SG_ 1448 MDB4_OD_NodeStatus "State of the node.";
CM_ SG_ 1448 MDB4_OD_NodeID "CANzero Node-ID.";
CM_ SG_ 1448 MDB4_SDO_RespCode "Response code of SDO access.";
CM_ SG_ 1448 MDB4_SDO_ID "Specifies SDO-ID of MDB4";
CM_ BO_ 1512 "DO NOT CHANGE ANYTHING HERE!
SDO Request Upload to node MDB4 with Node-ID 0x28";
CM_ SG_ 1512 MDB4_OD_CAN2_DelayedTxMessages "Number of delayed TX messages on CAN2 because no messagebox was free.";
CM_ SG_ 1512 MDB4_OD_CAN2_ErrorStatus "Internal error status (e.g. Error active, Error passive, Bus Off)";
CM_ SG_ 1512 MDB4_OD_CAN2_DiscardedTxMessages "Number of discarded TX messages on CAN2 because all messageboxes were full";
CM_ SG_ 1512 MDB4_OD_CAN2_Status "Status of CAN2.";
CM_ SG_ 1512 MDB4_OD_CAN2_Baudrate "Baudrate of CAN.";
CM_ SG_ 1512 MDB4_OD_CAN2_autoErrorReset "Automatic reset of errors.";
CM_ SG_ 1512 MDB4_OD_CAN2_lastErrorCode "Last error code.";
CM_ SG_ 1512 MDB4_OD_CAN2_RxErrCnt "Receive error count of CAN1.";
CM_ SG_ 1512 MDB4_OD_CAN2_TxErrCnt "Transmit error count of CAN1.";
CM_ SG_ 1512 MDB4_OD_CAN1_DelayedTxMessages "Number of delayed TX messages on CAN1 because no messagebox was free.";
CM_ SG_ 1512 MDB4_OD_CAN1_ErrorStatus "Internal error status (e.g. Error active, Error passive, Bus Off)";
CM_ SG_ 1512 MDB4_OD_CAN1_DiscardedTxMessages "Number of discarded TX messages on CAN1 because all messageboxes were full";
CM_ SG_ 1512 MDB4_OD_CAN1_Status "Status of CAN1.";
CM_ SG_ 1512 MDB4_OD_CAN1_Baudrate "Baudrate of CAN.";
CM_ SG_ 1512 MDB4_OD_CAN1_autoErrorReset "Automatic reset of errors.";
CM_ SG_ 1512 MDB4_OD_CAN1_lastErrorCode "Last error code.";
CM_ SG_ 1512 MDB4_OD_CAN1_RxErrCnt "Receive error count of CAN1.";
CM_ SG_ 1512 MDB4_OD_CAN1_TxErrCnt "Transmit error count of CAN1.";
CM_ SG_ 1512 MDB4_OD_BuildTime "Software build time in the format HHMMSS.";
CM_ SG_ 1512 MDB4_OD_BuildDate "Software build date in the format YYYYMMDD.";
CM_ SG_ 1512 MDB4_OD_ChipUID2 "Seccond part of unique ID of microcontroller.";
CM_ SG_ 1512 MDB4_OD_ChipUID1 "First part of unique ID of microcontroller.";
CM_ SG_ 1512 MDB4_OD_SdcOut "Measurement of Shutdown Circuit Output";
CM_ SG_ 1512 MDB4_OD_SdcIn "Measurement of Shutdown Circuit Input";
CM_ SG_ 1512 MDB4_OD_runtime "Runtime of chip in milliseconds.";
CM_ SG_ 1512 MDB4_OD_InputVoltage "Board supply voltage.";
CM_ SG_ 1512 MDB4_OD_BoardTemp "Temperature of board";
CM_ SG_ 1512 MDB4_OD_MemFree "Free memory in bytes.";
CM_ SG_ 1512 MDB4_OD_CpuUsage "Current CPU usage in %.";
CM_ SG_ 1512 MDB4_OD_OdEntrySendInterval "Interval for sending all readable OD entries. Sending is disabled if less than 5 ms.";
CM_ SG_ 1512 MDB4_OD_SendOdOnBootup "Whether to send all OD entries on bootup.";
CM_ SG_ 1512 MDB4_OD_HeartbeatInterval "Heartbeat Interval in milliseconds.";
CM_ SG_ 1512 MDB4_OD_DbcVersion "CANzero DBC version.";
CM_ SG_ 1512 MDB4_OD_StackVersion "CANzero stack version.";
CM_ SG_ 1512 MDB4_OD_ProtocolVersion "CANzero Protocol Version.";
CM_ SG_ 1512 MDB4_OD_NodeStatus "State of the node.";
CM_ SG_ 1512 MDB4_OD_NodeID "CANzero Node-ID.";
CM_ SG_ 1512 MDB4_SDO_ID "Specifies SDO-ID of MDB4";
CM_ BO_ 1576 "DO NOT CHANGE ANYTHING HERE!
SDO Request Download from node MDB4 with Node-ID 0x28";
CM_ SG_ 1576 MDB4_SDO_ID "Specifies SDO-ID of MDB4";
CM_ BO_ 1832 "Heartbeat of node MDB4 with Node-ID 0x28";
CM_ SG_ 1832 MDB4_NodeState "Heartbeat status of node MDB4";
CM_ BO_ 1896 "Bootloader transmit from node MDB4 with Node-ID 0x28";
CM_ BO_ 1960 "Bootloader receive by node MDB4 with Node-ID 0x28";
CM_ BO_ 169 "Emergency message of node MDB5 with Node-ID 0x29";
CM_ SG_ 169 MDB5_E0_OtherError "Other error.";
CM_ SG_ 169 MDB5_W0_OtherWarning "Other warning.";
CM_ BO_ 425 "Transmit PDO 1 of node MDB5 with Node-ID 0x29";
CM_ BO_ 489 "Receive PDO 1 of node MDB5 with Node-ID 0x29";
CM_ BO_ 553 "Transmit PDO 2 of node MDB5 with Node-ID 0x29";
CM_ BO_ 617 "Receive PDO 2 of node MDB5 with Node-ID 0x29";
CM_ BO_ 681 "Transmit PDO 3 of node MDB5 with Node-ID 0x29";
CM_ BO_ 745 "Receive PDO 3 of node MDB5 with Node-ID 0x29";
CM_ BO_ 809 "Transmit PDO 4 of node MDB5 with Node-ID 0x29";
CM_ BO_ 873 "Receive PDO 4 of node MDB5 with Node-ID 0x29";
CM_ BO_ 937 "Transmit PDO 5 of node MDB5 with Node-ID 0x29";
CM_ BO_ 1001 "Transmit PDO 6 of node MDB5 with Node-ID 0x29";
CM_ BO_ 1065 "Transmit PDO 7 of node MDB5 with Node-ID 0x29";
CM_ BO_ 1129 "Transmit PDO 8 of node MDB5 with Node-ID 0x29";
CM_ BO_ 1193 "Transmit PDO 9 of node MDB5 with Node-ID 0x29";
CM_ BO_ 1257 "Transmit PDO 10 of node MDB5 with Node-ID 0x29";
CM_ BO_ 1321 "Transmit PDO 11 of node MDB5 with Node-ID 0x29";
CM_ BO_ 1385 "Transmit PDO 12 of node MDB5 with Node-ID 0x29";
CM_ BO_ 1449 "DO NOT CHANGE ANYTHING HERE!
SDO Response of node MDB5 with Node-ID 0x29";
CM_ SG_ 1449 MDB5_OD_CAN2_DelayedTxMessages "Number of delayed TX messages on CAN2 because no messagebox was free.";
CM_ SG_ 1449 MDB5_OD_CAN2_ErrorStatus "Internal error status (e.g. Error active, Error passive, Bus Off)";
CM_ SG_ 1449 MDB5_OD_CAN2_DiscardedTxMessages "Number of discarded TX messages on CAN2 because all messageboxes were full";
CM_ SG_ 1449 MDB5_OD_CAN2_Status "Status of CAN2.";
CM_ SG_ 1449 MDB5_OD_CAN2_Baudrate "Baudrate of CAN.";
CM_ SG_ 1449 MDB5_OD_CAN2_autoErrorReset "Automatic reset of errors.";
CM_ SG_ 1449 MDB5_OD_CAN2_lastErrorCode "Last error code.";
CM_ SG_ 1449 MDB5_OD_CAN2_RxErrCnt "Receive error count of CAN1.";
CM_ SG_ 1449 MDB5_OD_CAN2_TxErrCnt "Transmit error count of CAN1.";
CM_ SG_ 1449 MDB5_OD_CAN1_DelayedTxMessages "Number of delayed TX messages on CAN1 because no messagebox was free.";
CM_ SG_ 1449 MDB5_OD_CAN1_ErrorStatus "Internal error status (e.g. Error active, Error passive, Bus Off)";
CM_ SG_ 1449 MDB5_OD_CAN1_DiscardedTxMessages "Number of discarded TX messages on CAN1 because all messageboxes were full";
CM_ SG_ 1449 MDB5_OD_CAN1_Status "Status of CAN1.";
CM_ SG_ 1449 MDB5_OD_CAN1_Baudrate "Baudrate of CAN.";
CM_ SG_ 1449 MDB5_OD_CAN1_autoErrorReset "Automatic reset of errors.";
CM_ SG_ 1449 MDB5_OD_CAN1_lastErrorCode "Last error code.";
CM_ SG_ 1449 MDB5_OD_CAN1_RxErrCnt "Receive error count of CAN1.";
CM_ SG_ 1449 MDB5_OD_CAN1_TxErrCnt "Transmit error count of CAN1.";
CM_ SG_ 1449 MDB5_OD_BuildTime "Software build time in the format HHMMSS.";
CM_ SG_ 1449 MDB5_OD_BuildDate "Software build date in the format YYYYMMDD.";
CM_ SG_ 1449 MDB5_OD_ChipUID2 "Seccond part of unique ID of microcontroller.";
CM_ SG_ 1449 MDB5_OD_ChipUID1 "First part of unique ID of microcontroller.";
CM_ SG_ 1449 MDB5_OD_SdcOut "Measurement of Shutdown Circuit Output";
CM_ SG_ 1449 MDB5_OD_SdcIn "Measurement of Shutdown Circuit Input";
CM_ SG_ 1449 MDB5_OD_runtime "Runtime of chip in milliseconds.";
CM_ SG_ 1449 MDB5_OD_InputVoltage "Board supply voltage.";
CM_ SG_ 1449 MDB5_OD_BoardTemp "Temperature of board";
CM_ SG_ 1449 MDB5_OD_MemFree "Free memory in bytes.";
CM_ SG_ 1449 MDB5_OD_CpuUsage "Current CPU usage in %.";
CM_ SG_ 1449 MDB5_OD_OdEntrySendInterval "Interval for sending all readable OD entries. Sending is disabled if less than 5 ms.";
CM_ SG_ 1449 MDB5_OD_SendOdOnBootup "Whether to send all OD entries on bootup.";
CM_ SG_ 1449 MDB5_OD_HeartbeatInterval "Heartbeat Interval in milliseconds.";
CM_ SG_ 1449 MDB5_OD_DbcVersion "CANzero DBC version.";
CM_ SG_ 1449 MDB5_OD_StackVersion "CANzero stack version.";
CM_ SG_ 1449 MDB5_OD_ProtocolVersion "CANzero Protocol Version.";
CM_ SG_ 1449 MDB5_OD_NodeStatus "State of the node.";
CM_ SG_ 1449 MDB5_OD_NodeID "CANzero Node-ID.";
CM_ SG_ 1449 MDB5_SDO_RespCode "Response code of SDO access.";
CM_ SG_ 1449 MDB5_SDO_ID "Specifies SDO-ID of MDB5";
CM_ BO_ 1513 "DO NOT CHANGE ANYTHING HERE!
SDO Request Upload to node MDB5 with Node-ID 0x29";
CM_ SG_ 1513 MDB5_OD_CAN2_DelayedTxMessages "Number of delayed TX messages on CAN2 because no messagebox was free.";
CM_ SG_ 1513 MDB5_OD_CAN2_ErrorStatus "Internal error status (e.g. Error active, Error passive, Bus Off)";
CM_ SG_ 1513 MDB5_OD_CAN2_DiscardedTxMessages "Number of discarded TX messages on CAN2 because all messageboxes were full";
CM_ SG_ 1513 MDB5_OD_CAN2_Status "Status of CAN2.";
CM_ SG_ 1513 MDB5_OD_CAN2_Baudrate "Baudrate of CAN.";
CM_ SG_ 1513 MDB5_OD_CAN2_autoErrorReset "Automatic reset of errors.";
CM_ SG_ 1513 MDB5_OD_CAN2_lastErrorCode "Last error code.";
CM_ SG_ 1513 MDB5_OD_CAN2_RxErrCnt "Receive error count of CAN1.";
CM_ SG_ 1513 MDB5_OD_CAN2_TxErrCnt "Transmit error count of CAN1.";
CM_ SG_ 1513 MDB5_OD_CAN1_DelayedTxMessages "Number of delayed TX messages on CAN1 because no messagebox was free.";
CM_ SG_ 1513 MDB5_OD_CAN1_ErrorStatus "Internal error status (e.g. Error active, Error passive, Bus Off)";
CM_ SG_ 1513 MDB5_OD_CAN1_DiscardedTxMessages "Number of discarded TX messages on CAN1 because all messageboxes were full";
CM_ SG_ 1513 MDB5_OD_CAN1_Status "Status of CAN1.";
CM_ SG_ 1513 MDB5_OD_CAN1_Baudrate "Baudrate of CAN.";
CM_ SG_ 1513 MDB5_OD_CAN1_autoErrorReset "Automatic reset of errors.";
CM_ SG_ 1513 MDB5_OD_CAN1_lastErrorCode "Last error code.";
CM_ SG_ 1513 MDB5_OD_CAN1_RxErrCnt "Receive error count of CAN1.";
CM_ SG_ 1513 MDB5_OD_CAN1_TxErrCnt "Transmit error count of CAN1.";
CM_ SG_ 1513 MDB5_OD_BuildTime "Software build time in the format HHMMSS.";
CM_ SG_ 1513 MDB5_OD_BuildDate "Software build date in the format YYYYMMDD.";
CM_ SG_ 1513 MDB5_OD_ChipUID2 "Seccond part of unique ID of microcontroller.";
CM_ SG_ 1513 MDB5_OD_ChipUID1 "First part of unique ID of microcontroller.";
CM_ SG_ 1513 MDB5_OD_SdcOut "Measurement of Shutdown Circuit Output";
CM_ SG_ 1513 MDB5_OD_SdcIn "Measurement of Shutdown Circuit Input";
CM_ SG_ 1513 MDB5_OD_runtime "Runtime of chip in milliseconds.";
CM_ SG_ 1513 MDB5_OD_InputVoltage "Board supply voltage.";
CM_ SG_ 1513 MDB5_OD_BoardTemp "Temperature of board";
CM_ SG_ 1513 MDB5_OD_MemFree "Free memory in bytes.";
CM_ SG_ 1513 MDB5_OD_CpuUsage "Current CPU usage in %.";
CM_ SG_ 1513 MDB5_OD_OdEntrySendInterval "Interval for sending all readable OD entries. Sending is disabled if less than 5 ms.";
CM_ SG_ 1513 MDB5_OD_SendOdOnBootup "Whether to send all OD entries on bootup.";
CM_ SG_ 1513 MDB5_OD_HeartbeatInterval "Heartbeat Interval in milliseconds.";
CM_ SG_ 1513 MDB5_OD_DbcVersion "CANzero DBC version.";
CM_ SG_ 1513 MDB5_OD_StackVersion "CANzero stack version.";
CM_ SG_ 1513 MDB5_OD_ProtocolVersion "CANzero Protocol Version.";
CM_ SG_ 1513 MDB5_OD_NodeStatus "State of the node.";
CM_ SG_ 1513 MDB5_OD_NodeID "CANzero Node-ID.";
CM_ SG_ 1513 MDB5_SDO_ID "Specifies SDO-ID of MDB5";
CM_ BO_ 1577 "DO NOT CHANGE ANYTHING HERE!
SDO Request Download from node MDB5 with Node-ID 0x29";
CM_ SG_ 1577 MDB5_SDO_ID "Specifies SDO-ID of MDB5";
CM_ BO_ 1833 "Heartbeat of node MDB5 with Node-ID 0x29";
CM_ SG_ 1833 MDB5_NodeState "Heartbeat status of node MDB5";
CM_ BO_ 1897 "Bootloader transmit from node MDB5 with Node-ID 0x29";
CM_ BO_ 1961 "Bootloader receive by node MDB5 with Node-ID 0x29";
CM_ BO_ 177 "Emergency message of node MDB6 with Node-ID 0x31";
CM_ SG_ 177 MDB6_E0_OtherError "Other error.";
CM_ SG_ 177 MDB6_W0_OtherWarning "Other warning.";
CM_ BO_ 433 "Transmit PDO 1 of node MDB6 with Node-ID 0x31";
CM_ BO_ 497 "Receive PDO 1 of node MDB6 with Node-ID 0x31";
CM_ BO_ 561 "Transmit PDO 2 of node MDB6 with Node-ID 0x31";
CM_ BO_ 625 "Receive PDO 2 of node MDB6 with Node-ID 0x31";
CM_ BO_ 689 "Transmit PDO 3 of node MDB6 with Node-ID 0x31";
CM_ BO_ 753 "Receive PDO 3 of node MDB6 with Node-ID 0x31";
CM_ BO_ 817 "Transmit PDO 4 of node MDB6 with Node-ID 0x31";
CM_ BO_ 881 "Receive PDO 4 of node MDB6 with Node-ID 0x31";
CM_ BO_ 945 "Transmit PDO 5 of node MDB6 with Node-ID 0x31";
CM_ BO_ 1009 "Transmit PDO 6 of node MDB6 with Node-ID 0x31";
CM_ BO_ 1073 "Transmit PDO 7 of node MDB6 with Node-ID 0x31";
CM_ BO_ 1137 "Transmit PDO 8 of node MDB6 with Node-ID 0x31";
CM_ BO_ 1201 "Transmit PDO 9 of node MDB6 with Node-ID 0x31";
CM_ BO_ 1265 "Transmit PDO 10 of node MDB6 with Node-ID 0x31";
CM_ BO_ 1329 "Transmit PDO 11 of node MDB6 with Node-ID 0x31";
CM_ BO_ 1393 "Transmit PDO 12 of node MDB6 with Node-ID 0x31";
CM_ BO_ 1457 "DO NOT CHANGE ANYTHING HERE!
SDO Response of node MDB6 with Node-ID 0x31";
CM_ SG_ 1457 MDB6_OD_CAN2_DelayedTxMessages "Number of delayed TX messages on CAN2 because no messagebox was free.";
CM_ SG_ 1457 MDB6_OD_CAN2_ErrorStatus "Internal error status (e.g. Error active, Error passive, Bus Off)";
CM_ SG_ 1457 MDB6_OD_CAN2_DiscardedTxMessages "Number of discarded TX messages on CAN2 because all messageboxes were full";
CM_ SG_ 1457 MDB6_OD_CAN2_Status "Status of CAN2.";
CM_ SG_ 1457 MDB6_OD_CAN2_Baudrate "Baudrate of CAN.";
CM_ SG_ 1457 MDB6_OD_CAN2_autoErrorReset "Automatic reset of errors.";
CM_ SG_ 1457 MDB6_OD_CAN2_lastErrorCode "Last error code.";
CM_ SG_ 1457 MDB6_OD_CAN2_RxErrCnt "Receive error count of CAN1.";
CM_ SG_ 1457 MDB6_OD_CAN2_TxErrCnt "Transmit error count of CAN1.";
CM_ SG_ 1457 MDB6_OD_CAN1_DelayedTxMessages "Number of delayed TX messages on CAN1 because no messagebox was free.";
CM_ SG_ 1457 MDB6_OD_CAN1_ErrorStatus "Internal error status (e.g. Error active, Error passive, Bus Off)";
CM_ SG_ 1457 MDB6_OD_CAN1_DiscardedTxMessages "Number of discarded TX messages on CAN1 because all messageboxes were full";
CM_ SG_ 1457 MDB6_OD_CAN1_Status "Status of CAN1.";
CM_ SG_ 1457 MDB6_OD_CAN1_Baudrate "Baudrate of CAN.";
CM_ SG_ 1457 MDB6_OD_CAN1_autoErrorReset "Automatic reset of errors.";
CM_ SG_ 1457 MDB6_OD_CAN1_lastErrorCode "Last error code.";
CM_ SG_ 1457 MDB6_OD_CAN1_RxErrCnt "Receive error count of CAN1.";
CM_ SG_ 1457 MDB6_OD_CAN1_TxErrCnt "Transmit error count of CAN1.";
CM_ SG_ 1457 MDB6_OD_BuildTime "Software build time in the format HHMMSS.";
CM_ SG_ 1457 MDB6_OD_BuildDate "Software build date in the format YYYYMMDD.";
CM_ SG_ 1457 MDB6_OD_ChipUID2 "Seccond part of unique ID of microcontroller.";
CM_ SG_ 1457 MDB6_OD_ChipUID1 "First part of unique ID of microcontroller.";
CM_ SG_ 1457 MDB6_OD_SdcOut "Measurement of Shutdown Circuit Output";
CM_ SG_ 1457 MDB6_OD_SdcIn "Measurement of Shutdown Circuit Input";
CM_ SG_ 1457 MDB6_OD_runtime "Runtime of chip in milliseconds.";
CM_ SG_ 1457 MDB6_OD_InputVoltage "Board supply voltage.";
CM_ SG_ 1457 MDB6_OD_BoardTemp "Temperature of board";
CM_ SG_ 1457 MDB6_OD_MemFree "Free memory in bytes.";
CM_ SG_ 1457 MDB6_OD_CpuUsage "Current CPU usage in %.";
CM_ SG_ 1457 MDB6_OD_OdEntrySendInterval "Interval for sending all readable OD entries. Sending is disabled if less than 5 ms.";
CM_ SG_ 1457 MDB6_OD_SendOdOnBootup "Whether to send all OD entries on bootup.";
CM_ SG_ 1457 MDB6_OD_HeartbeatInterval "Heartbeat Interval in milliseconds.";
CM_ SG_ 1457 MDB6_OD_DbcVersion "CANzero DBC version.";
CM_ SG_ 1457 MDB6_OD_StackVersion "CANzero stack version.";
CM_ SG_ 1457 MDB6_OD_ProtocolVersion "CANzero Protocol Version.";
CM_ SG_ 1457 MDB6_OD_NodeStatus "State of the node.";
CM_ SG_ 1457 MDB6_OD_NodeID "CANzero Node-ID.";
CM_ SG_ 1457 MDB6_SDO_RespCode "Response code of SDO access.";
CM_ SG_ 1457 MDB6_SDO_ID "Specifies SDO-ID of MDB6";
CM_ BO_ 1521 "DO NOT CHANGE ANYTHING HERE!
SDO Request Upload to node MDB6 with Node-ID 0x31";
CM_ SG_ 1521 MDB6_OD_CAN2_DelayedTxMessages "Number of delayed TX messages on CAN2 because no messagebox was free.";
CM_ SG_ 1521 MDB6_OD_CAN2_ErrorStatus "Internal error status (e.g. Error active, Error passive, Bus Off)";
CM_ SG_ 1521 MDB6_OD_CAN2_DiscardedTxMessages "Number of discarded TX messages on CAN2 because all messageboxes were full";
CM_ SG_ 1521 MDB6_OD_CAN2_Status "Status of CAN2.";
CM_ SG_ 1521 MDB6_OD_CAN2_Baudrate "Baudrate of CAN.";
CM_ SG_ 1521 MDB6_OD_CAN2_autoErrorReset "Automatic reset of errors.";
CM_ SG_ 1521 MDB6_OD_CAN2_lastErrorCode "Last error code.";
CM_ SG_ 1521 MDB6_OD_CAN2_RxErrCnt "Receive error count of CAN1.";
CM_ SG_ 1521 MDB6_OD_CAN2_TxErrCnt "Transmit error count of CAN1.";
CM_ SG_ 1521 MDB6_OD_CAN1_DelayedTxMessages "Number of delayed TX messages on CAN1 because no messagebox was free.";
CM_ SG_ 1521 MDB6_OD_CAN1_ErrorStatus "Internal error status (e.g. Error active, Error passive, Bus Off)";
CM_ SG_ 1521 MDB6_OD_CAN1_DiscardedTxMessages "Number of discarded TX messages on CAN1 because all messageboxes were full";
CM_ SG_ 1521 MDB6_OD_CAN1_Status "Status of CAN1.";
CM_ SG_ 1521 MDB6_OD_CAN1_Baudrate "Baudrate of CAN.";
CM_ SG_ 1521 MDB6_OD_CAN1_autoErrorReset "Automatic reset of errors.";
CM_ SG_ 1521 MDB6_OD_CAN1_lastErrorCode "Last error code.";
CM_ SG_ 1521 MDB6_OD_CAN1_RxErrCnt "Receive error count of CAN1.";
CM_ SG_ 1521 MDB6_OD_CAN1_TxErrCnt "Transmit error count of CAN1.";
CM_ SG_ 1521 MDB6_OD_BuildTime "Software build time in the format HHMMSS.";
CM_ SG_ 1521 MDB6_OD_BuildDate "Software build date in the format YYYYMMDD.";
CM_ SG_ 1521 MDB6_OD_ChipUID2 "Seccond part of unique ID of microcontroller.";
CM_ SG_ 1521 MDB6_OD_ChipUID1 "First part of unique ID of microcontroller.";
CM_ SG_ 1521 MDB6_OD_SdcOut "Measurement of Shutdown Circuit Output";
CM_ SG_ 1521 MDB6_OD_SdcIn "Measurement of Shutdown Circuit Input";
CM_ SG_ 1521 MDB6_OD_runtime "Runtime of chip in milliseconds.";
CM_ SG_ 1521 MDB6_OD_InputVoltage "Board supply voltage.";
CM_ SG_ 1521 MDB6_OD_BoardTemp "Temperature of board";
CM_ SG_ 1521 MDB6_OD_MemFree "Free memory in bytes.";
CM_ SG_ 1521 MDB6_OD_CpuUsage "Current CPU usage in %.";
CM_ SG_ 1521 MDB6_OD_OdEntrySendInterval "Interval for sending all readable OD entries. Sending is disabled if less than 5 ms.";
CM_ SG_ 1521 MDB6_OD_SendOdOnBootup "Whether to send all OD entries on bootup.";
CM_ SG_ 1521 MDB6_OD_HeartbeatInterval "Heartbeat Interval in milliseconds.";
CM_ SG_ 1521 MDB6_OD_DbcVersion "CANzero DBC version.";
CM_ SG_ 1521 MDB6_OD_StackVersion "CANzero stack version.";
CM_ SG_ 1521 MDB6_OD_ProtocolVersion "CANzero Protocol Version.";
CM_ SG_ 1521 MDB6_OD_NodeStatus "State of the node.";
CM_ SG_ 1521 MDB6_OD_NodeID "CANzero Node-ID.";
CM_ SG_ 1521 MDB6_SDO_ID "Specifies SDO-ID of MDB6";
CM_ BO_ 1585 "DO NOT CHANGE ANYTHING HERE!
SDO Request Download from node MDB6 with Node-ID 0x31";
CM_ SG_ 1585 MDB6_SDO_ID "Specifies SDO-ID of MDB6";
CM_ BO_ 1841 "Heartbeat of node MDB6 with Node-ID 0x31";
CM_ SG_ 1841 MDB6_NodeState "Heartbeat status of node MDB6";
CM_ BO_ 1905 "Bootloader transmit from node MDB6 with Node-ID 0x31";
CM_ BO_ 1969 "Bootloader receive by node MDB6 with Node-ID 0x31";
CM_ BO_ 178 "Emergency message of node Track with Node-ID 0x32";
CM_ SG_ 178 Track_E0_OtherError "Other error.";
CM_ SG_ 178 Track_W0_OtherWarning "Other warning.";
CM_ BO_ 434 "Transmit PDO 1 of node Track with Node-ID 0x32";
CM_ BO_ 498 "Receive PDO 1 of node Track with Node-ID 0x32";
CM_ BO_ 562 "Transmit PDO 2 of node Track with Node-ID 0x32";
CM_ BO_ 626 "Receive PDO 2 of node Track with Node-ID 0x32";
CM_ BO_ 690 "Transmit PDO 3 of node Track with Node-ID 0x32";
CM_ BO_ 754 "Receive PDO 3 of node Track with Node-ID 0x32";
CM_ BO_ 818 "Transmit PDO 4 of node Track with Node-ID 0x32";
CM_ BO_ 882 "Receive PDO 4 of node Track with Node-ID 0x32";
CM_ BO_ 946 "Transmit PDO 5 of node Track with Node-ID 0x32";
CM_ BO_ 1010 "Transmit PDO 6 of node Track with Node-ID 0x32";
CM_ BO_ 1074 "Transmit PDO 7 of node Track with Node-ID 0x32";
CM_ BO_ 1138 "Transmit PDO 8 of node Track with Node-ID 0x32";
CM_ BO_ 1202 "Transmit PDO 9 of node Track with Node-ID 0x32";
CM_ BO_ 1266 "Transmit PDO 10 of node Track with Node-ID 0x32";
CM_ BO_ 1330 "Transmit PDO 11 of node Track with Node-ID 0x32";
CM_ BO_ 1394 "Transmit PDO 12 of node Track with Node-ID 0x32";
CM_ BO_ 1458 "DO NOT CHANGE ANYTHING HERE!
SDO Response of node Track with Node-ID 0x32";
CM_ SG_ 1458 Track_OD_PropulsionDistance "Propulsion Distance";
CM_ SG_ 1458 Track_OD_PropulsionPressure "Propulsion Pressure";
CM_ SG_ 1458 Track_OD_PistonStatus "Propulsion Piston Status.";
CM_ SG_ 1458 Track_OD_CAN2_DelayedTxMessages "Number of delayed TX messages on CAN2 because no messagebox was free.";
CM_ SG_ 1458 Track_OD_CAN2_ErrorStatus "Internal error status (e.g. Error active, Error passive, Bus Off)";
CM_ SG_ 1458 Track_OD_CAN2_DiscardedTxMessage "Number of discarded TX messages on CAN2 because all messageboxes were full";
CM_ SG_ 1458 Track_OD_CAN2_Status "Status of CAN2.";
CM_ SG_ 1458 Track_OD_CAN2_Baudrate "Baudrate of CAN.";
CM_ SG_ 1458 Track_OD_CAN2_autoErrorReset "Automatic reset of errors.";
CM_ SG_ 1458 Track_OD_CAN2_lastErrorCode "Last error code.";
CM_ SG_ 1458 Track_OD_CAN2_RxErrCnt "Receive error count of CAN1.";
CM_ SG_ 1458 Track_OD_CAN2_TxErrCnt "Transmit error count of CAN1.";
CM_ SG_ 1458 Track_OD_CAN1_DelayedTxMessages "Number of delayed TX messages on CAN1 because no messagebox was free.";
CM_ SG_ 1458 Track_OD_CAN1_ErrorStatus "Internal error status (e.g. Error active, Error passive, Bus Off)";
CM_ SG_ 1458 Track_OD_CAN1_DiscardedTxMessage "Number of discarded TX messages on CAN1 because all messageboxes were full";
CM_ SG_ 1458 Track_OD_CAN1_Status "Status of CAN1.";
CM_ SG_ 1458 Track_OD_CAN1_Baudrate "Baudrate of CAN.";
CM_ SG_ 1458 Track_OD_CAN1_autoErrorReset "Automatic reset of errors.";
CM_ SG_ 1458 Track_OD_CAN1_lastErrorCode "Last error code.";
CM_ SG_ 1458 Track_OD_CAN1_RxErrCnt "Receive error count of CAN1.";
CM_ SG_ 1458 Track_OD_CAN1_TxErrCnt "Transmit error count of CAN1.";
CM_ SG_ 1458 Track_OD_BuildTime "Software build time in the format HHMMSS.";
CM_ SG_ 1458 Track_OD_BuildDate "Software build date in the format YYYYMMDD.";
CM_ SG_ 1458 Track_OD_ChipUID2 "Seccond part of unique ID of microcontroller.";
CM_ SG_ 1458 Track_OD_ChipUID1 "First part of unique ID of microcontroller.";
CM_ SG_ 1458 Track_OD_SdcOut "Measurement of Shutdown Circuit Output";
CM_ SG_ 1458 Track_OD_SdcIn "Measurement of Shutdown Circuit Input";
CM_ SG_ 1458 Track_OD_runtime "Runtime of chip in milliseconds.";
CM_ SG_ 1458 Track_OD_InputVoltage "Board supply voltage.";
CM_ SG_ 1458 Track_OD_BoardTemp "Temperature of board";
CM_ SG_ 1458 Track_OD_MemFree "Free memory in bytes.";
CM_ SG_ 1458 Track_OD_CpuUsage "Current CPU usage in %.";
CM_ SG_ 1458 Track_OD_OdEntrySendInterval "Interval for sending all readable OD entries. Sending is disabled if less than 5 ms.";
CM_ SG_ 1458 Track_OD_SendOdOnBootup "Whether to send all OD entries on bootup.";
CM_ SG_ 1458 Track_OD_HeartbeatInterval "Heartbeat Interval in milliseconds.";
CM_ SG_ 1458 Track_OD_DbcVersion "CANzero DBC version.";
CM_ SG_ 1458 Track_OD_StackVersion "CANzero stack version.";
CM_ SG_ 1458 Track_OD_ProtocolVersion "CANzero Protocol Version.";
CM_ SG_ 1458 Track_OD_NodeStatus "State of the node.";
CM_ SG_ 1458 Track_OD_NodeID "CANzero Node-ID.";
CM_ SG_ 1458 Track_SDO_RespCode "Response code of SDO access.";
CM_ SG_ 1458 Track_SDO_ID "Specifies SDO-ID of Track";
CM_ BO_ 1522 "DO NOT CHANGE ANYTHING HERE!
SDO Request Upload to node Track with Node-ID 0x32";
CM_ SG_ 1522 Track_OD_PropulsionDistance "Propulsion Distance";
CM_ SG_ 1522 Track_OD_PropulsionPressure "Propulsion Pressure";
CM_ SG_ 1522 Track_OD_PistonStatus "Propulsion Piston Status.";
CM_ SG_ 1522 Track_OD_CAN2_DelayedTxMessages "Number of delayed TX messages on CAN2 because no messagebox was free.";
CM_ SG_ 1522 Track_OD_CAN2_ErrorStatus "Internal error status (e.g. Error active, Error passive, Bus Off)";
CM_ SG_ 1522 Track_OD_CAN2_DiscardedTxMe_0000 "Number of discarded TX messages on CAN2 because all messageboxes were full";
CM_ SG_ 1522 Track_OD_CAN2_Status "Status of CAN2.";
CM_ SG_ 1522 Track_OD_CAN2_Baudrate "Baudrate of CAN.";
CM_ SG_ 1522 Track_OD_CAN2_autoErrorReset "Automatic reset of errors.";
CM_ SG_ 1522 Track_OD_CAN2_lastErrorCode "Last error code.";
CM_ SG_ 1522 Track_OD_CAN2_RxErrCnt "Receive error count of CAN1.";
CM_ SG_ 1522 Track_OD_CAN2_TxErrCnt "Transmit error count of CAN1.";
CM_ SG_ 1522 Track_OD_CAN1_DelayedTxMessages "Number of delayed TX messages on CAN1 because no messagebox was free.";
CM_ SG_ 1522 Track_OD_CAN1_ErrorStatus "Internal error status (e.g. Error active, Error passive, Bus Off)";
CM_ SG_ 1522 Track_OD_CAN1_DiscardedTxMe_0000 "Number of discarded TX messages on CAN1 because all messageboxes were full";
CM_ SG_ 1522 Track_OD_CAN1_Status "Status of CAN1.";
CM_ SG_ 1522 Track_OD_CAN1_Baudrate "Baudrate of CAN.";
CM_ SG_ 1522 Track_OD_CAN1_autoErrorReset "Automatic reset of errors.";
CM_ SG_ 1522 Track_OD_CAN1_lastErrorCode "Last error code.";
CM_ SG_ 1522 Track_OD_CAN1_RxErrCnt "Receive error count of CAN1.";
CM_ SG_ 1522 Track_OD_CAN1_TxErrCnt "Transmit error count of CAN1.";
CM_ SG_ 1522 Track_OD_BuildTime "Software build time in the format HHMMSS.";
CM_ SG_ 1522 Track_OD_BuildDate "Software build date in the format YYYYMMDD.";
CM_ SG_ 1522 Track_OD_ChipUID2 "Seccond part of unique ID of microcontroller.";
CM_ SG_ 1522 Track_OD_ChipUID1 "First part of unique ID of microcontroller.";
CM_ SG_ 1522 Track_OD_SdcOut "Measurement of Shutdown Circuit Output";
CM_ SG_ 1522 Track_OD_SdcIn "Measurement of Shutdown Circuit Input";
CM_ SG_ 1522 Track_OD_runtime "Runtime of chip in milliseconds.";
CM_ SG_ 1522 Track_OD_InputVoltage "Board supply voltage.";
CM_ SG_ 1522 Track_OD_BoardTemp "Temperature of board";
CM_ SG_ 1522 Track_OD_MemFree "Free memory in bytes.";
CM_ SG_ 1522 Track_OD_CpuUsage "Current CPU usage in %.";
CM_ SG_ 1522 Track_OD_OdEntrySendInterval "Interval for sending all readable OD entries. Sending is disabled if less than 5 ms.";
CM_ SG_ 1522 Track_OD_SendOdOnBootup "Whether to send all OD entries on bootup.";
CM_ SG_ 1522 Track_OD_HeartbeatInterval "Heartbeat Interval in milliseconds.";
CM_ SG_ 1522 Track_OD_DbcVersion "CANzero DBC version.";
CM_ SG_ 1522 Track_OD_StackVersion "CANzero stack version.";
CM_ SG_ 1522 Track_OD_ProtocolVersion "CANzero Protocol Version.";
CM_ SG_ 1522 Track_OD_NodeStatus "State of the node.";
CM_ SG_ 1522 Track_OD_NodeID "CANzero Node-ID.";
CM_ SG_ 1522 Track_SDO_ID "Specifies SDO-ID of Track";
CM_ BO_ 1586 "DO NOT CHANGE ANYTHING HERE!
SDO Request Download from node Track with Node-ID 0x32";
CM_ SG_ 1586 Track_SDO_ID "Specifies SDO-ID of Track";
CM_ BO_ 1842 "Heartbeat of node Track with Node-ID 0x32";
CM_ SG_ 1842 Track_NodeState "Heartbeat status of node Track";
CM_ BO_ 1906 "Bootloader transmit from node Track with Node-ID 0x32";
CM_ BO_ 1970 "Bootloader receive by node Track with Node-ID 0x32";
CM_ BO_ 148 "Emergency message of node CLU with Node-ID 0x14";
CM_ SG_ 148 CLU_E0_OtherError "Other error.";
CM_ SG_ 148 CLU_W0_OtherWarning "Other warning.";
CM_ BO_ 404 "Transmit PDO 1 of node CLU with Node-ID 0x14";
CM_ BO_ 468 "Receive PDO 1 of node CLU with Node-ID 0x14";
CM_ BO_ 532 "Transmit PDO 2 of node CLU with Node-ID 0x14";
CM_ BO_ 596 "Receive PDO 2 of node CLU with Node-ID 0x14";
CM_ BO_ 660 "Transmit PDO 3 of node CLU with Node-ID 0x14";
CM_ BO_ 724 "Receive PDO 3 of node CLU with Node-ID 0x14";
CM_ BO_ 788 "Transmit PDO 4 of node CLU with Node-ID 0x14";
CM_ BO_ 852 "Receive PDO 4 of node CLU with Node-ID 0x14";
CM_ BO_ 916 "Transmit PDO 5 of node CLU with Node-ID 0x14";
CM_ BO_ 980 "Transmit PDO 6 of node CLU with Node-ID 0x14";
CM_ BO_ 1044 "Transmit PDO 7 of node CLU with Node-ID 0x14";
CM_ BO_ 1108 "Transmit PDO 8 of node CLU with Node-ID 0x14";
CM_ BO_ 1172 "Transmit PDO 9 of node CLU with Node-ID 0x14";
CM_ BO_ 1236 "Transmit PDO 10 of node CLU with Node-ID 0x14";
CM_ BO_ 1300 "Transmit PDO 11 of node CLU with Node-ID 0x14";
CM_ BO_ 1364 "Transmit PDO 12 of node CLU with Node-ID 0x14";
CM_ BO_ 1428 "DO NOT CHANGE ANYTHING HERE!
SDO Response of node CLU with Node-ID 0x14";
CM_ SG_ 1428 CLU_OD_CAN2_DelayedTxMessages "Number of delayed TX messages on CAN2 because no messagebox was free.";
CM_ SG_ 1428 CLU_OD_CAN2_ErrorStatus "Internal error status (e.g. Error active, Error passive, Bus Off)";
CM_ SG_ 1428 CLU_OD_CAN2_DiscardedTxMessages "Number of discarded TX messages on CAN2 because all messageboxes were full";
CM_ SG_ 1428 CLU_OD_CAN2_Status "Status of CAN2.";
CM_ SG_ 1428 CLU_OD_CAN2_Baudrate "Baudrate of CAN.";
CM_ SG_ 1428 CLU_OD_CAN2_autoErrorReset "Automatic reset of errors.";
CM_ SG_ 1428 CLU_OD_CAN2_lastErrorCode "Last error code.";
CM_ SG_ 1428 CLU_OD_CAN2_RxErrCnt "Receive error count of CAN1.";
CM_ SG_ 1428 CLU_OD_CAN2_TxErrCnt "Transmit error count of CAN1.";
CM_ SG_ 1428 CLU_OD_CAN1_DelayedTxMessages "Number of delayed TX messages on CAN1 because no messagebox was free.";
CM_ SG_ 1428 CLU_OD_CAN1_ErrorStatus "Internal error status (e.g. Error active, Error passive, Bus Off)";
CM_ SG_ 1428 CLU_OD_CAN1_DiscardedTxMessages "Number of discarded TX messages on CAN1 because all messageboxes were full";
CM_ SG_ 1428 CLU_OD_CAN1_Status "Status of CAN1.";
CM_ SG_ 1428 CLU_OD_CAN1_Baudrate "Baudrate of CAN.";
CM_ SG_ 1428 CLU_OD_CAN1_autoErrorReset "Automatic reset of errors.";
CM_ SG_ 1428 CLU_OD_CAN1_lastErrorCode "Last error code.";
CM_ SG_ 1428 CLU_OD_CAN1_RxErrCnt "Receive error count of CAN1.";
CM_ SG_ 1428 CLU_OD_CAN1_TxErrCnt "Transmit error count of CAN1.";
CM_ SG_ 1428 CLU_OD_BuildTime "Software build time in the format HHMMSS.";
CM_ SG_ 1428 CLU_OD_BuildDate "Software build date in the format YYYYMMDD.";
CM_ SG_ 1428 CLU_OD_ChipUID2 "Seccond part of unique ID of microcontroller.";
CM_ SG_ 1428 CLU_OD_ChipUID1 "First part of unique ID of microcontroller.";
CM_ SG_ 1428 CLU_OD_SdcOut "Measurement of Shutdown Circuit Output";
CM_ SG_ 1428 CLU_OD_SdcIn "Measurement of Shutdown Circuit Input";
CM_ SG_ 1428 CLU_OD_runtime "Runtime of chip in milliseconds.";
CM_ SG_ 1428 CLU_OD_InputVoltage "Board supply voltage.";
CM_ SG_ 1428 CLU_OD_BoardTemp "Temperature of board";
CM_ SG_ 1428 CLU_OD_MemFree "Free memory in bytes.";
CM_ SG_ 1428 CLU_OD_CpuUsage "Current CPU usage in %.";
CM_ SG_ 1428 CLU_OD_OdEntrySendInterval "Interval for sending all readable OD entries. Sending is disabled if less than 5 ms.";
CM_ SG_ 1428 CLU_OD_SendOdOnBootup "Whether to send all OD entries on bootup.";
CM_ SG_ 1428 CLU_OD_HeartbeatInterval "Heartbeat Interval in milliseconds.";
CM_ SG_ 1428 CLU_OD_DbcVersion "CANzero DBC version.";
CM_ SG_ 1428 CLU_OD_StackVersion "CANzero stack version.";
CM_ SG_ 1428 CLU_OD_ProtocolVersion "CANzero Protocol Version.";
CM_ SG_ 1428 CLU_OD_NodeStatus "State of the node.";
CM_ SG_ 1428 CLU_OD_NodeID "CANzero Node-ID.";
CM_ SG_ 1428 CLU_SDO_RespCode "Response code of SDO access.";
CM_ SG_ 1428 CLU_SDO_ID "Specifies SDO-ID of CLU";
CM_ BO_ 1492 "DO NOT CHANGE ANYTHING HERE!
SDO Request Upload to node CLU with Node-ID 0x14";
CM_ SG_ 1492 CLU_OD_CAN2_DelayedTxMessages "Number of delayed TX messages on CAN2 because no messagebox was free.";
CM_ SG_ 1492 CLU_OD_CAN2_ErrorStatus "Internal error status (e.g. Error active, Error passive, Bus Off)";
CM_ SG_ 1492 CLU_OD_CAN2_DiscardedTxMessages "Number of discarded TX messages on CAN2 because all messageboxes were full";
CM_ SG_ 1492 CLU_OD_CAN2_Status "Status of CAN2.";
CM_ SG_ 1492 CLU_OD_CAN2_Baudrate "Baudrate of CAN.";
CM_ SG_ 1492 CLU_OD_CAN2_autoErrorReset "Automatic reset of errors.";
CM_ SG_ 1492 CLU_OD_CAN2_lastErrorCode "Last error code.";
CM_ SG_ 1492 CLU_OD_CAN2_RxErrCnt "Receive error count of CAN1.";
CM_ SG_ 1492 CLU_OD_CAN2_TxErrCnt "Transmit error count of CAN1.";
CM_ SG_ 1492 CLU_OD_CAN1_DelayedTxMessages "Number of delayed TX messages on CAN1 because no messagebox was free.";
CM_ SG_ 1492 CLU_OD_CAN1_ErrorStatus "Internal error status (e.g. Error active, Error passive, Bus Off)";
CM_ SG_ 1492 CLU_OD_CAN1_DiscardedTxMessages "Number of discarded TX messages on CAN1 because all messageboxes were full";
CM_ SG_ 1492 CLU_OD_CAN1_Status "Status of CAN1.";
CM_ SG_ 1492 CLU_OD_CAN1_Baudrate "Baudrate of CAN.";
CM_ SG_ 1492 CLU_OD_CAN1_autoErrorReset "Automatic reset of errors.";
CM_ SG_ 1492 CLU_OD_CAN1_lastErrorCode "Last error code.";
CM_ SG_ 1492 CLU_OD_CAN1_RxErrCnt "Receive error count of CAN1.";
CM_ SG_ 1492 CLU_OD_CAN1_TxErrCnt "Transmit error count of CAN1.";
CM_ SG_ 1492 CLU_OD_BuildTime "Software build time in the format HHMMSS.";
CM_ SG_ 1492 CLU_OD_BuildDate "Software build date in the format YYYYMMDD.";
CM_ SG_ 1492 CLU_OD_ChipUID2 "Seccond part of unique ID of microcontroller.";
CM_ SG_ 1492 CLU_OD_ChipUID1 "First part of unique ID of microcontroller.";
CM_ SG_ 1492 CLU_OD_SdcOut "Measurement of Shutdown Circuit Output";
CM_ SG_ 1492 CLU_OD_SdcIn "Measurement of Shutdown Circuit Input";
CM_ SG_ 1492 CLU_OD_runtime "Runtime of chip in milliseconds.";
CM_ SG_ 1492 CLU_OD_InputVoltage "Board supply voltage.";
CM_ SG_ 1492 CLU_OD_BoardTemp "Temperature of board";
CM_ SG_ 1492 CLU_OD_MemFree "Free memory in bytes.";
CM_ SG_ 1492 CLU_OD_CpuUsage "Current CPU usage in %.";
CM_ SG_ 1492 CLU_OD_OdEntrySendInterval "Interval for sending all readable OD entries. Sending is disabled if less than 5 ms.";
CM_ SG_ 1492 CLU_OD_SendOdOnBootup "Whether to send all OD entries on bootup.";
CM_ SG_ 1492 CLU_OD_HeartbeatInterval "Heartbeat Interval in milliseconds.";
CM_ SG_ 1492 CLU_OD_DbcVersion "CANzero DBC version.";
CM_ SG_ 1492 CLU_OD_StackVersion "CANzero stack version.";
CM_ SG_ 1492 CLU_OD_ProtocolVersion "CANzero Protocol Version.";
CM_ SG_ 1492 CLU_OD_NodeStatus "State of the node.";
CM_ SG_ 1492 CLU_OD_NodeID "CANzero Node-ID.";
CM_ SG_ 1492 CLU_SDO_ID "Specifies SDO-ID of CLU";
CM_ BO_ 1556 "DO NOT CHANGE ANYTHING HERE!
SDO Request Download from node CLU with Node-ID 0x14";
CM_ SG_ 1556 CLU_SDO_ID "Specifies SDO-ID of CLU";
CM_ BO_ 1812 "Heartbeat of node CLU with Node-ID 0x14";
CM_ SG_ 1812 CLU_NodeState "Heartbeat status of node CLU";
CM_ BO_ 1876 "Bootloader transmit from node CLU with Node-ID 0x14";
CM_ BO_ 1940 "Bootloader receive by node CLU with Node-ID 0x14";
BA_DEF_ SG_  "GenSigSendType" ENUM  "Cyclic","OnWrite","OnWriteWithRepetition","OnChange","OnChangeWithRepetition","IfActive","IfActiveWithRepetition","NoSigSendType";
BA_DEF_ BO_  "GenMsgSendType" ENUM  "Cyclic","not_used","not_used","not_used","not_used","Cyclic","not_used","IfActive","NoMsgSendType";
BA_DEF_ BO_  "GenMsgCycleTime" INT 2 50000;
BA_DEF_ BO_  "GenMsgDelayTime" INT 1 1000;
BA_DEF_ BO_  "GenMsgNrOfRepetitions" INT 1 999999;
BA_DEF_ SG_  "GenSigStartValue" FLOAT 0 100000000000;
BA_DEF_ SG_  "CANzero_SDO_Group" STRING ;
BA_DEF_ SG_  "CANzero_SDO_AccessIfOperational" ENUM  "No","Yes";
BA_DEF_ SG_  "CANzero_SDO_AccessType" ENUM  "Read Write","Read Only","Write Only";
BA_DEF_ SG_  "CANzero_SDO_Default" FLOAT 0 0;
BA_DEF_ SG_  "SystemSignalLongSymbol" STRING ;
BA_DEF_DEF_  "GenSigSendType" "Cyclic";
BA_DEF_DEF_  "GenMsgSendType" "NoMsgSendType";
BA_DEF_DEF_  "GenMsgCycleTime" 100;
BA_DEF_DEF_  "GenMsgDelayTime" 1;
BA_DEF_DEF_  "GenMsgNrOfRepetitions" 1;
BA_DEF_DEF_  "GenSigStartValue" 0;
BA_DEF_DEF_  "CANzero_SDO_Group" "";
BA_DEF_DEF_  "CANzero_SDO_AccessIfOperational" "No";
BA_DEF_DEF_  "CANzero_SDO_AccessType" "Read Write";
BA_DEF_DEF_  "CANzero_SDO_Default" 0;
BA_DEF_DEF_  "SystemSignalLongSymbol" "";
BA_ "CANzero_SDO_Group" SG_ 1447 MDB3_OD_CAN2_DelayedTxMessages "CAN";
BA_ "CANzero_SDO_AccessType" SG_ 1447 MDB3_OD_CAN2_DelayedTxMessages 1;
BA_ "CANzero_SDO_AccessIfOperational" SG_ 1447 MDB3_OD_CAN2_DelayedTxMessages 1;
BA_ "CANzero_SDO_Group" SG_ 1447 MDB3_OD_CAN2_ErrorStatus "CAN";
BA_ "CANzero_SDO_AccessType" SG_ 1447 MDB3_OD_CAN2_ErrorStatus 1;
BA_ "CANzero_SDO_AccessIfOperational" SG_ 1447 MDB3_OD_CAN2_ErrorStatus 1;
BA_ "CANzero_SDO_Group" SG_ 1447 MDB3_OD_CAN2_DiscardedTxMessages "CAN";
BA_ "CANzero_SDO_AccessType" SG_ 1447 MDB3_OD_CAN2_DiscardedTxMessages 1;
BA_ "CANzero_SDO_AccessIfOperational" SG_ 1447 MDB3_OD_CAN2_DiscardedTxMessages 1;
BA_ "CANzero_SDO_Group" SG_ 1447 MDB3_OD_CAN2_Status "CAN";
BA_ "CANzero_SDO_AccessType" SG_ 1447 MDB3_OD_CAN2_Status 1;
BA_ "CANzero_SDO_AccessIfOperational" SG_ 1447 MDB3_OD_CAN2_Status 1;
BA_ "CANzero_SDO_Group" SG_ 1447 MDB3_OD_CAN2_Baudrate "CAN";
BA_ "CANzero_SDO_AccessIfOperational" SG_ 1447 MDB3_OD_CAN2_Baudrate 1;
BA_ "GenSigStartValue" SG_ 1447 MDB3_OD_CAN2_Baudrate 1000.0;
BA_ "CANzero_SDO_Default" SG_ 1447 MDB3_OD_CAN2_Baudrate 1000;
BA_ "CANzero_SDO_Group" SG_ 1447 MDB3_OD_CAN2_autoErrorReset "CAN";
BA_ "CANzero_SDO_AccessIfOperational" SG_ 1447 MDB3_OD_CAN2_autoErrorReset 1;
BA_ "GenSigStartValue" SG_ 1447 MDB3_OD_CAN2_autoErrorReset 1.0;
BA_ "CANzero_SDO_Default" SG_ 1447 MDB3_OD_CAN2_autoErrorReset 1;
BA_ "CANzero_SDO_Group" SG_ 1447 MDB3_OD_CAN2_lastErrorCode "CAN";
BA_ "CANzero_SDO_AccessType" SG_ 1447 MDB3_OD_CAN2_lastErrorCode 1;
BA_ "CANzero_SDO_AccessIfOperational" SG_ 1447 MDB3_OD_CAN2_lastErrorCode 1;
BA_ "CANzero_SDO_Group" SG_ 1447 MDB3_OD_CAN2_RxErrCnt "CAN";
BA_ "CANzero_SDO_AccessType" SG_ 1447 MDB3_OD_CAN2_RxErrCnt 1;
BA_ "CANzero_SDO_AccessIfOperational" SG_ 1447 MDB3_OD_CAN2_RxErrCnt 1;
BA_ "CANzero_SDO_Group" SG_ 1447 MDB3_OD_CAN2_TxErrCnt "CAN";
BA_ "CANzero_SDO_AccessType" SG_ 1447 MDB3_OD_CAN2_TxErrCnt 1;
BA_ "CANzero_SDO_AccessIfOperational" SG_ 1447 MDB3_OD_CAN2_TxErrCnt 1;
BA_ "CANzero_SDO_Group" SG_ 1447 MDB3_OD_CAN1_DelayedTxMessages "CAN";
BA_ "CANzero_SDO_AccessType" SG_ 1447 MDB3_OD_CAN1_DelayedTxMessages 1;
BA_ "CANzero_SDO_AccessIfOperational" SG_ 1447 MDB3_OD_CAN1_DelayedTxMessages 1;
BA_ "CANzero_SDO_Group" SG_ 1447 MDB3_OD_CAN1_ErrorStatus "CAN";
BA_ "CANzero_SDO_AccessType" SG_ 1447 MDB3_OD_CAN1_ErrorStatus 1;
BA_ "CANzero_SDO_AccessIfOperational" SG_ 1447 MDB3_OD_CAN1_ErrorStatus 1;
BA_ "CANzero_SDO_Group" SG_ 1447 MDB3_OD_CAN1_DiscardedTxMessages "CAN";
BA_ "CANzero_SDO_AccessType" SG_ 1447 MDB3_OD_CAN1_DiscardedTxMessages 1;
BA_ "CANzero_SDO_AccessIfOperational" SG_ 1447 MDB3_OD_CAN1_DiscardedTxMessages 1;
BA_ "CANzero_SDO_Group" SG_ 1447 MDB3_OD_CAN1_Status "CAN";
BA_ "CANzero_SDO_AccessType" SG_ 1447 MDB3_OD_CAN1_Status 1;
BA_ "CANzero_SDO_AccessIfOperational" SG_ 1447 MDB3_OD_CAN1_Status 1;
BA_ "CANzero_SDO_Group" SG_ 1447 MDB3_OD_CAN1_Baudrate "CAN";
BA_ "CANzero_SDO_AccessIfOperational" SG_ 1447 MDB3_OD_CAN1_Baudrate 1;
BA_ "GenSigStartValue" SG_ 1447 MDB3_OD_CAN1_Baudrate 1000.0;
BA_ "CANzero_SDO_Default" SG_ 1447 MDB3_OD_CAN1_Baudrate 1000;
BA_ "CANzero_SDO_Group" SG_ 1447 MDB3_OD_CAN1_autoErrorReset "CAN";
BA_ "CANzero_SDO_AccessIfOperational" SG_ 1447 MDB3_OD_CAN1_autoErrorReset 1;
BA_ "GenSigStartValue" SG_ 1447 MDB3_OD_CAN1_autoErrorReset 1.0;
BA_ "CANzero_SDO_Default" SG_ 1447 MDB3_OD_CAN1_autoErrorReset 1;
BA_ "CANzero_SDO_Group" SG_ 1447 MDB3_OD_CAN1_lastErrorCode "CAN";
BA_ "CANzero_SDO_AccessType" SG_ 1447 MDB3_OD_CAN1_lastErrorCode 1;
BA_ "CANzero_SDO_AccessIfOperational" SG_ 1447 MDB3_OD_CAN1_lastErrorCode 1;
BA_ "CANzero_SDO_Group" SG_ 1447 MDB3_OD_CAN1_RxErrCnt "CAN";
BA_ "CANzero_SDO_AccessType" SG_ 1447 MDB3_OD_CAN1_RxErrCnt 1;
BA_ "CANzero_SDO_AccessIfOperational" SG_ 1447 MDB3_OD_CAN1_RxErrCnt 1;
BA_ "CANzero_SDO_Group" SG_ 1447 MDB3_OD_CAN1_TxErrCnt "CAN";
BA_ "CANzero_SDO_AccessType" SG_ 1447 MDB3_OD_CAN1_TxErrCnt 1;
BA_ "CANzero_SDO_AccessIfOperational" SG_ 1447 MDB3_OD_CAN1_TxErrCnt 1;
BA_ "CANzero_SDO_AccessType" SG_ 1447 MDB3_OD_BuildTime 1;
BA_ "CANzero_SDO_AccessIfOperational" SG_ 1447 MDB3_OD_BuildTime 1;
BA_ "CANzero_SDO_AccessType" SG_ 1447 MDB3_OD_BuildDate 1;
BA_ "CANzero_SDO_AccessIfOperational" SG_ 1447 MDB3_OD_BuildDate 1;
BA_ "CANzero_SDO_AccessType" SG_ 1447 MDB3_OD_ChipUID2 1;
BA_ "CANzero_SDO_AccessIfOperational" SG_ 1447 MDB3_OD_ChipUID2 1;
BA_ "CANzero_SDO_AccessType" SG_ 1447 MDB3_OD_ChipUID1 1;
BA_ "CANzero_SDO_AccessIfOperational" SG_ 1447 MDB3_OD_ChipUID1 1;
BA_ "CANzero_SDO_AccessType" SG_ 1447 MDB3_OD_SdcOut 1;
BA_ "CANzero_SDO_AccessIfOperational" SG_ 1447 MDB3_OD_SdcOut 1;
BA_ "CANzero_SDO_AccessType" SG_ 1447 MDB3_OD_SdcIn 1;
BA_ "CANzero_SDO_AccessIfOperational" SG_ 1447 MDB3_OD_SdcIn 1;
BA_ "CANzero_SDO_AccessType" SG_ 1447 MDB3_OD_runtime 1;
BA_ "CANzero_SDO_AccessIfOperational" SG_ 1447 MDB3_OD_runtime 1;
BA_ "CANzero_SDO_AccessType" SG_ 1447 MDB3_OD_InputVoltage 1;
BA_ "CANzero_SDO_AccessIfOperational" SG_ 1447 MDB3_OD_InputVoltage 1;
BA_ "CANzero_SDO_AccessType" SG_ 1447 MDB3_OD_BoardTemp 1;
BA_ "CANzero_SDO_AccessIfOperational" SG_ 1447 MDB3_OD_BoardTemp 1;
BA_ "GenSigStartValue" SG_ 1447 MDB3_OD_BoardTemp 3000.0;
BA_ "CANzero_SDO_AccessType" SG_ 1447 MDB3_OD_MemFree 1;
BA_ "CANzero_SDO_AccessIfOperational" SG_ 1447 MDB3_OD_MemFree 1;
BA_ "CANzero_SDO_AccessType" SG_ 1447 MDB3_OD_CpuUsage 1;
BA_ "CANzero_SDO_AccessIfOperational" SG_ 1447 MDB3_OD_CpuUsage 1;
BA_ "CANzero_SDO_AccessIfOperational" SG_ 1447 MDB3_OD_OdEntrySendInterval 1;
BA_ "GenSigStartValue" SG_ 1447 MDB3_OD_OdEntrySendInterval 50.0;
BA_ "CANzero_SDO_Default" SG_ 1447 MDB3_OD_OdEntrySendInterval 50;
BA_ "CANzero_SDO_AccessIfOperational" SG_ 1447 MDB3_OD_SendOdOnBootup 1;
BA_ "CANzero_SDO_AccessIfOperational" SG_ 1447 MDB3_OD_HeartbeatInterval 1;
BA_ "GenSigStartValue" SG_ 1447 MDB3_OD_HeartbeatInterval 250.0;
BA_ "CANzero_SDO_Default" SG_ 1447 MDB3_OD_HeartbeatInterval 250;
BA_ "CANzero_SDO_AccessType" SG_ 1447 MDB3_OD_DbcVersion 1;
BA_ "CANzero_SDO_AccessIfOperational" SG_ 1447 MDB3_OD_DbcVersion 1;
BA_ "CANzero_SDO_AccessType" SG_ 1447 MDB3_OD_StackVersion 1;
BA_ "CANzero_SDO_AccessIfOperational" SG_ 1447 MDB3_OD_StackVersion 1;
BA_ "CANzero_SDO_AccessType" SG_ 1447 MDB3_OD_ProtocolVersion 1;
BA_ "CANzero_SDO_AccessIfOperational" SG_ 1447 MDB3_OD_ProtocolVersion 1;
BA_ "GenSigStartValue" SG_ 1447 MDB3_OD_ProtocolVersion 1.0;
BA_ "CANzero_SDO_Default" SG_ 1447 MDB3_OD_ProtocolVersion 1;
BA_ "CANzero_SDO_AccessType" SG_ 1447 MDB3_OD_NodeStatus 1;
BA_ "CANzero_SDO_AccessIfOperational" SG_ 1447 MDB3_OD_NodeStatus 1;
BA_ "CANzero_SDO_AccessType" SG_ 1447 MDB3_OD_NodeID 1;
BA_ "CANzero_SDO_AccessIfOperational" SG_ 1447 MDB3_OD_NodeID 1;
BA_ "CANzero_SDO_Group" SG_ 1511 MDB3_OD_CAN2_DelayedTxMessages "CAN";
BA_ "CANzero_SDO_AccessType" SG_ 1511 MDB3_OD_CAN2_DelayedTxMessages 1;
BA_ "CANzero_SDO_AccessIfOperational" SG_ 1511 MDB3_OD_CAN2_DelayedTxMessages 1;
BA_ "CANzero_SDO_Group" SG_ 1511 MDB3_OD_CAN2_ErrorStatus "CAN";
BA_ "CANzero_SDO_AccessType" SG_ 1511 MDB3_OD_CAN2_ErrorStatus 1;
BA_ "CANzero_SDO_AccessIfOperational" SG_ 1511 MDB3_OD_CAN2_ErrorStatus 1;
BA_ "CANzero_SDO_Group" SG_ 1511 MDB3_OD_CAN2_DiscardedTxMessages "CAN";
BA_ "CANzero_SDO_AccessType" SG_ 1511 MDB3_OD_CAN2_DiscardedTxMessages 1;
BA_ "CANzero_SDO_AccessIfOperational" SG_ 1511 MDB3_OD_CAN2_DiscardedTxMessages 1;
BA_ "CANzero_SDO_Group" SG_ 1511 MDB3_OD_CAN2_Status "CAN";
BA_ "CANzero_SDO_AccessType" SG_ 1511 MDB3_OD_CAN2_Status 1;
BA_ "CANzero_SDO_AccessIfOperational" SG_ 1511 MDB3_OD_CAN2_Status 1;
BA_ "CANzero_SDO_Group" SG_ 1511 MDB3_OD_CAN2_Baudrate "CAN";
BA_ "CANzero_SDO_AccessIfOperational" SG_ 1511 MDB3_OD_CAN2_Baudrate 1;
BA_ "GenSigStartValue" SG_ 1511 MDB3_OD_CAN2_Baudrate 1000.0;
BA_ "CANzero_SDO_Default" SG_ 1511 MDB3_OD_CAN2_Baudrate 1000;
BA_ "CANzero_SDO_Group" SG_ 1511 MDB3_OD_CAN2_autoErrorReset "CAN";
BA_ "CANzero_SDO_AccessIfOperational" SG_ 1511 MDB3_OD_CAN2_autoErrorReset 1;
BA_ "GenSigStartValue" SG_ 1511 MDB3_OD_CAN2_autoErrorReset 1.0;
BA_ "CANzero_SDO_Default" SG_ 1511 MDB3_OD_CAN2_autoErrorReset 1;
BA_ "CANzero_SDO_Group" SG_ 1511 MDB3_OD_CAN2_lastErrorCode "CAN";
BA_ "CANzero_SDO_AccessType" SG_ 1511 MDB3_OD_CAN2_lastErrorCode 1;
BA_ "CANzero_SDO_AccessIfOperational" SG_ 1511 MDB3_OD_CAN2_lastErrorCode 1;
BA_ "CANzero_SDO_Group" SG_ 1511 MDB3_OD_CAN2_RxErrCnt "CAN";
BA_ "CANzero_SDO_AccessType" SG_ 1511 MDB3_OD_CAN2_RxErrCnt 1;
BA_ "CANzero_SDO_AccessIfOperational" SG_ 1511 MDB3_OD_CAN2_RxErrCnt 1;
BA_ "CANzero_SDO_Group" SG_ 1511 MDB3_OD_CAN2_TxErrCnt "CAN";
BA_ "CANzero_SDO_AccessType" SG_ 1511 MDB3_OD_CAN2_TxErrCnt 1;
BA_ "CANzero_SDO_AccessIfOperational" SG_ 1511 MDB3_OD_CAN2_TxErrCnt 1;
BA_ "CANzero_SDO_Group" SG_ 1511 MDB3_OD_CAN1_DelayedTxMessages "CAN";
BA_ "CANzero_SDO_AccessType" SG_ 1511 MDB3_OD_CAN1_DelayedTxMessages 1;
BA_ "CANzero_SDO_AccessIfOperational" SG_ 1511 MDB3_OD_CAN1_DelayedTxMessages 1;
BA_ "CANzero_SDO_Group" SG_ 1511 MDB3_OD_CAN1_ErrorStatus "CAN";
BA_ "CANzero_SDO_AccessType" SG_ 1511 MDB3_OD_CAN1_ErrorStatus 1;
BA_ "CANzero_SDO_AccessIfOperational" SG_ 1511 MDB3_OD_CAN1_ErrorStatus 1;
BA_ "CANzero_SDO_Group" SG_ 1511 MDB3_OD_CAN1_DiscardedTxMessages "CAN";
BA_ "CANzero_SDO_AccessType" SG_ 1511 MDB3_OD_CAN1_DiscardedTxMessages 1;
BA_ "CANzero_SDO_AccessIfOperational" SG_ 1511 MDB3_OD_CAN1_DiscardedTxMessages 1;
BA_ "CANzero_SDO_Group" SG_ 1511 MDB3_OD_CAN1_Status "CAN";
BA_ "CANzero_SDO_AccessType" SG_ 1511 MDB3_OD_CAN1_Status 1;
BA_ "CANzero_SDO_AccessIfOperational" SG_ 1511 MDB3_OD_CAN1_Status 1;
BA_ "CANzero_SDO_Group" SG_ 1511 MDB3_OD_CAN1_Baudrate "CAN";
BA_ "CANzero_SDO_AccessIfOperational" SG_ 1511 MDB3_OD_CAN1_Baudrate 1;
BA_ "GenSigStartValue" SG_ 1511 MDB3_OD_CAN1_Baudrate 1000.0;
BA_ "CANzero_SDO_Default" SG_ 1511 MDB3_OD_CAN1_Baudrate 1000;
BA_ "CANzero_SDO_Group" SG_ 1511 MDB3_OD_CAN1_autoErrorReset "CAN";
BA_ "CANzero_SDO_AccessIfOperational" SG_ 1511 MDB3_OD_CAN1_autoErrorReset 1;
BA_ "GenSigStartValue" SG_ 1511 MDB3_OD_CAN1_autoErrorReset 1.0;
BA_ "CANzero_SDO_Default" SG_ 1511 MDB3_OD_CAN1_autoErrorReset 1;
BA_ "CANzero_SDO_Group" SG_ 1511 MDB3_OD_CAN1_lastErrorCode "CAN";
BA_ "CANzero_SDO_AccessType" SG_ 1511 MDB3_OD_CAN1_lastErrorCode 1;
BA_ "CANzero_SDO_AccessIfOperational" SG_ 1511 MDB3_OD_CAN1_lastErrorCode 1;
BA_ "CANzero_SDO_Group" SG_ 1511 MDB3_OD_CAN1_RxErrCnt "CAN";
BA_ "CANzero_SDO_AccessType" SG_ 1511 MDB3_OD_CAN1_RxErrCnt 1;
BA_ "CANzero_SDO_AccessIfOperational" SG_ 1511 MDB3_OD_CAN1_RxErrCnt 1;
BA_ "CANzero_SDO_Group" SG_ 1511 MDB3_OD_CAN1_TxErrCnt "CAN";
BA_ "CANzero_SDO_AccessType" SG_ 1511 MDB3_OD_CAN1_TxErrCnt 1;
BA_ "CANzero_SDO_AccessIfOperational" SG_ 1511 MDB3_OD_CAN1_TxErrCnt 1;
BA_ "CANzero_SDO_AccessType" SG_ 1511 MDB3_OD_BuildTime 1;
BA_ "CANzero_SDO_AccessIfOperational" SG_ 1511 MDB3_OD_BuildTime 1;
BA_ "CANzero_SDO_AccessType" SG_ 1511 MDB3_OD_BuildDate 1;
BA_ "CANzero_SDO_AccessIfOperational" SG_ 1511 MDB3_OD_BuildDate 1;
BA_ "CANzero_SDO_AccessType" SG_ 1511 MDB3_OD_ChipUID2 1;
BA_ "CANzero_SDO_AccessIfOperational" SG_ 1511 MDB3_OD_ChipUID2 1;
BA_ "CANzero_SDO_AccessType" SG_ 1511 MDB3_OD_ChipUID1 1;
BA_ "CANzero_SDO_AccessIfOperational" SG_ 1511 MDB3_OD_ChipUID1 1;
BA_ "CANzero_SDO_AccessType" SG_ 1511 MDB3_OD_SdcOut 1;
BA_ "CANzero_SDO_AccessIfOperational" SG_ 1511 MDB3_OD_SdcOut 1;
BA_ "CANzero_SDO_AccessType" SG_ 1511 MDB3_OD_SdcIn 1;
BA_ "CANzero_SDO_AccessIfOperational" SG_ 1511 MDB3_OD_SdcIn 1;
BA_ "CANzero_SDO_AccessType" SG_ 1511 MDB3_OD_runtime 1;
BA_ "CANzero_SDO_AccessIfOperational" SG_ 1511 MDB3_OD_runtime 1;
BA_ "CANzero_SDO_AccessType" SG_ 1511 MDB3_OD_InputVoltage 1;
BA_ "CANzero_SDO_AccessIfOperational" SG_ 1511 MDB3_OD_InputVoltage 1;
BA_ "CANzero_SDO_AccessType" SG_ 1511 MDB3_OD_BoardTemp 1;
BA_ "CANzero_SDO_AccessIfOperational" SG_ 1511 MDB3_OD_BoardTemp 1;
BA_ "GenSigStartValue" SG_ 1511 MDB3_OD_BoardTemp 3000.0;
BA_ "CANzero_SDO_AccessType" SG_ 1511 MDB3_OD_MemFree 1;
BA_ "CANzero_SDO_AccessIfOperational" SG_ 1511 MDB3_OD_MemFree 1;
BA_ "CANzero_SDO_AccessType" SG_ 1511 MDB3_OD_CpuUsage 1;
BA_ "CANzero_SDO_AccessIfOperational" SG_ 1511 MDB3_OD_CpuUsage 1;
BA_ "CANzero_SDO_AccessIfOperational" SG_ 1511 MDB3_OD_OdEntrySendInterval 1;
BA_ "GenSigStartValue" SG_ 1511 MDB3_OD_OdEntrySendInterval 50.0;
BA_ "CANzero_SDO_Default" SG_ 1511 MDB3_OD_OdEntrySendInterval 50;
BA_ "CANzero_SDO_AccessIfOperational" SG_ 1511 MDB3_OD_SendOdOnBootup 1;
BA_ "CANzero_SDO_AccessIfOperational" SG_ 1511 MDB3_OD_HeartbeatInterval 1;
BA_ "GenSigStartValue" SG_ 1511 MDB3_OD_HeartbeatInterval 250.0;
BA_ "CANzero_SDO_Default" SG_ 1511 MDB3_OD_HeartbeatInterval 250;
BA_ "CANzero_SDO_AccessType" SG_ 1511 MDB3_OD_DbcVersion 1;
BA_ "CANzero_SDO_AccessIfOperational" SG_ 1511 MDB3_OD_DbcVersion 1;
BA_ "CANzero_SDO_AccessType" SG_ 1511 MDB3_OD_StackVersion 1;
BA_ "CANzero_SDO_AccessIfOperational" SG_ 1511 MDB3_OD_StackVersion 1;
BA_ "CANzero_SDO_AccessType" SG_ 1511 MDB3_OD_ProtocolVersion 1;
BA_ "CANzero_SDO_AccessIfOperational" SG_ 1511 MDB3_OD_ProtocolVersion 1;
BA_ "GenSigStartValue" SG_ 1511 MDB3_OD_ProtocolVersion 1.0;
BA_ "CANzero_SDO_Default" SG_ 1511 MDB3_OD_ProtocolVersion 1;
BA_ "CANzero_SDO_AccessType" SG_ 1511 MDB3_OD_NodeStatus 1;
BA_ "CANzero_SDO_AccessIfOperational" SG_ 1511 MDB3_OD_NodeStatus 1;
BA_ "CANzero_SDO_AccessType" SG_ 1511 MDB3_OD_NodeID 1;
BA_ "CANzero_SDO_AccessIfOperational" SG_ 1511 MDB3_OD_NodeID 1;
BA_ "CANzero_SDO_Group" SG_ 1448 MDB4_OD_CAN2_DelayedTxMessages "CAN";
BA_ "CANzero_SDO_AccessType" SG_ 1448 MDB4_OD_CAN2_DelayedTxMessages 1;
BA_ "CANzero_SDO_AccessIfOperational" SG_ 1448 MDB4_OD_CAN2_DelayedTxMessages 1;
BA_ "CANzero_SDO_Group" SG_ 1448 MDB4_OD_CAN2_ErrorStatus "CAN";
BA_ "CANzero_SDO_AccessType" SG_ 1448 MDB4_OD_CAN2_ErrorStatus 1;
BA_ "CANzero_SDO_AccessIfOperational" SG_ 1448 MDB4_OD_CAN2_ErrorStatus 1;
BA_ "CANzero_SDO_Group" SG_ 1448 MDB4_OD_CAN2_DiscardedTxMessages "CAN";
BA_ "CANzero_SDO_AccessType" SG_ 1448 MDB4_OD_CAN2_DiscardedTxMessages 1;
BA_ "CANzero_SDO_AccessIfOperational" SG_ 1448 MDB4_OD_CAN2_DiscardedTxMessages 1;
BA_ "CANzero_SDO_Group" SG_ 1448 MDB4_OD_CAN2_Status "CAN";
BA_ "CANzero_SDO_AccessType" SG_ 1448 MDB4_OD_CAN2_Status 1;
BA_ "CANzero_SDO_AccessIfOperational" SG_ 1448 MDB4_OD_CAN2_Status 1;
BA_ "CANzero_SDO_Group" SG_ 1448 MDB4_OD_CAN2_Baudrate "CAN";
BA_ "CANzero_SDO_AccessIfOperational" SG_ 1448 MDB4_OD_CAN2_Baudrate 1;
BA_ "GenSigStartValue" SG_ 1448 MDB4_OD_CAN2_Baudrate 1000.0;
BA_ "CANzero_SDO_Default" SG_ 1448 MDB4_OD_CAN2_Baudrate 1000;
BA_ "CANzero_SDO_Group" SG_ 1448 MDB4_OD_CAN2_autoErrorReset "CAN";
BA_ "CANzero_SDO_AccessIfOperational" SG_ 1448 MDB4_OD_CAN2_autoErrorReset 1;
BA_ "GenSigStartValue" SG_ 1448 MDB4_OD_CAN2_autoErrorReset 1.0;
BA_ "CANzero_SDO_Default" SG_ 1448 MDB4_OD_CAN2_autoErrorReset 1;
BA_ "CANzero_SDO_Group" SG_ 1448 MDB4_OD_CAN2_lastErrorCode "CAN";
BA_ "CANzero_SDO_AccessType" SG_ 1448 MDB4_OD_CAN2_lastErrorCode 1;
BA_ "CANzero_SDO_AccessIfOperational" SG_ 1448 MDB4_OD_CAN2_lastErrorCode 1;
BA_ "CANzero_SDO_Group" SG_ 1448 MDB4_OD_CAN2_RxErrCnt "CAN";
BA_ "CANzero_SDO_AccessType" SG_ 1448 MDB4_OD_CAN2_RxErrCnt 1;
BA_ "CANzero_SDO_AccessIfOperational" SG_ 1448 MDB4_OD_CAN2_RxErrCnt 1;
BA_ "CANzero_SDO_Group" SG_ 1448 MDB4_OD_CAN2_TxErrCnt "CAN";
BA_ "CANzero_SDO_AccessType" SG_ 1448 MDB4_OD_CAN2_TxErrCnt 1;
BA_ "CANzero_SDO_AccessIfOperational" SG_ 1448 MDB4_OD_CAN2_TxErrCnt 1;
BA_ "CANzero_SDO_Group" SG_ 1448 MDB4_OD_CAN1_DelayedTxMessages "CAN";
BA_ "CANzero_SDO_AccessType" SG_ 1448 MDB4_OD_CAN1_DelayedTxMessages 1;
BA_ "CANzero_SDO_AccessIfOperational" SG_ 1448 MDB4_OD_CAN1_DelayedTxMessages 1;
BA_ "CANzero_SDO_Group" SG_ 1448 MDB4_OD_CAN1_ErrorStatus "CAN";
BA_ "CANzero_SDO_AccessType" SG_ 1448 MDB4_OD_CAN1_ErrorStatus 1;
BA_ "CANzero_SDO_AccessIfOperational" SG_ 1448 MDB4_OD_CAN1_ErrorStatus 1;
BA_ "CANzero_SDO_Group" SG_ 1448 MDB4_OD_CAN1_DiscardedTxMessages "CAN";
BA_ "CANzero_SDO_AccessType" SG_ 1448 MDB4_OD_CAN1_DiscardedTxMessages 1;
BA_ "CANzero_SDO_AccessIfOperational" SG_ 1448 MDB4_OD_CAN1_DiscardedTxMessages 1;
BA_ "CANzero_SDO_Group" SG_ 1448 MDB4_OD_CAN1_Status "CAN";
BA_ "CANzero_SDO_AccessType" SG_ 1448 MDB4_OD_CAN1_Status 1;
BA_ "CANzero_SDO_AccessIfOperational" SG_ 1448 MDB4_OD_CAN1_Status 1;
BA_ "CANzero_SDO_Group" SG_ 1448 MDB4_OD_CAN1_Baudrate "CAN";
BA_ "CANzero_SDO_AccessIfOperational" SG_ 1448 MDB4_OD_CAN1_Baudrate 1;
BA_ "GenSigStartValue" SG_ 1448 MDB4_OD_CAN1_Baudrate 1000.0;
BA_ "CANzero_SDO_Default" SG_ 1448 MDB4_OD_CAN1_Baudrate 1000;
BA_ "CANzero_SDO_Group" SG_ 1448 MDB4_OD_CAN1_autoErrorReset "CAN";
BA_ "CANzero_SDO_AccessIfOperational" SG_ 1448 MDB4_OD_CAN1_autoErrorReset 1;
BA_ "GenSigStartValue" SG_ 1448 MDB4_OD_CAN1_autoErrorReset 1.0;
BA_ "CANzero_SDO_Default" SG_ 1448 MDB4_OD_CAN1_autoErrorReset 1;
BA_ "CANzero_SDO_Group" SG_ 1448 MDB4_OD_CAN1_lastErrorCode "CAN";
BA_ "CANzero_SDO_AccessType" SG_ 1448 MDB4_OD_CAN1_lastErrorCode 1;
BA_ "CANzero_SDO_AccessIfOperational" SG_ 1448 MDB4_OD_CAN1_lastErrorCode 1;
BA_ "CANzero_SDO_Group" SG_ 1448 MDB4_OD_CAN1_RxErrCnt "CAN";
BA_ "CANzero_SDO_AccessType" SG_ 1448 MDB4_OD_CAN1_RxErrCnt 1;
BA_ "CANzero_SDO_AccessIfOperational" SG_ 1448 MDB4_OD_CAN1_RxErrCnt 1;
BA_ "CANzero_SDO_Group" SG_ 1448 MDB4_OD_CAN1_TxErrCnt "CAN";
BA_ "CANzero_SDO_AccessType" SG_ 1448 MDB4_OD_CAN1_TxErrCnt 1;
BA_ "CANzero_SDO_AccessIfOperational" SG_ 1448 MDB4_OD_CAN1_TxErrCnt 1;
BA_ "CANzero_SDO_AccessType" SG_ 1448 MDB4_OD_BuildTime 1;
BA_ "CANzero_SDO_AccessIfOperational" SG_ 1448 MDB4_OD_BuildTime 1;
BA_ "CANzero_SDO_AccessType" SG_ 1448 MDB4_OD_BuildDate 1;
BA_ "CANzero_SDO_AccessIfOperational" SG_ 1448 MDB4_OD_BuildDate 1;
BA_ "CANzero_SDO_AccessType" SG_ 1448 MDB4_OD_ChipUID2 1;
BA_ "CANzero_SDO_AccessIfOperational" SG_ 1448 MDB4_OD_ChipUID2 1;
BA_ "CANzero_SDO_AccessType" SG_ 1448 MDB4_OD_ChipUID1 1;
BA_ "CANzero_SDO_AccessIfOperational" SG_ 1448 MDB4_OD_ChipUID1 1;
BA_ "CANzero_SDO_AccessType" SG_ 1448 MDB4_OD_SdcOut 1;
BA_ "CANzero_SDO_AccessIfOperational" SG_ 1448 MDB4_OD_SdcOut 1;
BA_ "CANzero_SDO_AccessType" SG_ 1448 MDB4_OD_SdcIn 1;
BA_ "CANzero_SDO_AccessIfOperational" SG_ 1448 MDB4_OD_SdcIn 1;
BA_ "CANzero_SDO_AccessType" SG_ 1448 MDB4_OD_runtime 1;
BA_ "CANzero_SDO_AccessIfOperational" SG_ 1448 MDB4_OD_runtime 1;
BA_ "CANzero_SDO_AccessType" SG_ 1448 MDB4_OD_InputVoltage 1;
BA_ "CANzero_SDO_AccessIfOperational" SG_ 1448 MDB4_OD_InputVoltage 1;
BA_ "CANzero_SDO_AccessType" SG_ 1448 MDB4_OD_BoardTemp 1;
BA_ "CANzero_SDO_AccessIfOperational" SG_ 1448 MDB4_OD_BoardTemp 1;
BA_ "GenSigStartValue" SG_ 1448 MDB4_OD_BoardTemp 3000.0;
BA_ "CANzero_SDO_AccessType" SG_ 1448 MDB4_OD_MemFree 1;
BA_ "CANzero_SDO_AccessIfOperational" SG_ 1448 MDB4_OD_MemFree 1;
BA_ "CANzero_SDO_AccessType" SG_ 1448 MDB4_OD_CpuUsage 1;
BA_ "CANzero_SDO_AccessIfOperational" SG_ 1448 MDB4_OD_CpuUsage 1;
BA_ "CANzero_SDO_AccessIfOperational" SG_ 1448 MDB4_OD_OdEntrySendInterval 1;
BA_ "GenSigStartValue" SG_ 1448 MDB4_OD_OdEntrySendInterval 50.0;
BA_ "CANzero_SDO_Default" SG_ 1448 MDB4_OD_OdEntrySendInterval 50;
BA_ "CANzero_SDO_AccessIfOperational" SG_ 1448 MDB4_OD_SendOdOnBootup 1;
BA_ "CANzero_SDO_AccessIfOperational" SG_ 1448 MDB4_OD_HeartbeatInterval 1;
BA_ "GenSigStartValue" SG_ 1448 MDB4_OD_HeartbeatInterval 250.0;
BA_ "CANzero_SDO_Default" SG_ 1448 MDB4_OD_HeartbeatInterval 250;
BA_ "CANzero_SDO_AccessType" SG_ 1448 MDB4_OD_DbcVersion 1;
BA_ "CANzero_SDO_AccessIfOperational" SG_ 1448 MDB4_OD_DbcVersion 1;
BA_ "CANzero_SDO_AccessType" SG_ 1448 MDB4_OD_StackVersion 1;
BA_ "CANzero_SDO_AccessIfOperational" SG_ 1448 MDB4_OD_StackVersion 1;
BA_ "CANzero_SDO_AccessType" SG_ 1448 MDB4_OD_ProtocolVersion 1;
BA_ "CANzero_SDO_AccessIfOperational" SG_ 1448 MDB4_OD_ProtocolVersion 1;
BA_ "GenSigStartValue" SG_ 1448 MDB4_OD_ProtocolVersion 1.0;
BA_ "CANzero_SDO_Default" SG_ 1448 MDB4_OD_ProtocolVersion 1;
BA_ "CANzero_SDO_AccessType" SG_ 1448 MDB4_OD_NodeStatus 1;
BA_ "CANzero_SDO_AccessIfOperational" SG_ 1448 MDB4_OD_NodeStatus 1;
BA_ "CANzero_SDO_AccessType" SG_ 1448 MDB4_OD_NodeID 1;
BA_ "CANzero_SDO_AccessIfOperational" SG_ 1448 MDB4_OD_NodeID 1;
BA_ "CANzero_SDO_Group" SG_ 1512 MDB4_OD_CAN2_DelayedTxMessages "CAN";
BA_ "CANzero_SDO_AccessType" SG_ 1512 MDB4_OD_CAN2_DelayedTxMessages 1;
BA_ "CANzero_SDO_AccessIfOperational" SG_ 1512 MDB4_OD_CAN2_DelayedTxMessages 1;
BA_ "CANzero_SDO_Group" SG_ 1512 MDB4_OD_CAN2_ErrorStatus "CAN";
BA_ "CANzero_SDO_AccessType" SG_ 1512 MDB4_OD_CAN2_ErrorStatus 1;
BA_ "CANzero_SDO_AccessIfOperational" SG_ 1512 MDB4_OD_CAN2_ErrorStatus 1;
BA_ "CANzero_SDO_Group" SG_ 1512 MDB4_OD_CAN2_DiscardedTxMessages "CAN";
BA_ "CANzero_SDO_AccessType" SG_ 1512 MDB4_OD_CAN2_DiscardedTxMessages 1;
BA_ "CANzero_SDO_AccessIfOperational" SG_ 1512 MDB4_OD_CAN2_DiscardedTxMessages 1;
BA_ "CANzero_SDO_Group" SG_ 1512 MDB4_OD_CAN2_Status "CAN";
BA_ "CANzero_SDO_AccessType" SG_ 1512 MDB4_OD_CAN2_Status 1;
BA_ "CANzero_SDO_AccessIfOperational" SG_ 1512 MDB4_OD_CAN2_Status 1;
BA_ "CANzero_SDO_Group" SG_ 1512 MDB4_OD_CAN2_Baudrate "CAN";
BA_ "CANzero_SDO_AccessIfOperational" SG_ 1512 MDB4_OD_CAN2_Baudrate 1;
BA_ "GenSigStartValue" SG_ 1512 MDB4_OD_CAN2_Baudrate 1000.0;
BA_ "CANzero_SDO_Default" SG_ 1512 MDB4_OD_CAN2_Baudrate 1000;
BA_ "CANzero_SDO_Group" SG_ 1512 MDB4_OD_CAN2_autoErrorReset "CAN";
BA_ "CANzero_SDO_AccessIfOperational" SG_ 1512 MDB4_OD_CAN2_autoErrorReset 1;
BA_ "GenSigStartValue" SG_ 1512 MDB4_OD_CAN2_autoErrorReset 1.0;
BA_ "CANzero_SDO_Default" SG_ 1512 MDB4_OD_CAN2_autoErrorReset 1;
BA_ "CANzero_SDO_Group" SG_ 1512 MDB4_OD_CAN2_lastErrorCode "CAN";
BA_ "CANzero_SDO_AccessType" SG_ 1512 MDB4_OD_CAN2_lastErrorCode 1;
BA_ "CANzero_SDO_AccessIfOperational" SG_ 1512 MDB4_OD_CAN2_lastErrorCode 1;
BA_ "CANzero_SDO_Group" SG_ 1512 MDB4_OD_CAN2_RxErrCnt "CAN";
BA_ "CANzero_SDO_AccessType" SG_ 1512 MDB4_OD_CAN2_RxErrCnt 1;
BA_ "CANzero_SDO_AccessIfOperational" SG_ 1512 MDB4_OD_CAN2_RxErrCnt 1;
BA_ "CANzero_SDO_Group" SG_ 1512 MDB4_OD_CAN2_TxErrCnt "CAN";
BA_ "CANzero_SDO_AccessType" SG_ 1512 MDB4_OD_CAN2_TxErrCnt 1;
BA_ "CANzero_SDO_AccessIfOperational" SG_ 1512 MDB4_OD_CAN2_TxErrCnt 1;
BA_ "CANzero_SDO_Group" SG_ 1512 MDB4_OD_CAN1_DelayedTxMessages "CAN";
BA_ "CANzero_SDO_AccessType" SG_ 1512 MDB4_OD_CAN1_DelayedTxMessages 1;
BA_ "CANzero_SDO_AccessIfOperational" SG_ 1512 MDB4_OD_CAN1_DelayedTxMessages 1;
BA_ "CANzero_SDO_Group" SG_ 1512 MDB4_OD_CAN1_ErrorStatus "CAN";
BA_ "CANzero_SDO_AccessType" SG_ 1512 MDB4_OD_CAN1_ErrorStatus 1;
BA_ "CANzero_SDO_AccessIfOperational" SG_ 1512 MDB4_OD_CAN1_ErrorStatus 1;
BA_ "CANzero_SDO_Group" SG_ 1512 MDB4_OD_CAN1_DiscardedTxMessages "CAN";
BA_ "CANzero_SDO_AccessType" SG_ 1512 MDB4_OD_CAN1_DiscardedTxMessages 1;
BA_ "CANzero_SDO_AccessIfOperational" SG_ 1512 MDB4_OD_CAN1_DiscardedTxMessages 1;
BA_ "CANzero_SDO_Group" SG_ 1512 MDB4_OD_CAN1_Status "CAN";
BA_ "CANzero_SDO_AccessType" SG_ 1512 MDB4_OD_CAN1_Status 1;
BA_ "CANzero_SDO_AccessIfOperational" SG_ 1512 MDB4_OD_CAN1_Status 1;
BA_ "CANzero_SDO_Group" SG_ 1512 MDB4_OD_CAN1_Baudrate "CAN";
BA_ "CANzero_SDO_AccessIfOperational" SG_ 1512 MDB4_OD_CAN1_Baudrate 1;
BA_ "GenSigStartValue" SG_ 1512 MDB4_OD_CAN1_Baudrate 1000.0;
BA_ "CANzero_SDO_Default" SG_ 1512 MDB4_OD_CAN1_Baudrate 1000;
BA_ "CANzero_SDO_Group" SG_ 1512 MDB4_OD_CAN1_autoErrorReset "CAN";
BA_ "CANzero_SDO_AccessIfOperational" SG_ 1512 MDB4_OD_CAN1_autoErrorReset 1;
BA_ "GenSigStartValue" SG_ 1512 MDB4_OD_CAN1_autoErrorReset 1.0;
BA_ "CANzero_SDO_Default" SG_ 1512 MDB4_OD_CAN1_autoErrorReset 1;
BA_ "CANzero_SDO_Group" SG_ 1512 MDB4_OD_CAN1_lastErrorCode "CAN";
BA_ "CANzero_SDO_AccessType" SG_ 1512 MDB4_OD_CAN1_lastErrorCode 1;
BA_ "CANzero_SDO_AccessIfOperational" SG_ 1512 MDB4_OD_CAN1_lastErrorCode 1;
BA_ "CANzero_SDO_Group" SG_ 1512 MDB4_OD_CAN1_RxErrCnt "CAN";
BA_ "CANzero_SDO_AccessType" SG_ 1512 MDB4_OD_CAN1_RxErrCnt 1;
BA_ "CANzero_SDO_AccessIfOperational" SG_ 1512 MDB4_OD_CAN1_RxErrCnt 1;
BA_ "CANzero_SDO_Group" SG_ 1512 MDB4_OD_CAN1_TxErrCnt "CAN";
BA_ "CANzero_SDO_AccessType" SG_ 1512 MDB4_OD_CAN1_TxErrCnt 1;
BA_ "CANzero_SDO_AccessIfOperational" SG_ 1512 MDB4_OD_CAN1_TxErrCnt 1;
BA_ "CANzero_SDO_AccessType" SG_ 1512 MDB4_OD_BuildTime 1;
BA_ "CANzero_SDO_AccessIfOperational" SG_ 1512 MDB4_OD_BuildTime 1;
BA_ "CANzero_SDO_AccessType" SG_ 1512 MDB4_OD_BuildDate 1;
BA_ "CANzero_SDO_AccessIfOperational" SG_ 1512 MDB4_OD_BuildDate 1;
BA_ "CANzero_SDO_AccessType" SG_ 1512 MDB4_OD_ChipUID2 1;
BA_ "CANzero_SDO_AccessIfOperational" SG_ 1512 MDB4_OD_ChipUID2 1;
BA_ "CANzero_SDO_AccessType" SG_ 1512 MDB4_OD_ChipUID1 1;
BA_ "CANzero_SDO_AccessIfOperational" SG_ 1512 MDB4_OD_ChipUID1 1;
BA_ "CANzero_SDO_AccessType" SG_ 1512 MDB4_OD_SdcOut 1;
BA_ "CANzero_SDO_AccessIfOperational" SG_ 1512 MDB4_OD_SdcOut 1;
BA_ "CANzero_SDO_AccessType" SG_ 1512 MDB4_OD_SdcIn 1;
BA_ "CANzero_SDO_AccessIfOperational" SG_ 1512 MDB4_OD_SdcIn 1;
BA_ "CANzero_SDO_AccessType" SG_ 1512 MDB4_OD_runtime 1;
BA_ "CANzero_SDO_AccessIfOperational" SG_ 1512 MDB4_OD_runtime 1;
BA_ "CANzero_SDO_AccessType" SG_ 1512 MDB4_OD_InputVoltage 1;
BA_ "CANzero_SDO_AccessIfOperational" SG_ 1512 MDB4_OD_InputVoltage 1;
BA_ "CANzero_SDO_AccessType" SG_ 1512 MDB4_OD_BoardTemp 1;
BA_ "CANzero_SDO_AccessIfOperational" SG_ 1512 MDB4_OD_BoardTemp 1;
BA_ "GenSigStartValue" SG_ 1512 MDB4_OD_BoardTemp 3000.0;
BA_ "CANzero_SDO_AccessType" SG_ 1512 MDB4_OD_MemFree 1;
BA_ "CANzero_SDO_AccessIfOperational" SG_ 1512 MDB4_OD_MemFree 1;
BA_ "CANzero_SDO_AccessType" SG_ 1512 MDB4_OD_CpuUsage 1;
BA_ "CANzero_SDO_AccessIfOperational" SG_ 1512 MDB4_OD_CpuUsage 1;
BA_ "CANzero_SDO_AccessIfOperational" SG_ 1512 MDB4_OD_OdEntrySendInterval 1;
BA_ "GenSigStartValue" SG_ 1512 MDB4_OD_OdEntrySendInterval 50.0;
BA_ "CANzero_SDO_Default" SG_ 1512 MDB4_OD_OdEntrySendInterval 50;
BA_ "CANzero_SDO_AccessIfOperational" SG_ 1512 MDB4_OD_SendOdOnBootup 1;
BA_ "CANzero_SDO_AccessIfOperational" SG_ 1512 MDB4_OD_HeartbeatInterval 1;
BA_ "GenSigStartValue" SG_ 1512 MDB4_OD_HeartbeatInterval 250.0;
BA_ "CANzero_SDO_Default" SG_ 1512 MDB4_OD_HeartbeatInterval 250;
BA_ "CANzero_SDO_AccessType" SG_ 1512 MDB4_OD_DbcVersion 1;
BA_ "CANzero_SDO_AccessIfOperational" SG_ 1512 MDB4_OD_DbcVersion 1;
BA_ "CANzero_SDO_AccessType" SG_ 1512 MDB4_OD_StackVersion 1;
BA_ "CANzero_SDO_AccessIfOperational" SG_ 1512 MDB4_OD_StackVersion 1;
BA_ "CANzero_SDO_AccessType" SG_ 1512 MDB4_OD_ProtocolVersion 1;
BA_ "CANzero_SDO_AccessIfOperational" SG_ 1512 MDB4_OD_ProtocolVersion 1;
BA_ "GenSigStartValue" SG_ 1512 MDB4_OD_ProtocolVersion 1.0;
BA_ "CANzero_SDO_Default" SG_ 1512 MDB4_OD_ProtocolVersion 1;
BA_ "CANzero_SDO_AccessType" SG_ 1512 MDB4_OD_NodeStatus 1;
BA_ "CANzero_SDO_AccessIfOperational" SG_ 1512 MDB4_OD_NodeStatus 1;
BA_ "CANzero_SDO_AccessType" SG_ 1512 MDB4_OD_NodeID 1;
BA_ "CANzero_SDO_AccessIfOperational" SG_ 1512 MDB4_OD_NodeID 1;
BA_ "CANzero_SDO_Group" SG_ 1449 MDB5_OD_CAN2_DelayedTxMessages "CAN";
BA_ "CANzero_SDO_AccessType" SG_ 1449 MDB5_OD_CAN2_DelayedTxMessages 1;
BA_ "CANzero_SDO_AccessIfOperational" SG_ 1449 MDB5_OD_CAN2_DelayedTxMessages 1;
BA_ "CANzero_SDO_Group" SG_ 1449 MDB5_OD_CAN2_ErrorStatus "CAN";
BA_ "CANzero_SDO_AccessType" SG_ 1449 MDB5_OD_CAN2_ErrorStatus 1;
BA_ "CANzero_SDO_AccessIfOperational" SG_ 1449 MDB5_OD_CAN2_ErrorStatus 1;
BA_ "CANzero_SDO_Group" SG_ 1449 MDB5_OD_CAN2_DiscardedTxMessages "CAN";
BA_ "CANzero_SDO_AccessType" SG_ 1449 MDB5_OD_CAN2_DiscardedTxMessages 1;
BA_ "CANzero_SDO_AccessIfOperational" SG_ 1449 MDB5_OD_CAN2_DiscardedTxMessages 1;
BA_ "CANzero_SDO_Group" SG_ 1449 MDB5_OD_CAN2_Status "CAN";
BA_ "CANzero_SDO_AccessType" SG_ 1449 MDB5_OD_CAN2_Status 1;
BA_ "CANzero_SDO_AccessIfOperational" SG_ 1449 MDB5_OD_CAN2_Status 1;
BA_ "CANzero_SDO_Group" SG_ 1449 MDB5_OD_CAN2_Baudrate "CAN";
BA_ "CANzero_SDO_AccessIfOperational" SG_ 1449 MDB5_OD_CAN2_Baudrate 1;
BA_ "GenSigStartValue" SG_ 1449 MDB5_OD_CAN2_Baudrate 1000.0;
BA_ "CANzero_SDO_Default" SG_ 1449 MDB5_OD_CAN2_Baudrate 1000;
BA_ "CANzero_SDO_Group" SG_ 1449 MDB5_OD_CAN2_autoErrorReset "CAN";
BA_ "CANzero_SDO_AccessIfOperational" SG_ 1449 MDB5_OD_CAN2_autoErrorReset 1;
BA_ "GenSigStartValue" SG_ 1449 MDB5_OD_CAN2_autoErrorReset 1.0;
BA_ "CANzero_SDO_Default" SG_ 1449 MDB5_OD_CAN2_autoErrorReset 1;
BA_ "CANzero_SDO_Group" SG_ 1449 MDB5_OD_CAN2_lastErrorCode "CAN";
BA_ "CANzero_SDO_AccessType" SG_ 1449 MDB5_OD_CAN2_lastErrorCode 1;
BA_ "CANzero_SDO_AccessIfOperational" SG_ 1449 MDB5_OD_CAN2_lastErrorCode 1;
BA_ "CANzero_SDO_Group" SG_ 1449 MDB5_OD_CAN2_RxErrCnt "CAN";
BA_ "CANzero_SDO_AccessType" SG_ 1449 MDB5_OD_CAN2_RxErrCnt 1;
BA_ "CANzero_SDO_AccessIfOperational" SG_ 1449 MDB5_OD_CAN2_RxErrCnt 1;
BA_ "CANzero_SDO_Group" SG_ 1449 MDB5_OD_CAN2_TxErrCnt "CAN";
BA_ "CANzero_SDO_AccessType" SG_ 1449 MDB5_OD_CAN2_TxErrCnt 1;
BA_ "CANzero_SDO_AccessIfOperational" SG_ 1449 MDB5_OD_CAN2_TxErrCnt 1;
BA_ "CANzero_SDO_Group" SG_ 1449 MDB5_OD_CAN1_DelayedTxMessages "CAN";
BA_ "CANzero_SDO_AccessType" SG_ 1449 MDB5_OD_CAN1_DelayedTxMessages 1;
BA_ "CANzero_SDO_AccessIfOperational" SG_ 1449 MDB5_OD_CAN1_DelayedTxMessages 1;
BA_ "CANzero_SDO_Group" SG_ 1449 MDB5_OD_CAN1_ErrorStatus "CAN";
BA_ "CANzero_SDO_AccessType" SG_ 1449 MDB5_OD_CAN1_ErrorStatus 1;
BA_ "CANzero_SDO_AccessIfOperational" SG_ 1449 MDB5_OD_CAN1_ErrorStatus 1;
BA_ "CANzero_SDO_Group" SG_ 1449 MDB5_OD_CAN1_DiscardedTxMessages "CAN";
BA_ "CANzero_SDO_AccessType" SG_ 1449 MDB5_OD_CAN1_DiscardedTxMessages 1;
BA_ "CANzero_SDO_AccessIfOperational" SG_ 1449 MDB5_OD_CAN1_DiscardedTxMessages 1;
BA_ "CANzero_SDO_Group" SG_ 1449 MDB5_OD_CAN1_Status "CAN";
BA_ "CANzero_SDO_AccessType" SG_ 1449 MDB5_OD_CAN1_Status 1;
BA_ "CANzero_SDO_AccessIfOperational" SG_ 1449 MDB5_OD_CAN1_Status 1;
BA_ "CANzero_SDO_Group" SG_ 1449 MDB5_OD_CAN1_Baudrate "CAN";
BA_ "CANzero_SDO_AccessIfOperational" SG_ 1449 MDB5_OD_CAN1_Baudrate 1;
BA_ "GenSigStartValue" SG_ 1449 MDB5_OD_CAN1_Baudrate 1000.0;
BA_ "CANzero_SDO_Default" SG_ 1449 MDB5_OD_CAN1_Baudrate 1000;
BA_ "CANzero_SDO_Group" SG_ 1449 MDB5_OD_CAN1_autoErrorReset "CAN";
BA_ "CANzero_SDO_AccessIfOperational" SG_ 1449 MDB5_OD_CAN1_autoErrorReset 1;
BA_ "GenSigStartValue" SG_ 1449 MDB5_OD_CAN1_autoErrorReset 1.0;
BA_ "CANzero_SDO_Default" SG_ 1449 MDB5_OD_CAN1_autoErrorReset 1;
BA_ "CANzero_SDO_Group" SG_ 1449 MDB5_OD_CAN1_lastErrorCode "CAN";
BA_ "CANzero_SDO_AccessType" SG_ 1449 MDB5_OD_CAN1_lastErrorCode 1;
BA_ "CANzero_SDO_AccessIfOperational" SG_ 1449 MDB5_OD_CAN1_lastErrorCode 1;
BA_ "CANzero_SDO_Group" SG_ 1449 MDB5_OD_CAN1_RxErrCnt "CAN";
BA_ "CANzero_SDO_AccessType" SG_ 1449 MDB5_OD_CAN1_RxErrCnt 1;
BA_ "CANzero_SDO_AccessIfOperational" SG_ 1449 MDB5_OD_CAN1_RxErrCnt 1;
BA_ "CANzero_SDO_Group" SG_ 1449 MDB5_OD_CAN1_TxErrCnt "CAN";
BA_ "CANzero_SDO_AccessType" SG_ 1449 MDB5_OD_CAN1_TxErrCnt 1;
BA_ "CANzero_SDO_AccessIfOperational" SG_ 1449 MDB5_OD_CAN1_TxErrCnt 1;
BA_ "CANzero_SDO_AccessType" SG_ 1449 MDB5_OD_BuildTime 1;
BA_ "CANzero_SDO_AccessIfOperational" SG_ 1449 MDB5_OD_BuildTime 1;
BA_ "CANzero_SDO_AccessType" SG_ 1449 MDB5_OD_BuildDate 1;
BA_ "CANzero_SDO_AccessIfOperational" SG_ 1449 MDB5_OD_BuildDate 1;
BA_ "CANzero_SDO_AccessType" SG_ 1449 MDB5_OD_ChipUID2 1;
BA_ "CANzero_SDO_AccessIfOperational" SG_ 1449 MDB5_OD_ChipUID2 1;
BA_ "CANzero_SDO_AccessType" SG_ 1449 MDB5_OD_ChipUID1 1;
BA_ "CANzero_SDO_AccessIfOperational" SG_ 1449 MDB5_OD_ChipUID1 1;
BA_ "CANzero_SDO_AccessType" SG_ 1449 MDB5_OD_SdcOut 1;
BA_ "CANzero_SDO_AccessIfOperational" SG_ 1449 MDB5_OD_SdcOut 1;
BA_ "CANzero_SDO_AccessType" SG_ 1449 MDB5_OD_SdcIn 1;
BA_ "CANzero_SDO_AccessIfOperational" SG_ 1449 MDB5_OD_SdcIn 1;
BA_ "CANzero_SDO_AccessType" SG_ 1449 MDB5_OD_runtime 1;
BA_ "CANzero_SDO_AccessIfOperational" SG_ 1449 MDB5_OD_runtime 1;
BA_ "CANzero_SDO_AccessType" SG_ 1449 MDB5_OD_InputVoltage 1;
BA_ "CANzero_SDO_AccessIfOperational" SG_ 1449 MDB5_OD_InputVoltage 1;
BA_ "CANzero_SDO_AccessType" SG_ 1449 MDB5_OD_BoardTemp 1;
BA_ "CANzero_SDO_AccessIfOperational" SG_ 1449 MDB5_OD_BoardTemp 1;
BA_ "GenSigStartValue" SG_ 1449 MDB5_OD_BoardTemp 3000.0;
BA_ "CANzero_SDO_AccessType" SG_ 1449 MDB5_OD_MemFree 1;
BA_ "CANzero_SDO_AccessIfOperational" SG_ 1449 MDB5_OD_MemFree 1;
BA_ "CANzero_SDO_AccessType" SG_ 1449 MDB5_OD_CpuUsage 1;
BA_ "CANzero_SDO_AccessIfOperational" SG_ 1449 MDB5_OD_CpuUsage 1;
BA_ "CANzero_SDO_AccessIfOperational" SG_ 1449 MDB5_OD_OdEntrySendInterval 1;
BA_ "GenSigStartValue" SG_ 1449 MDB5_OD_OdEntrySendInterval 50.0;
BA_ "CANzero_SDO_Default" SG_ 1449 MDB5_OD_OdEntrySendInterval 50;
BA_ "CANzero_SDO_AccessIfOperational" SG_ 1449 MDB5_OD_SendOdOnBootup 1;
BA_ "CANzero_SDO_AccessIfOperational" SG_ 1449 MDB5_OD_HeartbeatInterval 1;
BA_ "GenSigStartValue" SG_ 1449 MDB5_OD_HeartbeatInterval 250.0;
BA_ "CANzero_SDO_Default" SG_ 1449 MDB5_OD_HeartbeatInterval 250;
BA_ "CANzero_SDO_AccessType" SG_ 1449 MDB5_OD_DbcVersion 1;
BA_ "CANzero_SDO_AccessIfOperational" SG_ 1449 MDB5_OD_DbcVersion 1;
BA_ "CANzero_SDO_AccessType" SG_ 1449 MDB5_OD_StackVersion 1;
BA_ "CANzero_SDO_AccessIfOperational" SG_ 1449 MDB5_OD_StackVersion 1;
BA_ "CANzero_SDO_AccessType" SG_ 1449 MDB5_OD_ProtocolVersion 1;
BA_ "CANzero_SDO_AccessIfOperational" SG_ 1449 MDB5_OD_ProtocolVersion 1;
BA_ "GenSigStartValue" SG_ 1449 MDB5_OD_ProtocolVersion 1.0;
BA_ "CANzero_SDO_Default" SG_ 1449 MDB5_OD_ProtocolVersion 1;
BA_ "CANzero_SDO_AccessType" SG_ 1449 MDB5_OD_NodeStatus 1;
BA_ "CANzero_SDO_AccessIfOperational" SG_ 1449 MDB5_OD_NodeStatus 1;
BA_ "CANzero_SDO_AccessType" SG_ 1449 MDB5_OD_NodeID 1;
BA_ "CANzero_SDO_AccessIfOperational" SG_ 1449 MDB5_OD_NodeID 1;
BA_ "CANzero_SDO_Group" SG_ 1513 MDB5_OD_CAN2_DelayedTxMessages "CAN";
BA_ "CANzero_SDO_AccessType" SG_ 1513 MDB5_OD_CAN2_DelayedTxMessages 1;
BA_ "CANzero_SDO_AccessIfOperational" SG_ 1513 MDB5_OD_CAN2_DelayedTxMessages 1;
BA_ "CANzero_SDO_Group" SG_ 1513 MDB5_OD_CAN2_ErrorStatus "CAN";
BA_ "CANzero_SDO_AccessType" SG_ 1513 MDB5_OD_CAN2_ErrorStatus 1;
BA_ "CANzero_SDO_AccessIfOperational" SG_ 1513 MDB5_OD_CAN2_ErrorStatus 1;
BA_ "CANzero_SDO_Group" SG_ 1513 MDB5_OD_CAN2_DiscardedTxMessages "CAN";
BA_ "CANzero_SDO_AccessType" SG_ 1513 MDB5_OD_CAN2_DiscardedTxMessages 1;
BA_ "CANzero_SDO_AccessIfOperational" SG_ 1513 MDB5_OD_CAN2_DiscardedTxMessages 1;
BA_ "CANzero_SDO_Group" SG_ 1513 MDB5_OD_CAN2_Status "CAN";
BA_ "CANzero_SDO_AccessType" SG_ 1513 MDB5_OD_CAN2_Status 1;
BA_ "CANzero_SDO_AccessIfOperational" SG_ 1513 MDB5_OD_CAN2_Status 1;
BA_ "CANzero_SDO_Group" SG_ 1513 MDB5_OD_CAN2_Baudrate "CAN";
BA_ "CANzero_SDO_AccessIfOperational" SG_ 1513 MDB5_OD_CAN2_Baudrate 1;
BA_ "GenSigStartValue" SG_ 1513 MDB5_OD_CAN2_Baudrate 1000.0;
BA_ "CANzero_SDO_Default" SG_ 1513 MDB5_OD_CAN2_Baudrate 1000;
BA_ "CANzero_SDO_Group" SG_ 1513 MDB5_OD_CAN2_autoErrorReset "CAN";
BA_ "CANzero_SDO_AccessIfOperational" SG_ 1513 MDB5_OD_CAN2_autoErrorReset 1;
BA_ "GenSigStartValue" SG_ 1513 MDB5_OD_CAN2_autoErrorReset 1.0;
BA_ "CANzero_SDO_Default" SG_ 1513 MDB5_OD_CAN2_autoErrorReset 1;
BA_ "CANzero_SDO_Group" SG_ 1513 MDB5_OD_CAN2_lastErrorCode "CAN";
BA_ "CANzero_SDO_AccessType" SG_ 1513 MDB5_OD_CAN2_lastErrorCode 1;
BA_ "CANzero_SDO_AccessIfOperational" SG_ 1513 MDB5_OD_CAN2_lastErrorCode 1;
BA_ "CANzero_SDO_Group" SG_ 1513 MDB5_OD_CAN2_RxErrCnt "CAN";
BA_ "CANzero_SDO_AccessType" SG_ 1513 MDB5_OD_CAN2_RxErrCnt 1;
BA_ "CANzero_SDO_AccessIfOperational" SG_ 1513 MDB5_OD_CAN2_RxErrCnt 1;
BA_ "CANzero_SDO_Group" SG_ 1513 MDB5_OD_CAN2_TxErrCnt "CAN";
BA_ "CANzero_SDO_AccessType" SG_ 1513 MDB5_OD_CAN2_TxErrCnt 1;
BA_ "CANzero_SDO_AccessIfOperational" SG_ 1513 MDB5_OD_CAN2_TxErrCnt 1;
BA_ "CANzero_SDO_Group" SG_ 1513 MDB5_OD_CAN1_DelayedTxMessages "CAN";
BA_ "CANzero_SDO_AccessType" SG_ 1513 MDB5_OD_CAN1_DelayedTxMessages 1;
BA_ "CANzero_SDO_AccessIfOperational" SG_ 1513 MDB5_OD_CAN1_DelayedTxMessages 1;
BA_ "CANzero_SDO_Group" SG_ 1513 MDB5_OD_CAN1_ErrorStatus "CAN";
BA_ "CANzero_SDO_AccessType" SG_ 1513 MDB5_OD_CAN1_ErrorStatus 1;
BA_ "CANzero_SDO_AccessIfOperational" SG_ 1513 MDB5_OD_CAN1_ErrorStatus 1;
BA_ "CANzero_SDO_Group" SG_ 1513 MDB5_OD_CAN1_DiscardedTxMessages "CAN";
BA_ "CANzero_SDO_AccessType" SG_ 1513 MDB5_OD_CAN1_DiscardedTxMessages 1;
BA_ "CANzero_SDO_AccessIfOperational" SG_ 1513 MDB5_OD_CAN1_DiscardedTxMessages 1;
BA_ "CANzero_SDO_Group" SG_ 1513 MDB5_OD_CAN1_Status "CAN";
BA_ "CANzero_SDO_AccessType" SG_ 1513 MDB5_OD_CAN1_Status 1;
BA_ "CANzero_SDO_AccessIfOperational" SG_ 1513 MDB5_OD_CAN1_Status 1;
BA_ "CANzero_SDO_Group" SG_ 1513 MDB5_OD_CAN1_Baudrate "CAN";
BA_ "CANzero_SDO_AccessIfOperational" SG_ 1513 MDB5_OD_CAN1_Baudrate 1;
BA_ "GenSigStartValue" SG_ 1513 MDB5_OD_CAN1_Baudrate 1000.0;
BA_ "CANzero_SDO_Default" SG_ 1513 MDB5_OD_CAN1_Baudrate 1000;
BA_ "CANzero_SDO_Group" SG_ 1513 MDB5_OD_CAN1_autoErrorReset "CAN";
BA_ "CANzero_SDO_AccessIfOperational" SG_ 1513 MDB5_OD_CAN1_autoErrorReset 1;
BA_ "GenSigStartValue" SG_ 1513 MDB5_OD_CAN1_autoErrorReset 1.0;
BA_ "CANzero_SDO_Default" SG_ 1513 MDB5_OD_CAN1_autoErrorReset 1;
BA_ "CANzero_SDO_Group" SG_ 1513 MDB5_OD_CAN1_lastErrorCode "CAN";
BA_ "CANzero_SDO_AccessType" SG_ 1513 MDB5_OD_CAN1_lastErrorCode 1;
BA_ "CANzero_SDO_AccessIfOperational" SG_ 1513 MDB5_OD_CAN1_lastErrorCode 1;
BA_ "CANzero_SDO_Group" SG_ 1513 MDB5_OD_CAN1_RxErrCnt "CAN";
BA_ "CANzero_SDO_AccessType" SG_ 1513 MDB5_OD_CAN1_RxErrCnt 1;
BA_ "CANzero_SDO_AccessIfOperational" SG_ 1513 MDB5_OD_CAN1_RxErrCnt 1;
BA_ "CANzero_SDO_Group" SG_ 1513 MDB5_OD_CAN1_TxErrCnt "CAN";
BA_ "CANzero_SDO_AccessType" SG_ 1513 MDB5_OD_CAN1_TxErrCnt 1;
BA_ "CANzero_SDO_AccessIfOperational" SG_ 1513 MDB5_OD_CAN1_TxErrCnt 1;
BA_ "CANzero_SDO_AccessType" SG_ 1513 MDB5_OD_BuildTime 1;
BA_ "CANzero_SDO_AccessIfOperational" SG_ 1513 MDB5_OD_BuildTime 1;
BA_ "CANzero_SDO_AccessType" SG_ 1513 MDB5_OD_BuildDate 1;
BA_ "CANzero_SDO_AccessIfOperational" SG_ 1513 MDB5_OD_BuildDate 1;
BA_ "CANzero_SDO_AccessType" SG_ 1513 MDB5_OD_ChipUID2 1;
BA_ "CANzero_SDO_AccessIfOperational" SG_ 1513 MDB5_OD_ChipUID2 1;
BA_ "CANzero_SDO_AccessType" SG_ 1513 MDB5_OD_ChipUID1 1;
BA_ "CANzero_SDO_AccessIfOperational" SG_ 1513 MDB5_OD_ChipUID1 1;
BA_ "CANzero_SDO_AccessType" SG_ 1513 MDB5_OD_SdcOut 1;
BA_ "CANzero_SDO_AccessIfOperational" SG_ 1513 MDB5_OD_SdcOut 1;
BA_ "CANzero_SDO_AccessType" SG_ 1513 MDB5_OD_SdcIn 1;
BA_ "CANzero_SDO_AccessIfOperational" SG_ 1513 MDB5_OD_SdcIn 1;
BA_ "CANzero_SDO_AccessType" SG_ 1513 MDB5_OD_runtime 1;
BA_ "CANzero_SDO_AccessIfOperational" SG_ 1513 MDB5_OD_runtime 1;
BA_ "CANzero_SDO_AccessType" SG_ 1513 MDB5_OD_InputVoltage 1;
BA_ "CANzero_SDO_AccessIfOperational" SG_ 1513 MDB5_OD_InputVoltage 1;
BA_ "CANzero_SDO_AccessType" SG_ 1513 MDB5_OD_BoardTemp 1;
BA_ "CANzero_SDO_AccessIfOperational" SG_ 1513 MDB5_OD_BoardTemp 1;
BA_ "GenSigStartValue" SG_ 1513 MDB5_OD_BoardTemp 3000.0;
BA_ "CANzero_SDO_AccessType" SG_ 1513 MDB5_OD_MemFree 1;
BA_ "CANzero_SDO_AccessIfOperational" SG_ 1513 MDB5_OD_MemFree 1;
BA_ "CANzero_SDO_AccessType" SG_ 1513 MDB5_OD_CpuUsage 1;
BA_ "CANzero_SDO_AccessIfOperational" SG_ 1513 MDB5_OD_CpuUsage 1;
BA_ "CANzero_SDO_AccessIfOperational" SG_ 1513 MDB5_OD_OdEntrySendInterval 1;
BA_ "GenSigStartValue" SG_ 1513 MDB5_OD_OdEntrySendInterval 50.0;
BA_ "CANzero_SDO_Default" SG_ 1513 MDB5_OD_OdEntrySendInterval 50;
BA_ "CANzero_SDO_AccessIfOperational" SG_ 1513 MDB5_OD_SendOdOnBootup 1;
BA_ "CANzero_SDO_AccessIfOperational" SG_ 1513 MDB5_OD_HeartbeatInterval 1;
BA_ "GenSigStartValue" SG_ 1513 MDB5_OD_HeartbeatInterval 250.0;
BA_ "CANzero_SDO_Default" SG_ 1513 MDB5_OD_HeartbeatInterval 250;
BA_ "CANzero_SDO_AccessType" SG_ 1513 MDB5_OD_DbcVersion 1;
BA_ "CANzero_SDO_AccessIfOperational" SG_ 1513 MDB5_OD_DbcVersion 1;
BA_ "CANzero_SDO_AccessType" SG_ 1513 MDB5_OD_StackVersion 1;
BA_ "CANzero_SDO_AccessIfOperational" SG_ 1513 MDB5_OD_StackVersion 1;
BA_ "CANzero_SDO_AccessType" SG_ 1513 MDB5_OD_ProtocolVersion 1;
BA_ "CANzero_SDO_AccessIfOperational" SG_ 1513 MDB5_OD_ProtocolVersion 1;
BA_ "GenSigStartValue" SG_ 1513 MDB5_OD_ProtocolVersion 1.0;
BA_ "CANzero_SDO_Default" SG_ 1513 MDB5_OD_ProtocolVersion 1;
BA_ "CANzero_SDO_AccessType" SG_ 1513 MDB5_OD_NodeStatus 1;
BA_ "CANzero_SDO_AccessIfOperational" SG_ 1513 MDB5_OD_NodeStatus 1;
BA_ "CANzero_SDO_AccessType" SG_ 1513 MDB5_OD_NodeID 1;
BA_ "CANzero_SDO_AccessIfOperational" SG_ 1513 MDB5_OD_NodeID 1;
BA_ "CANzero_SDO_Group" SG_ 1457 MDB6_OD_CAN2_DelayedTxMessages "CAN";
BA_ "CANzero_SDO_AccessType" SG_ 1457 MDB6_OD_CAN2_DelayedTxMessages 1;
BA_ "CANzero_SDO_AccessIfOperational" SG_ 1457 MDB6_OD_CAN2_DelayedTxMessages 1;
BA_ "CANzero_SDO_Group" SG_ 1457 MDB6_OD_CAN2_ErrorStatus "CAN";
BA_ "CANzero_SDO_AccessType" SG_ 1457 MDB6_OD_CAN2_ErrorStatus 1;
BA_ "CANzero_SDO_AccessIfOperational" SG_ 1457 MDB6_OD_CAN2_ErrorStatus 1;
BA_ "CANzero_SDO_Group" SG_ 1457 MDB6_OD_CAN2_DiscardedTxMessages "CAN";
BA_ "CANzero_SDO_AccessType" SG_ 1457 MDB6_OD_CAN2_DiscardedTxMessages 1;
BA_ "CANzero_SDO_AccessIfOperational" SG_ 1457 MDB6_OD_CAN2_DiscardedTxMessages 1;
BA_ "CANzero_SDO_Group" SG_ 1457 MDB6_OD_CAN2_Status "CAN";
BA_ "CANzero_SDO_AccessType" SG_ 1457 MDB6_OD_CAN2_Status 1;
BA_ "CANzero_SDO_AccessIfOperational" SG_ 1457 MDB6_OD_CAN2_Status 1;
BA_ "CANzero_SDO_Group" SG_ 1457 MDB6_OD_CAN2_Baudrate "CAN";
BA_ "CANzero_SDO_AccessIfOperational" SG_ 1457 MDB6_OD_CAN2_Baudrate 1;
BA_ "GenSigStartValue" SG_ 1457 MDB6_OD_CAN2_Baudrate 1000.0;
BA_ "CANzero_SDO_Default" SG_ 1457 MDB6_OD_CAN2_Baudrate 1000;
BA_ "CANzero_SDO_Group" SG_ 1457 MDB6_OD_CAN2_autoErrorReset "CAN";
BA_ "CANzero_SDO_AccessIfOperational" SG_ 1457 MDB6_OD_CAN2_autoErrorReset 1;
BA_ "GenSigStartValue" SG_ 1457 MDB6_OD_CAN2_autoErrorReset 1.0;
BA_ "CANzero_SDO_Default" SG_ 1457 MDB6_OD_CAN2_autoErrorReset 1;
BA_ "CANzero_SDO_Group" SG_ 1457 MDB6_OD_CAN2_lastErrorCode "CAN";
BA_ "CANzero_SDO_AccessType" SG_ 1457 MDB6_OD_CAN2_lastErrorCode 1;
BA_ "CANzero_SDO_AccessIfOperational" SG_ 1457 MDB6_OD_CAN2_lastErrorCode 1;
BA_ "CANzero_SDO_Group" SG_ 1457 MDB6_OD_CAN2_RxErrCnt "CAN";
BA_ "CANzero_SDO_AccessType" SG_ 1457 MDB6_OD_CAN2_RxErrCnt 1;
BA_ "CANzero_SDO_AccessIfOperational" SG_ 1457 MDB6_OD_CAN2_RxErrCnt 1;
BA_ "CANzero_SDO_Group" SG_ 1457 MDB6_OD_CAN2_TxErrCnt "CAN";
BA_ "CANzero_SDO_AccessType" SG_ 1457 MDB6_OD_CAN2_TxErrCnt 1;
BA_ "CANzero_SDO_AccessIfOperational" SG_ 1457 MDB6_OD_CAN2_TxErrCnt 1;
BA_ "CANzero_SDO_Group" SG_ 1457 MDB6_OD_CAN1_DelayedTxMessages "CAN";
BA_ "CANzero_SDO_AccessType" SG_ 1457 MDB6_OD_CAN1_DelayedTxMessages 1;
BA_ "CANzero_SDO_AccessIfOperational" SG_ 1457 MDB6_OD_CAN1_DelayedTxMessages 1;
BA_ "CANzero_SDO_Group" SG_ 1457 MDB6_OD_CAN1_ErrorStatus "CAN";
BA_ "CANzero_SDO_AccessType" SG_ 1457 MDB6_OD_CAN1_ErrorStatus 1;
BA_ "CANzero_SDO_AccessIfOperational" SG_ 1457 MDB6_OD_CAN1_ErrorStatus 1;
BA_ "CANzero_SDO_Group" SG_ 1457 MDB6_OD_CAN1_DiscardedTxMessages "CAN";
BA_ "CANzero_SDO_AccessType" SG_ 1457 MDB6_OD_CAN1_DiscardedTxMessages 1;
BA_ "CANzero_SDO_AccessIfOperational" SG_ 1457 MDB6_OD_CAN1_DiscardedTxMessages 1;
BA_ "CANzero_SDO_Group" SG_ 1457 MDB6_OD_CAN1_Status "CAN";
BA_ "CANzero_SDO_AccessType" SG_ 1457 MDB6_OD_CAN1_Status 1;
BA_ "CANzero_SDO_AccessIfOperational" SG_ 1457 MDB6_OD_CAN1_Status 1;
BA_ "CANzero_SDO_Group" SG_ 1457 MDB6_OD_CAN1_Baudrate "CAN";
BA_ "CANzero_SDO_AccessIfOperational" SG_ 1457 MDB6_OD_CAN1_Baudrate 1;
BA_ "GenSigStartValue" SG_ 1457 MDB6_OD_CAN1_Baudrate 1000.0;
BA_ "CANzero_SDO_Default" SG_ 1457 MDB6_OD_CAN1_Baudrate 1000;
BA_ "CANzero_SDO_Group" SG_ 1457 MDB6_OD_CAN1_autoErrorReset "CAN";
BA_ "CANzero_SDO_AccessIfOperational" SG_ 1457 MDB6_OD_CAN1_autoErrorReset 1;
BA_ "GenSigStartValue" SG_ 1457 MDB6_OD_CAN1_autoErrorReset 1.0;
BA_ "CANzero_SDO_Default" SG_ 1457 MDB6_OD_CAN1_autoErrorReset 1;
BA_ "CANzero_SDO_Group" SG_ 1457 MDB6_OD_CAN1_lastErrorCode "CAN";
BA_ "CANzero_SDO_AccessType" SG_ 1457 MDB6_OD_CAN1_lastErrorCode 1;
BA_ "CANzero_SDO_AccessIfOperational" SG_ 1457 MDB6_OD_CAN1_lastErrorCode 1;
BA_ "CANzero_SDO_Group" SG_ 1457 MDB6_OD_CAN1_RxErrCnt "CAN";
BA_ "CANzero_SDO_AccessType" SG_ 1457 MDB6_OD_CAN1_RxErrCnt 1;
BA_ "CANzero_SDO_AccessIfOperational" SG_ 1457 MDB6_OD_CAN1_RxErrCnt 1;
BA_ "CANzero_SDO_Group" SG_ 1457 MDB6_OD_CAN1_TxErrCnt "CAN";
BA_ "CANzero_SDO_AccessType" SG_ 1457 MDB6_OD_CAN1_TxErrCnt 1;
BA_ "CANzero_SDO_AccessIfOperational" SG_ 1457 MDB6_OD_CAN1_TxErrCnt 1;
BA_ "CANzero_SDO_AccessType" SG_ 1457 MDB6_OD_BuildTime 1;
BA_ "CANzero_SDO_AccessIfOperational" SG_ 1457 MDB6_OD_BuildTime 1;
BA_ "CANzero_SDO_AccessType" SG_ 1457 MDB6_OD_BuildDate 1;
BA_ "CANzero_SDO_AccessIfOperational" SG_ 1457 MDB6_OD_BuildDate 1;
BA_ "CANzero_SDO_AccessType" SG_ 1457 MDB6_OD_ChipUID2 1;
BA_ "CANzero_SDO_AccessIfOperational" SG_ 1457 MDB6_OD_ChipUID2 1;
BA_ "CANzero_SDO_AccessType" SG_ 1457 MDB6_OD_ChipUID1 1;
BA_ "CANzero_SDO_AccessIfOperational" SG_ 1457 MDB6_OD_ChipUID1 1;
BA_ "CANzero_SDO_AccessType" SG_ 1457 MDB6_OD_SdcOut 1;
BA_ "CANzero_SDO_AccessIfOperational" SG_ 1457 MDB6_OD_SdcOut 1;
BA_ "CANzero_SDO_AccessType" SG_ 1457 MDB6_OD_SdcIn 1;
BA_ "CANzero_SDO_AccessIfOperational" SG_ 1457 MDB6_OD_SdcIn 1;
BA_ "CANzero_SDO_AccessType" SG_ 1457 MDB6_OD_runtime 1;
BA_ "CANzero_SDO_AccessIfOperational" SG_ 1457 MDB6_OD_runtime 1;
BA_ "CANzero_SDO_AccessType" SG_ 1457 MDB6_OD_InputVoltage 1;
BA_ "CANzero_SDO_AccessIfOperational" SG_ 1457 MDB6_OD_InputVoltage 1;
BA_ "CANzero_SDO_AccessType" SG_ 1457 MDB6_OD_BoardTemp 1;
BA_ "CANzero_SDO_AccessIfOperational" SG_ 1457 MDB6_OD_BoardTemp 1;
BA_ "GenSigStartValue" SG_ 1457 MDB6_OD_BoardTemp 3000.0;
BA_ "CANzero_SDO_AccessType" SG_ 1457 MDB6_OD_MemFree 1;
BA_ "CANzero_SDO_AccessIfOperational" SG_ 1457 MDB6_OD_MemFree 1;
BA_ "CANzero_SDO_AccessType" SG_ 1457 MDB6_OD_CpuUsage 1;
BA_ "CANzero_SDO_AccessIfOperational" SG_ 1457 MDB6_OD_CpuUsage 1;
BA_ "CANzero_SDO_AccessIfOperational" SG_ 1457 MDB6_OD_OdEntrySendInterval 1;
BA_ "GenSigStartValue" SG_ 1457 MDB6_OD_OdEntrySendInterval 50.0;
BA_ "CANzero_SDO_Default" SG_ 1457 MDB6_OD_OdEntrySendInterval 50;
BA_ "CANzero_SDO_AccessIfOperational" SG_ 1457 MDB6_OD_SendOdOnBootup 1;
BA_ "CANzero_SDO_AccessIfOperational" SG_ 1457 MDB6_OD_HeartbeatInterval 1;
BA_ "GenSigStartValue" SG_ 1457 MDB6_OD_HeartbeatInterval 250.0;
BA_ "CANzero_SDO_Default" SG_ 1457 MDB6_OD_HeartbeatInterval 250;
BA_ "CANzero_SDO_AccessType" SG_ 1457 MDB6_OD_DbcVersion 1;
BA_ "CANzero_SDO_AccessIfOperational" SG_ 1457 MDB6_OD_DbcVersion 1;
BA_ "CANzero_SDO_AccessType" SG_ 1457 MDB6_OD_StackVersion 1;
BA_ "CANzero_SDO_AccessIfOperational" SG_ 1457 MDB6_OD_StackVersion 1;
BA_ "CANzero_SDO_AccessType" SG_ 1457 MDB6_OD_ProtocolVersion 1;
BA_ "CANzero_SDO_AccessIfOperational" SG_ 1457 MDB6_OD_ProtocolVersion 1;
BA_ "GenSigStartValue" SG_ 1457 MDB6_OD_ProtocolVersion 1.0;
BA_ "CANzero_SDO_Default" SG_ 1457 MDB6_OD_ProtocolVersion 1;
BA_ "CANzero_SDO_AccessType" SG_ 1457 MDB6_OD_NodeStatus 1;
BA_ "CANzero_SDO_AccessIfOperational" SG_ 1457 MDB6_OD_NodeStatus 1;
BA_ "CANzero_SDO_AccessType" SG_ 1457 MDB6_OD_NodeID 1;
BA_ "CANzero_SDO_AccessIfOperational" SG_ 1457 MDB6_OD_NodeID 1;
BA_ "CANzero_SDO_Group" SG_ 1521 MDB6_OD_CAN2_DelayedTxMessages "CAN";
BA_ "CANzero_SDO_AccessType" SG_ 1521 MDB6_OD_CAN2_DelayedTxMessages 1;
BA_ "CANzero_SDO_AccessIfOperational" SG_ 1521 MDB6_OD_CAN2_DelayedTxMessages 1;
BA_ "CANzero_SDO_Group" SG_ 1521 MDB6_OD_CAN2_ErrorStatus "CAN";
BA_ "CANzero_SDO_AccessType" SG_ 1521 MDB6_OD_CAN2_ErrorStatus 1;
BA_ "CANzero_SDO_AccessIfOperational" SG_ 1521 MDB6_OD_CAN2_ErrorStatus 1;
BA_ "CANzero_SDO_Group" SG_ 1521 MDB6_OD_CAN2_DiscardedTxMessages "CAN";
BA_ "CANzero_SDO_AccessType" SG_ 1521 MDB6_OD_CAN2_DiscardedTxMessages 1;
BA_ "CANzero_SDO_AccessIfOperational" SG_ 1521 MDB6_OD_CAN2_DiscardedTxMessages 1;
BA_ "CANzero_SDO_Group" SG_ 1521 MDB6_OD_CAN2_Status "CAN";
BA_ "CANzero_SDO_AccessType" SG_ 1521 MDB6_OD_CAN2_Status 1;
BA_ "CANzero_SDO_AccessIfOperational" SG_ 1521 MDB6_OD_CAN2_Status 1;
BA_ "CANzero_SDO_Group" SG_ 1521 MDB6_OD_CAN2_Baudrate "CAN";
BA_ "CANzero_SDO_AccessIfOperational" SG_ 1521 MDB6_OD_CAN2_Baudrate 1;
BA_ "GenSigStartValue" SG_ 1521 MDB6_OD_CAN2_Baudrate 1000.0;
BA_ "CANzero_SDO_Default" SG_ 1521 MDB6_OD_CAN2_Baudrate 1000;
BA_ "CANzero_SDO_Group" SG_ 1521 MDB6_OD_CAN2_autoErrorReset "CAN";
BA_ "CANzero_SDO_AccessIfOperational" SG_ 1521 MDB6_OD_CAN2_autoErrorReset 1;
BA_ "GenSigStartValue" SG_ 1521 MDB6_OD_CAN2_autoErrorReset 1.0;
BA_ "CANzero_SDO_Default" SG_ 1521 MDB6_OD_CAN2_autoErrorReset 1;
BA_ "CANzero_SDO_Group" SG_ 1521 MDB6_OD_CAN2_lastErrorCode "CAN";
BA_ "CANzero_SDO_AccessType" SG_ 1521 MDB6_OD_CAN2_lastErrorCode 1;
BA_ "CANzero_SDO_AccessIfOperational" SG_ 1521 MDB6_OD_CAN2_lastErrorCode 1;
BA_ "CANzero_SDO_Group" SG_ 1521 MDB6_OD_CAN2_RxErrCnt "CAN";
BA_ "CANzero_SDO_AccessType" SG_ 1521 MDB6_OD_CAN2_RxErrCnt 1;
BA_ "CANzero_SDO_AccessIfOperational" SG_ 1521 MDB6_OD_CAN2_RxErrCnt 1;
BA_ "CANzero_SDO_Group" SG_ 1521 MDB6_OD_CAN2_TxErrCnt "CAN";
BA_ "CANzero_SDO_AccessType" SG_ 1521 MDB6_OD_CAN2_TxErrCnt 1;
BA_ "CANzero_SDO_AccessIfOperational" SG_ 1521 MDB6_OD_CAN2_TxErrCnt 1;
BA_ "CANzero_SDO_Group" SG_ 1521 MDB6_OD_CAN1_DelayedTxMessages "CAN";
BA_ "CANzero_SDO_AccessType" SG_ 1521 MDB6_OD_CAN1_DelayedTxMessages 1;
BA_ "CANzero_SDO_AccessIfOperational" SG_ 1521 MDB6_OD_CAN1_DelayedTxMessages 1;
BA_ "CANzero_SDO_Group" SG_ 1521 MDB6_OD_CAN1_ErrorStatus "CAN";
BA_ "CANzero_SDO_AccessType" SG_ 1521 MDB6_OD_CAN1_ErrorStatus 1;
BA_ "CANzero_SDO_AccessIfOperational" SG_ 1521 MDB6_OD_CAN1_ErrorStatus 1;
BA_ "CANzero_SDO_Group" SG_ 1521 MDB6_OD_CAN1_DiscardedTxMessages "CAN";
BA_ "CANzero_SDO_AccessType" SG_ 1521 MDB6_OD_CAN1_DiscardedTxMessages 1;
BA_ "CANzero_SDO_AccessIfOperational" SG_ 1521 MDB6_OD_CAN1_DiscardedTxMessages 1;
BA_ "CANzero_SDO_Group" SG_ 1521 MDB6_OD_CAN1_Status "CAN";
BA_ "CANzero_SDO_AccessType" SG_ 1521 MDB6_OD_CAN1_Status 1;
BA_ "CANzero_SDO_AccessIfOperational" SG_ 1521 MDB6_OD_CAN1_Status 1;
BA_ "CANzero_SDO_Group" SG_ 1521 MDB6_OD_CAN1_Baudrate "CAN";
BA_ "CANzero_SDO_AccessIfOperational" SG_ 1521 MDB6_OD_CAN1_Baudrate 1;
BA_ "GenSigStartValue" SG_ 1521 MDB6_OD_CAN1_Baudrate 1000.0;
BA_ "CANzero_SDO_Default" SG_ 1521 MDB6_OD_CAN1_Baudrate 1000;
BA_ "CANzero_SDO_Group" SG_ 1521 MDB6_OD_CAN1_autoErrorReset "CAN";
BA_ "CANzero_SDO_AccessIfOperational" SG_ 1521 MDB6_OD_CAN1_autoErrorReset 1;
BA_ "GenSigStartValue" SG_ 1521 MDB6_OD_CAN1_autoErrorReset 1.0;
BA_ "CANzero_SDO_Default" SG_ 1521 MDB6_OD_CAN1_autoErrorReset 1;
BA_ "CANzero_SDO_Group" SG_ 1521 MDB6_OD_CAN1_lastErrorCode "CAN";
BA_ "CANzero_SDO_AccessType" SG_ 1521 MDB6_OD_CAN1_lastErrorCode 1;
BA_ "CANzero_SDO_AccessIfOperational" SG_ 1521 MDB6_OD_CAN1_lastErrorCode 1;
BA_ "CANzero_SDO_Group" SG_ 1521 MDB6_OD_CAN1_RxErrCnt "CAN";
BA_ "CANzero_SDO_AccessType" SG_ 1521 MDB6_OD_CAN1_RxErrCnt 1;
BA_ "CANzero_SDO_AccessIfOperational" SG_ 1521 MDB6_OD_CAN1_RxErrCnt 1;
BA_ "CANzero_SDO_Group" SG_ 1521 MDB6_OD_CAN1_TxErrCnt "CAN";
BA_ "CANzero_SDO_AccessType" SG_ 1521 MDB6_OD_CAN1_TxErrCnt 1;
BA_ "CANzero_SDO_AccessIfOperational" SG_ 1521 MDB6_OD_CAN1_TxErrCnt 1;
BA_ "CANzero_SDO_AccessType" SG_ 1521 MDB6_OD_BuildTime 1;
BA_ "CANzero_SDO_AccessIfOperational" SG_ 1521 MDB6_OD_BuildTime 1;
BA_ "CANzero_SDO_AccessType" SG_ 1521 MDB6_OD_BuildDate 1;
BA_ "CANzero_SDO_AccessIfOperational" SG_ 1521 MDB6_OD_BuildDate 1;
BA_ "CANzero_SDO_AccessType" SG_ 1521 MDB6_OD_ChipUID2 1;
BA_ "CANzero_SDO_AccessIfOperational" SG_ 1521 MDB6_OD_ChipUID2 1;
BA_ "CANzero_SDO_AccessType" SG_ 1521 MDB6_OD_ChipUID1 1;
BA_ "CANzero_SDO_AccessIfOperational" SG_ 1521 MDB6_OD_ChipUID1 1;
BA_ "CANzero_SDO_AccessType" SG_ 1521 MDB6_OD_SdcOut 1;
BA_ "CANzero_SDO_AccessIfOperational" SG_ 1521 MDB6_OD_SdcOut 1;
BA_ "CANzero_SDO_AccessType" SG_ 1521 MDB6_OD_SdcIn 1;
BA_ "CANzero_SDO_AccessIfOperational" SG_ 1521 MDB6_OD_SdcIn 1;
BA_ "CANzero_SDO_AccessType" SG_ 1521 MDB6_OD_runtime 1;
BA_ "CANzero_SDO_AccessIfOperational" SG_ 1521 MDB6_OD_runtime 1;
BA_ "CANzero_SDO_AccessType" SG_ 1521 MDB6_OD_InputVoltage 1;
BA_ "CANzero_SDO_AccessIfOperational" SG_ 1521 MDB6_OD_InputVoltage 1;
BA_ "CANzero_SDO_AccessType" SG_ 1521 MDB6_OD_BoardTemp 1;
BA_ "CANzero_SDO_AccessIfOperational" SG_ 1521 MDB6_OD_BoardTemp 1;
BA_ "GenSigStartValue" SG_ 1521 MDB6_OD_BoardTemp 3000.0;
BA_ "CANzero_SDO_AccessType" SG_ 1521 MDB6_OD_MemFree 1;
BA_ "CANzero_SDO_AccessIfOperational" SG_ 1521 MDB6_OD_MemFree 1;
BA_ "CANzero_SDO_AccessType" SG_ 1521 MDB6_OD_CpuUsage 1;
BA_ "CANzero_SDO_AccessIfOperational" SG_ 1521 MDB6_OD_CpuUsage 1;
BA_ "CANzero_SDO_AccessIfOperational" SG_ 1521 MDB6_OD_OdEntrySendInterval 1;
BA_ "GenSigStartValue" SG_ 1521 MDB6_OD_OdEntrySendInterval 50.0;
BA_ "CANzero_SDO_Default" SG_ 1521 MDB6_OD_OdEntrySendInterval 50;
BA_ "CANzero_SDO_AccessIfOperational" SG_ 1521 MDB6_OD_SendOdOnBootup 1;
BA_ "CANzero_SDO_AccessIfOperational" SG_ 1521 MDB6_OD_HeartbeatInterval 1;
BA_ "GenSigStartValue" SG_ 1521 MDB6_OD_HeartbeatInterval 250.0;
BA_ "CANzero_SDO_Default" SG_ 1521 MDB6_OD_HeartbeatInterval 250;
BA_ "CANzero_SDO_AccessType" SG_ 1521 MDB6_OD_DbcVersion 1;
BA_ "CANzero_SDO_AccessIfOperational" SG_ 1521 MDB6_OD_DbcVersion 1;
BA_ "CANzero_SDO_AccessType" SG_ 1521 MDB6_OD_StackVersion 1;
BA_ "CANzero_SDO_AccessIfOperational" SG_ 1521 MDB6_OD_StackVersion 1;
BA_ "CANzero_SDO_AccessType" SG_ 1521 MDB6_OD_ProtocolVersion 1;
BA_ "CANzero_SDO_AccessIfOperational" SG_ 1521 MDB6_OD_ProtocolVersion 1;
BA_ "GenSigStartValue" SG_ 1521 MDB6_OD_ProtocolVersion 1.0;
BA_ "CANzero_SDO_Default" SG_ 1521 MDB6_OD_ProtocolVersion 1;
BA_ "CANzero_SDO_AccessType" SG_ 1521 MDB6_OD_NodeStatus 1;
BA_ "CANzero_SDO_AccessIfOperational" SG_ 1521 MDB6_OD_NodeStatus 1;
BA_ "CANzero_SDO_AccessType" SG_ 1521 MDB6_OD_NodeID 1;
BA_ "CANzero_SDO_AccessIfOperational" SG_ 1521 MDB6_OD_NodeID 1;
BA_ "CANzero_SDO_AccessType" SG_ 1458 Track_OD_PropulsionDistance 1;
BA_ "CANzero_SDO_AccessIfOperational" SG_ 1458 Track_OD_PropulsionDistance 1;
BA_ "GenSigStartValue" SG_ 1458 Track_OD_PropulsionDistance 9810.0;
BA_ "CANzero_SDO_Default" SG_ 1458 Track_OD_PropulsionDistance -1.9;
BA_ "CANzero_SDO_AccessType" SG_ 1458 Track_OD_PropulsionPressure 1;
BA_ "CANzero_SDO_AccessIfOperational" SG_ 1458 Track_OD_PropulsionPressure 1;
BA_ "GenSigStartValue" SG_ 1458 Track_OD_PropulsionPressure 9810.0;
BA_ "CANzero_SDO_Default" SG_ 1458 Track_OD_PropulsionPressure -1.9;
BA_ "CANzero_SDO_AccessType" SG_ 1458 Track_OD_PistonStatus 1;
BA_ "CANzero_SDO_AccessIfOperational" SG_ 1458 Track_OD_PistonStatus 1;
BA_ "CANzero_SDO_Group" SG_ 1458 Track_OD_CAN2_DelayedTxMessages "CAN";
BA_ "CANzero_SDO_AccessType" SG_ 1458 Track_OD_CAN2_DelayedTxMessages 1;
BA_ "CANzero_SDO_AccessIfOperational" SG_ 1458 Track_OD_CAN2_DelayedTxMessages 1;
BA_ "CANzero_SDO_Group" SG_ 1458 Track_OD_CAN2_ErrorStatus "CAN";
BA_ "CANzero_SDO_AccessType" SG_ 1458 Track_OD_CAN2_ErrorStatus 1;
BA_ "CANzero_SDO_AccessIfOperational" SG_ 1458 Track_OD_CAN2_ErrorStatus 1;
BA_ "CANzero_SDO_Group" SG_ 1458 Track_OD_CAN2_DiscardedTxMessage "CAN";
BA_ "CANzero_SDO_AccessType" SG_ 1458 Track_OD_CAN2_DiscardedTxMessage 1;
BA_ "CANzero_SDO_AccessIfOperational" SG_ 1458 Track_OD_CAN2_DiscardedTxMessage 1;
BA_ "SystemSignalLongSymbol" SG_ 1458 Track_OD_CAN2_DiscardedTxMessage "Track_OD_CAN2_DiscardedTxMessages";
BA_ "CANzero_SDO_Group" SG_ 1458 Track_OD_CAN2_Status "CAN";
BA_ "CANzero_SDO_AccessType" SG_ 1458 Track_OD_CAN2_Status 1;
BA_ "CANzero_SDO_AccessIfOperational" SG_ 1458 Track_OD_CAN2_Status 1;
BA_ "CANzero_SDO_Group" SG_ 1458 Track_OD_CAN2_Baudrate "CAN";
BA_ "CANzero_SDO_AccessIfOperational" SG_ 1458 Track_OD_CAN2_Baudrate 1;
BA_ "GenSigStartValue" SG_ 1458 Track_OD_CAN2_Baudrate 1000.0;
BA_ "CANzero_SDO_Default" SG_ 1458 Track_OD_CAN2_Baudrate 1000;
BA_ "CANzero_SDO_Group" SG_ 1458 Track_OD_CAN2_autoErrorReset "CAN";
BA_ "CANzero_SDO_AccessIfOperational" SG_ 1458 Track_OD_CAN2_autoErrorReset 1;
BA_ "GenSigStartValue" SG_ 1458 Track_OD_CAN2_autoErrorReset 1.0;
BA_ "CANzero_SDO_Default" SG_ 1458 Track_OD_CAN2_autoErrorReset 1;
BA_ "CANzero_SDO_Group" SG_ 1458 Track_OD_CAN2_lastErrorCode "CAN";
BA_ "CANzero_SDO_AccessType" SG_ 1458 Track_OD_CAN2_lastErrorCode 1;
BA_ "CANzero_SDO_AccessIfOperational" SG_ 1458 Track_OD_CAN2_lastErrorCode 1;
BA_ "CANzero_SDO_Group" SG_ 1458 Track_OD_CAN2_RxErrCnt "CAN";
BA_ "CANzero_SDO_AccessType" SG_ 1458 Track_OD_CAN2_RxErrCnt 1;
BA_ "CANzero_SDO_AccessIfOperational" SG_ 1458 Track_OD_CAN2_RxErrCnt 1;
BA_ "CANzero_SDO_Group" SG_ 1458 Track_OD_CAN2_TxErrCnt "CAN";
BA_ "CANzero_SDO_AccessType" SG_ 1458 Track_OD_CAN2_TxErrCnt 1;
BA_ "CANzero_SDO_AccessIfOperational" SG_ 1458 Track_OD_CAN2_TxErrCnt 1;
BA_ "CANzero_SDO_Group" SG_ 1458 Track_OD_CAN1_DelayedTxMessages "CAN";
BA_ "CANzero_SDO_AccessType" SG_ 1458 Track_OD_CAN1_DelayedTxMessages 1;
BA_ "CANzero_SDO_AccessIfOperational" SG_ 1458 Track_OD_CAN1_DelayedTxMessages 1;
BA_ "CANzero_SDO_Group" SG_ 1458 Track_OD_CAN1_ErrorStatus "CAN";
BA_ "CANzero_SDO_AccessType" SG_ 1458 Track_OD_CAN1_ErrorStatus 1;
BA_ "CANzero_SDO_AccessIfOperational" SG_ 1458 Track_OD_CAN1_ErrorStatus 1;
BA_ "CANzero_SDO_Group" SG_ 1458 Track_OD_CAN1_DiscardedTxMessage "CAN";
BA_ "CANzero_SDO_AccessType" SG_ 1458 Track_OD_CAN1_DiscardedTxMessage 1;
BA_ "CANzero_SDO_AccessIfOperational" SG_ 1458 Track_OD_CAN1_DiscardedTxMessage 1;
BA_ "SystemSignalLongSymbol" SG_ 1458 Track_OD_CAN1_DiscardedTxMessage "Track_OD_CAN1_DiscardedTxMessages";
BA_ "CANzero_SDO_Group" SG_ 1458 Track_OD_CAN1_Status "CAN";
BA_ "CANzero_SDO_AccessType" SG_ 1458 Track_OD_CAN1_Status 1;
BA_ "CANzero_SDO_AccessIfOperational" SG_ 1458 Track_OD_CAN1_Status 1;
BA_ "CANzero_SDO_Group" SG_ 1458 Track_OD_CAN1_Baudrate "CAN";
BA_ "CANzero_SDO_AccessIfOperational" SG_ 1458 Track_OD_CAN1_Baudrate 1;
BA_ "GenSigStartValue" SG_ 1458 Track_OD_CAN1_Baudrate 1000.0;
BA_ "CANzero_SDO_Default" SG_ 1458 Track_OD_CAN1_Baudrate 1000;
BA_ "CANzero_SDO_Group" SG_ 1458 Track_OD_CAN1_autoErrorReset "CAN";
BA_ "CANzero_SDO_AccessIfOperational" SG_ 1458 Track_OD_CAN1_autoErrorReset 1;
BA_ "GenSigStartValue" SG_ 1458 Track_OD_CAN1_autoErrorReset 1.0;
BA_ "CANzero_SDO_Default" SG_ 1458 Track_OD_CAN1_autoErrorReset 1;
BA_ "CANzero_SDO_Group" SG_ 1458 Track_OD_CAN1_lastErrorCode "CAN";
BA_ "CANzero_SDO_AccessType" SG_ 1458 Track_OD_CAN1_lastErrorCode 1;
BA_ "CANzero_SDO_AccessIfOperational" SG_ 1458 Track_OD_CAN1_lastErrorCode 1;
BA_ "CANzero_SDO_Group" SG_ 1458 Track_OD_CAN1_RxErrCnt "CAN";
BA_ "CANzero_SDO_AccessType" SG_ 1458 Track_OD_CAN1_RxErrCnt 1;
BA_ "CANzero_SDO_AccessIfOperational" SG_ 1458 Track_OD_CAN1_RxErrCnt 1;
BA_ "CANzero_SDO_Group" SG_ 1458 Track_OD_CAN1_TxErrCnt "CAN";
BA_ "CANzero_SDO_AccessType" SG_ 1458 Track_OD_CAN1_TxErrCnt 1;
BA_ "CANzero_SDO_AccessIfOperational" SG_ 1458 Track_OD_CAN1_TxErrCnt 1;
BA_ "CANzero_SDO_AccessType" SG_ 1458 Track_OD_BuildTime 1;
BA_ "CANzero_SDO_AccessIfOperational" SG_ 1458 Track_OD_BuildTime 1;
BA_ "CANzero_SDO_AccessType" SG_ 1458 Track_OD_BuildDate 1;
BA_ "CANzero_SDO_AccessIfOperational" SG_ 1458 Track_OD_BuildDate 1;
BA_ "CANzero_SDO_AccessType" SG_ 1458 Track_OD_ChipUID2 1;
BA_ "CANzero_SDO_AccessIfOperational" SG_ 1458 Track_OD_ChipUID2 1;
BA_ "CANzero_SDO_AccessType" SG_ 1458 Track_OD_ChipUID1 1;
BA_ "CANzero_SDO_AccessIfOperational" SG_ 1458 Track_OD_ChipUID1 1;
BA_ "CANzero_SDO_AccessType" SG_ 1458 Track_OD_SdcOut 1;
BA_ "CANzero_SDO_AccessIfOperational" SG_ 1458 Track_OD_SdcOut 1;
BA_ "CANzero_SDO_AccessType" SG_ 1458 Track_OD_SdcIn 1;
BA_ "CANzero_SDO_AccessIfOperational" SG_ 1458 Track_OD_SdcIn 1;
BA_ "CANzero_SDO_AccessType" SG_ 1458 Track_OD_runtime 1;
BA_ "CANzero_SDO_AccessIfOperational" SG_ 1458 Track_OD_runtime 1;
BA_ "CANzero_SDO_AccessType" SG_ 1458 Track_OD_InputVoltage 1;
BA_ "CANzero_SDO_AccessIfOperational" SG_ 1458 Track_OD_InputVoltage 1;
BA_ "CANzero_SDO_AccessType" SG_ 1458 Track_OD_BoardTemp 1;
BA_ "CANzero_SDO_AccessIfOperational" SG_ 1458 Track_OD_BoardTemp 1;
BA_ "GenSigStartValue" SG_ 1458 Track_OD_BoardTemp 3000.0;
BA_ "CANzero_SDO_AccessType" SG_ 1458 Track_OD_MemFree 1;
BA_ "CANzero_SDO_AccessIfOperational" SG_ 1458 Track_OD_MemFree 1;
BA_ "CANzero_SDO_AccessType" SG_ 1458 Track_OD_CpuUsage 1;
BA_ "CANzero_SDO_AccessIfOperational" SG_ 1458 Track_OD_CpuUsage 1;
BA_ "CANzero_SDO_AccessIfOperational" SG_ 1458 Track_OD_OdEntrySendInterval 1;
BA_ "GenSigStartValue" SG_ 1458 Track_OD_OdEntrySendInterval 50.0;
BA_ "CANzero_SDO_Default" SG_ 1458 Track_OD_OdEntrySendInterval 50;
BA_ "CANzero_SDO_AccessIfOperational" SG_ 1458 Track_OD_SendOdOnBootup 1;
BA_ "CANzero_SDO_AccessIfOperational" SG_ 1458 Track_OD_HeartbeatInterval 1;
BA_ "GenSigStartValue" SG_ 1458 Track_OD_HeartbeatInterval 250.0;
BA_ "CANzero_SDO_Default" SG_ 1458 Track_OD_HeartbeatInterval 250;
BA_ "CANzero_SDO_AccessType" SG_ 1458 Track_OD_DbcVersion 1;
BA_ "CANzero_SDO_AccessIfOperational" SG_ 1458 Track_OD_DbcVersion 1;
BA_ "CANzero_SDO_AccessType" SG_ 1458 Track_OD_StackVersion 1;
BA_ "CANzero_SDO_AccessIfOperational" SG_ 1458 Track_OD_StackVersion 1;
BA_ "CANzero_SDO_AccessType" SG_ 1458 Track_OD_ProtocolVersion 1;
BA_ "CANzero_SDO_AccessIfOperational" SG_ 1458 Track_OD_ProtocolVersion 1;
BA_ "GenSigStartValue" SG_ 1458 Track_OD_ProtocolVersion 1.0;
BA_ "CANzero_SDO_Default" SG_ 1458 Track_OD_ProtocolVersion 1;
BA_ "CANzero_SDO_AccessType" SG_ 1458 Track_OD_NodeStatus 1;
BA_ "CANzero_SDO_AccessIfOperational" SG_ 1458 Track_OD_NodeStatus 1;
BA_ "CANzero_SDO_AccessType" SG_ 1458 Track_OD_NodeID 1;
BA_ "CANzero_SDO_AccessIfOperational" SG_ 1458 Track_OD_NodeID 1;
BA_ "CANzero_SDO_AccessType" SG_ 1522 Track_OD_PropulsionDistance 1;
BA_ "CANzero_SDO_AccessIfOperational" SG_ 1522 Track_OD_PropulsionDistance 1;
BA_ "GenSigStartValue" SG_ 1522 Track_OD_PropulsionDistance 9810.0;
BA_ "CANzero_SDO_Default" SG_ 1522 Track_OD_PropulsionDistance -1.9;
BA_ "CANzero_SDO_AccessType" SG_ 1522 Track_OD_PropulsionPressure 1;
BA_ "CANzero_SDO_AccessIfOperational" SG_ 1522 Track_OD_PropulsionPressure 1;
BA_ "GenSigStartValue" SG_ 1522 Track_OD_PropulsionPressure 9810.0;
BA_ "CANzero_SDO_Default" SG_ 1522 Track_OD_PropulsionPressure -1.9;
BA_ "CANzero_SDO_AccessType" SG_ 1522 Track_OD_PistonStatus 1;
BA_ "CANzero_SDO_AccessIfOperational" SG_ 1522 Track_OD_PistonStatus 1;
BA_ "CANzero_SDO_Group" SG_ 1522 Track_OD_CAN2_DelayedTxMessages "CAN";
BA_ "CANzero_SDO_AccessType" SG_ 1522 Track_OD_CAN2_DelayedTxMessages 1;
BA_ "CANzero_SDO_AccessIfOperational" SG_ 1522 Track_OD_CAN2_DelayedTxMessages 1;
BA_ "CANzero_SDO_Group" SG_ 1522 Track_OD_CAN2_ErrorStatus "CAN";
BA_ "CANzero_SDO_AccessType" SG_ 1522 Track_OD_CAN2_ErrorStatus 1;
BA_ "CANzero_SDO_AccessIfOperational" SG_ 1522 Track_OD_CAN2_ErrorStatus 1;
BA_ "CANzero_SDO_Group" SG_ 1522 Track_OD_CAN2_DiscardedTxMe_0000 "CAN";
BA_ "CANzero_SDO_AccessType" SG_ 1522 Track_OD_CAN2_DiscardedTxMe_0000 1;
BA_ "CANzero_SDO_AccessIfOperational" SG_ 1522 Track_OD_CAN2_DiscardedTxMe_0000 1;
BA_ "SystemSignalLongSymbol" SG_ 1522 Track_OD_CAN2_DiscardedTxMe_0000 "Track_OD_CAN2_DiscardedTxMessages";
BA_ "CANzero_SDO_Group" SG_ 1522 Track_OD_CAN2_Status "CAN";
BA_ "CANzero_SDO_AccessType" SG_ 1522 Track_OD_CAN2_Status 1;
BA_ "CANzero_SDO_AccessIfOperational" SG_ 1522 Track_OD_CAN2_Status 1;
BA_ "CANzero_SDO_Group" SG_ 1522 Track_OD_CAN2_Baudrate "CAN";
BA_ "CANzero_SDO_AccessIfOperational" SG_ 1522 Track_OD_CAN2_Baudrate 1;
BA_ "GenSigStartValue" SG_ 1522 Track_OD_CAN2_Baudrate 1000.0;
BA_ "CANzero_SDO_Default" SG_ 1522 Track_OD_CAN2_Baudrate 1000;
BA_ "CANzero_SDO_Group" SG_ 1522 Track_OD_CAN2_autoErrorReset "CAN";
BA_ "CANzero_SDO_AccessIfOperational" SG_ 1522 Track_OD_CAN2_autoErrorReset 1;
BA_ "GenSigStartValue" SG_ 1522 Track_OD_CAN2_autoErrorReset 1.0;
BA_ "CANzero_SDO_Default" SG_ 1522 Track_OD_CAN2_autoErrorReset 1;
BA_ "CANzero_SDO_Group" SG_ 1522 Track_OD_CAN2_lastErrorCode "CAN";
BA_ "CANzero_SDO_AccessType" SG_ 1522 Track_OD_CAN2_lastErrorCode 1;
BA_ "CANzero_SDO_AccessIfOperational" SG_ 1522 Track_OD_CAN2_lastErrorCode 1;
BA_ "CANzero_SDO_Group" SG_ 1522 Track_OD_CAN2_RxErrCnt "CAN";
BA_ "CANzero_SDO_AccessType" SG_ 1522 Track_OD_CAN2_RxErrCnt 1;
BA_ "CANzero_SDO_AccessIfOperational" SG_ 1522 Track_OD_CAN2_RxErrCnt 1;
BA_ "CANzero_SDO_Group" SG_ 1522 Track_OD_CAN2_TxErrCnt "CAN";
BA_ "CANzero_SDO_AccessType" SG_ 1522 Track_OD_CAN2_TxErrCnt 1;
BA_ "CANzero_SDO_AccessIfOperational" SG_ 1522 Track_OD_CAN2_TxErrCnt 1;
BA_ "CANzero_SDO_Group" SG_ 1522 Track_OD_CAN1_DelayedTxMessages "CAN";
BA_ "CANzero_SDO_AccessType" SG_ 1522 Track_OD_CAN1_DelayedTxMessages 1;
BA_ "CANzero_SDO_AccessIfOperational" SG_ 1522 Track_OD_CAN1_DelayedTxMessages 1;
BA_ "CANzero_SDO_Group" SG_ 1522 Track_OD_CAN1_ErrorStatus "CAN";
BA_ "CANzero_SDO_AccessType" SG_ 1522 Track_OD_CAN1_ErrorStatus 1;
BA_ "CANzero_SDO_AccessIfOperational" SG_ 1522 Track_OD_CAN1_ErrorStatus 1;
BA_ "CANzero_SDO_Group" SG_ 1522 Track_OD_CAN1_DiscardedTxMe_0000 "CAN";
BA_ "CANzero_SDO_AccessType" SG_ 1522 Track_OD_CAN1_DiscardedTxMe_0000 1;
BA_ "CANzero_SDO_AccessIfOperational" SG_ 1522 Track_OD_CAN1_DiscardedTxMe_0000 1;
BA_ "SystemSignalLongSymbol" SG_ 1522 Track_OD_CAN1_DiscardedTxMe_0000 "Track_OD_CAN1_DiscardedTxMessages";
BA_ "CANzero_SDO_Group" SG_ 1522 Track_OD_CAN1_Status "CAN";
BA_ "CANzero_SDO_AccessType" SG_ 1522 Track_OD_CAN1_Status 1;
BA_ "CANzero_SDO_AccessIfOperational" SG_ 1522 Track_OD_CAN1_Status 1;
BA_ "CANzero_SDO_Group" SG_ 1522 Track_OD_CAN1_Baudrate "CAN";
BA_ "CANzero_SDO_AccessIfOperational" SG_ 1522 Track_OD_CAN1_Baudrate 1;
BA_ "GenSigStartValue" SG_ 1522 Track_OD_CAN1_Baudrate 1000.0;
BA_ "CANzero_SDO_Default" SG_ 1522 Track_OD_CAN1_Baudrate 1000;
BA_ "CANzero_SDO_Group" SG_ 1522 Track_OD_CAN1_autoErrorReset "CAN";
BA_ "CANzero_SDO_AccessIfOperational" SG_ 1522 Track_OD_CAN1_autoErrorReset 1;
BA_ "GenSigStartValue" SG_ 1522 Track_OD_CAN1_autoErrorReset 1.0;
BA_ "CANzero_SDO_Default" SG_ 1522 Track_OD_CAN1_autoErrorReset 1;
BA_ "CANzero_SDO_Group" SG_ 1522 Track_OD_CAN1_lastErrorCode "CAN";
BA_ "CANzero_SDO_AccessType" SG_ 1522 Track_OD_CAN1_lastErrorCode 1;
BA_ "CANzero_SDO_AccessIfOperational" SG_ 1522 Track_OD_CAN1_lastErrorCode 1;
BA_ "CANzero_SDO_Group" SG_ 1522 Track_OD_CAN1_RxErrCnt "CAN";
BA_ "CANzero_SDO_AccessType" SG_ 1522 Track_OD_CAN1_RxErrCnt 1;
BA_ "CANzero_SDO_AccessIfOperational" SG_ 1522 Track_OD_CAN1_RxErrCnt 1;
BA_ "CANzero_SDO_Group" SG_ 1522 Track_OD_CAN1_TxErrCnt "CAN";
BA_ "CANzero_SDO_AccessType" SG_ 1522 Track_OD_CAN1_TxErrCnt 1;
BA_ "CANzero_SDO_AccessIfOperational" SG_ 1522 Track_OD_CAN1_TxErrCnt 1;
BA_ "CANzero_SDO_AccessType" SG_ 1522 Track_OD_BuildTime 1;
BA_ "CANzero_SDO_AccessIfOperational" SG_ 1522 Track_OD_BuildTime 1;
BA_ "CANzero_SDO_AccessType" SG_ 1522 Track_OD_BuildDate 1;
BA_ "CANzero_SDO_AccessIfOperational" SG_ 1522 Track_OD_BuildDate 1;
BA_ "CANzero_SDO_AccessType" SG_ 1522 Track_OD_ChipUID2 1;
BA_ "CANzero_SDO_AccessIfOperational" SG_ 1522 Track_OD_ChipUID2 1;
BA_ "CANzero_SDO_AccessType" SG_ 1522 Track_OD_ChipUID1 1;
BA_ "CANzero_SDO_AccessIfOperational" SG_ 1522 Track_OD_ChipUID1 1;
BA_ "CANzero_SDO_AccessType" SG_ 1522 Track_OD_SdcOut 1;
BA_ "CANzero_SDO_AccessIfOperational" SG_ 1522 Track_OD_SdcOut 1;
BA_ "CANzero_SDO_AccessType" SG_ 1522 Track_OD_SdcIn 1;
BA_ "CANzero_SDO_AccessIfOperational" SG_ 1522 Track_OD_SdcIn 1;
BA_ "CANzero_SDO_AccessType" SG_ 1522 Track_OD_runtime 1;
BA_ "CANzero_SDO_AccessIfOperational" SG_ 1522 Track_OD_runtime 1;
BA_ "CANzero_SDO_AccessType" SG_ 1522 Track_OD_InputVoltage 1;
BA_ "CANzero_SDO_AccessIfOperational" SG_ 1522 Track_OD_InputVoltage 1;
BA_ "CANzero_SDO_AccessType" SG_ 1522 Track_OD_BoardTemp 1;
BA_ "CANzero_SDO_AccessIfOperational" SG_ 1522 Track_OD_BoardTemp 1;
BA_ "GenSigStartValue" SG_ 1522 Track_OD_BoardTemp 3000.0;
BA_ "CANzero_SDO_AccessType" SG_ 1522 Track_OD_MemFree 1;
BA_ "CANzero_SDO_AccessIfOperational" SG_ 1522 Track_OD_MemFree 1;
BA_ "CANzero_SDO_AccessType" SG_ 1522 Track_OD_CpuUsage 1;
BA_ "CANzero_SDO_AccessIfOperational" SG_ 1522 Track_OD_CpuUsage 1;
BA_ "CANzero_SDO_AccessIfOperational" SG_ 1522 Track_OD_OdEntrySendInterval 1;
BA_ "GenSigStartValue" SG_ 1522 Track_OD_OdEntrySendInterval 50.0;
BA_ "CANzero_SDO_Default" SG_ 1522 Track_OD_OdEntrySendInterval 50;
BA_ "CANzero_SDO_AccessIfOperational" SG_ 1522 Track_OD_SendOdOnBootup 1;
BA_ "CANzero_SDO_AccessIfOperational" SG_ 1522 Track_OD_HeartbeatInterval 1;
BA_ "GenSigStartValue" SG_ 1522 Track_OD_HeartbeatInterval 250.0;
BA_ "CANzero_SDO_Default" SG_ 1522 Track_OD_HeartbeatInterval 250;
BA_ "CANzero_SDO_AccessType" SG_ 1522 Track_OD_DbcVersion 1;
BA_ "CANzero_SDO_AccessIfOperational" SG_ 1522 Track_OD_DbcVersion 1;
BA_ "CANzero_SDO_AccessType" SG_ 1522 Track_OD_StackVersion 1;
BA_ "CANzero_SDO_AccessIfOperational" SG_ 1522 Track_OD_StackVersion 1;
BA_ "CANzero_SDO_AccessType" SG_ 1522 Track_OD_ProtocolVersion 1;
BA_ "CANzero_SDO_AccessIfOperational" SG_ 1522 Track_OD_ProtocolVersion 1;
BA_ "GenSigStartValue" SG_ 1522 Track_OD_ProtocolVersion 1.0;
BA_ "CANzero_SDO_Default" SG_ 1522 Track_OD_ProtocolVersion 1;
BA_ "CANzero_SDO_AccessType" SG_ 1522 Track_OD_NodeStatus 1;
BA_ "CANzero_SDO_AccessIfOperational" SG_ 1522 Track_OD_NodeStatus 1;
BA_ "CANzero_SDO_AccessType" SG_ 1522 Track_OD_NodeID 1;
BA_ "CANzero_SDO_AccessIfOperational" SG_ 1522 Track_OD_NodeID 1;
BA_ "CANzero_SDO_Group" SG_ 1428 CLU_OD_CAN2_DelayedTxMessages "CAN";
BA_ "CANzero_SDO_AccessType" SG_ 1428 CLU_OD_CAN2_DelayedTxMessages 1;
BA_ "CANzero_SDO_AccessIfOperational" SG_ 1428 CLU_OD_CAN2_DelayedTxMessages 1;
BA_ "CANzero_SDO_Group" SG_ 1428 CLU_OD_CAN2_ErrorStatus "CAN";
BA_ "CANzero_SDO_AccessType" SG_ 1428 CLU_OD_CAN2_ErrorStatus 1;
BA_ "CANzero_SDO_AccessIfOperational" SG_ 1428 CLU_OD_CAN2_ErrorStatus 1;
BA_ "CANzero_SDO_Group" SG_ 1428 CLU_OD_CAN2_DiscardedTxMessages "CAN";
BA_ "CANzero_SDO_AccessType" SG_ 1428 CLU_OD_CAN2_DiscardedTxMessages 1;
BA_ "CANzero_SDO_AccessIfOperational" SG_ 1428 CLU_OD_CAN2_DiscardedTxMessages 1;
BA_ "CANzero_SDO_Group" SG_ 1428 CLU_OD_CAN2_Status "CAN";
BA_ "CANzero_SDO_AccessType" SG_ 1428 CLU_OD_CAN2_Status 1;
BA_ "CANzero_SDO_AccessIfOperational" SG_ 1428 CLU_OD_CAN2_Status 1;
BA_ "CANzero_SDO_Group" SG_ 1428 CLU_OD_CAN2_Baudrate "CAN";
BA_ "CANzero_SDO_AccessIfOperational" SG_ 1428 CLU_OD_CAN2_Baudrate 1;
BA_ "GenSigStartValue" SG_ 1428 CLU_OD_CAN2_Baudrate 1000.0;
BA_ "CANzero_SDO_Default" SG_ 1428 CLU_OD_CAN2_Baudrate 1000;
BA_ "CANzero_SDO_Group" SG_ 1428 CLU_OD_CAN2_autoErrorReset "CAN";
BA_ "CANzero_SDO_AccessIfOperational" SG_ 1428 CLU_OD_CAN2_autoErrorReset 1;
BA_ "GenSigStartValue" SG_ 1428 CLU_OD_CAN2_autoErrorReset 1.0;
BA_ "CANzero_SDO_Default" SG_ 1428 CLU_OD_CAN2_autoErrorReset 1;
BA_ "CANzero_SDO_Group" SG_ 1428 CLU_OD_CAN2_lastErrorCode "CAN";
BA_ "CANzero_SDO_AccessType" SG_ 1428 CLU_OD_CAN2_lastErrorCode 1;
BA_ "CANzero_SDO_AccessIfOperational" SG_ 1428 CLU_OD_CAN2_lastErrorCode 1;
BA_ "CANzero_SDO_Group" SG_ 1428 CLU_OD_CAN2_RxErrCnt "CAN";
BA_ "CANzero_SDO_AccessType" SG_ 1428 CLU_OD_CAN2_RxErrCnt 1;
BA_ "CANzero_SDO_AccessIfOperational" SG_ 1428 CLU_OD_CAN2_RxErrCnt 1;
BA_ "CANzero_SDO_Group" SG_ 1428 CLU_OD_CAN2_TxErrCnt "CAN";
BA_ "CANzero_SDO_AccessType" SG_ 1428 CLU_OD_CAN2_TxErrCnt 1;
BA_ "CANzero_SDO_AccessIfOperational" SG_ 1428 CLU_OD_CAN2_TxErrCnt 1;
BA_ "CANzero_SDO_Group" SG_ 1428 CLU_OD_CAN1_DelayedTxMessages "CAN";
BA_ "CANzero_SDO_AccessType" SG_ 1428 CLU_OD_CAN1_DelayedTxMessages 1;
BA_ "CANzero_SDO_AccessIfOperational" SG_ 1428 CLU_OD_CAN1_DelayedTxMessages 1;
BA_ "CANzero_SDO_Group" SG_ 1428 CLU_OD_CAN1_ErrorStatus "CAN";
BA_ "CANzero_SDO_AccessType" SG_ 1428 CLU_OD_CAN1_ErrorStatus 1;
BA_ "CANzero_SDO_AccessIfOperational" SG_ 1428 CLU_OD_CAN1_ErrorStatus 1;
BA_ "CANzero_SDO_Group" SG_ 1428 CLU_OD_CAN1_DiscardedTxMessages "CAN";
BA_ "CANzero_SDO_AccessType" SG_ 1428 CLU_OD_CAN1_DiscardedTxMessages 1;
BA_ "CANzero_SDO_AccessIfOperational" SG_ 1428 CLU_OD_CAN1_DiscardedTxMessages 1;
BA_ "CANzero_SDO_Group" SG_ 1428 CLU_OD_CAN1_Status "CAN";
BA_ "CANzero_SDO_AccessType" SG_ 1428 CLU_OD_CAN1_Status 1;
BA_ "CANzero_SDO_AccessIfOperational" SG_ 1428 CLU_OD_CAN1_Status 1;
BA_ "CANzero_SDO_Group" SG_ 1428 CLU_OD_CAN1_Baudrate "CAN";
BA_ "CANzero_SDO_AccessIfOperational" SG_ 1428 CLU_OD_CAN1_Baudrate 1;
BA_ "GenSigStartValue" SG_ 1428 CLU_OD_CAN1_Baudrate 1000.0;
BA_ "CANzero_SDO_Default" SG_ 1428 CLU_OD_CAN1_Baudrate 1000;
BA_ "CANzero_SDO_Group" SG_ 1428 CLU_OD_CAN1_autoErrorReset "CAN";
BA_ "CANzero_SDO_AccessIfOperational" SG_ 1428 CLU_OD_CAN1_autoErrorReset 1;
BA_ "GenSigStartValue" SG_ 1428 CLU_OD_CAN1_autoErrorReset 1.0;
BA_ "CANzero_SDO_Default" SG_ 1428 CLU_OD_CAN1_autoErrorReset 1;
BA_ "CANzero_SDO_Group" SG_ 1428 CLU_OD_CAN1_lastErrorCode "CAN";
BA_ "CANzero_SDO_AccessType" SG_ 1428 CLU_OD_CAN1_lastErrorCode 1;
BA_ "CANzero_SDO_AccessIfOperational" SG_ 1428 CLU_OD_CAN1_lastErrorCode 1;
BA_ "CANzero_SDO_Group" SG_ 1428 CLU_OD_CAN1_RxErrCnt "CAN";
BA_ "CANzero_SDO_AccessType" SG_ 1428 CLU_OD_CAN1_RxErrCnt 1;
BA_ "CANzero_SDO_AccessIfOperational" SG_ 1428 CLU_OD_CAN1_RxErrCnt 1;
BA_ "CANzero_SDO_Group" SG_ 1428 CLU_OD_CAN1_TxErrCnt "CAN";
BA_ "CANzero_SDO_AccessType" SG_ 1428 CLU_OD_CAN1_TxErrCnt 1;
BA_ "CANzero_SDO_AccessIfOperational" SG_ 1428 CLU_OD_CAN1_TxErrCnt 1;
BA_ "CANzero_SDO_AccessType" SG_ 1428 CLU_OD_BuildTime 1;
BA_ "CANzero_SDO_AccessIfOperational" SG_ 1428 CLU_OD_BuildTime 1;
BA_ "CANzero_SDO_AccessType" SG_ 1428 CLU_OD_BuildDate 1;
BA_ "CANzero_SDO_AccessIfOperational" SG_ 1428 CLU_OD_BuildDate 1;
BA_ "CANzero_SDO_AccessType" SG_ 1428 CLU_OD_ChipUID2 1;
BA_ "CANzero_SDO_AccessIfOperational" SG_ 1428 CLU_OD_ChipUID2 1;
BA_ "CANzero_SDO_AccessType" SG_ 1428 CLU_OD_ChipUID1 1;
BA_ "CANzero_SDO_AccessIfOperational" SG_ 1428 CLU_OD_ChipUID1 1;
BA_ "CANzero_SDO_AccessType" SG_ 1428 CLU_OD_SdcOut 1;
BA_ "CANzero_SDO_AccessIfOperational" SG_ 1428 CLU_OD_SdcOut 1;
BA_ "CANzero_SDO_AccessType" SG_ 1428 CLU_OD_SdcIn 1;
BA_ "CANzero_SDO_AccessIfOperational" SG_ 1428 CLU_OD_SdcIn 1;
BA_ "CANzero_SDO_AccessType" SG_ 1428 CLU_OD_runtime 1;
BA_ "CANzero_SDO_AccessIfOperational" SG_ 1428 CLU_OD_runtime 1;
BA_ "CANzero_SDO_AccessType" SG_ 1428 CLU_OD_InputVoltage 1;
BA_ "CANzero_SDO_AccessIfOperational" SG_ 1428 CLU_OD_InputVoltage 1;
BA_ "CANzero_SDO_AccessType" SG_ 1428 CLU_OD_BoardTemp 1;
BA_ "CANzero_SDO_AccessIfOperational" SG_ 1428 CLU_OD_BoardTemp 1;
BA_ "GenSigStartValue" SG_ 1428 CLU_OD_BoardTemp 3000.0;
BA_ "CANzero_SDO_AccessType" SG_ 1428 CLU_OD_MemFree 1;
BA_ "CANzero_SDO_AccessIfOperational" SG_ 1428 CLU_OD_MemFree 1;
BA_ "CANzero_SDO_AccessType" SG_ 1428 CLU_OD_CpuUsage 1;
BA_ "CANzero_SDO_AccessIfOperational" SG_ 1428 CLU_OD_CpuUsage 1;
BA_ "CANzero_SDO_AccessIfOperational" SG_ 1428 CLU_OD_OdEntrySendInterval 1;
BA_ "GenSigStartValue" SG_ 1428 CLU_OD_OdEntrySendInterval 50.0;
BA_ "CANzero_SDO_Default" SG_ 1428 CLU_OD_OdEntrySendInterval 50;
BA_ "CANzero_SDO_AccessIfOperational" SG_ 1428 CLU_OD_SendOdOnBootup 1;
BA_ "CANzero_SDO_AccessIfOperational" SG_ 1428 CLU_OD_HeartbeatInterval 1;
BA_ "GenSigStartValue" SG_ 1428 CLU_OD_HeartbeatInterval 250.0;
BA_ "CANzero_SDO_Default" SG_ 1428 CLU_OD_HeartbeatInterval 250;
BA_ "CANzero_SDO_AccessType" SG_ 1428 CLU_OD_DbcVersion 1;
BA_ "CANzero_SDO_AccessIfOperational" SG_ 1428 CLU_OD_DbcVersion 1;
BA_ "CANzero_SDO_AccessType" SG_ 1428 CLU_OD_StackVersion 1;
BA_ "CANzero_SDO_AccessIfOperational" SG_ 1428 CLU_OD_StackVersion 1;
BA_ "CANzero_SDO_AccessType" SG_ 1428 CLU_OD_ProtocolVersion 1;
BA_ "CANzero_SDO_AccessIfOperational" SG_ 1428 CLU_OD_ProtocolVersion 1;
BA_ "GenSigStartValue" SG_ 1428 CLU_OD_ProtocolVersion 1.0;
BA_ "CANzero_SDO_Default" SG_ 1428 CLU_OD_ProtocolVersion 1;
BA_ "CANzero_SDO_AccessType" SG_ 1428 CLU_OD_NodeStatus 1;
BA_ "CANzero_SDO_AccessIfOperational" SG_ 1428 CLU_OD_NodeStatus 1;
BA_ "CANzero_SDO_AccessType" SG_ 1428 CLU_OD_NodeID 1;
BA_ "CANzero_SDO_AccessIfOperational" SG_ 1428 CLU_OD_NodeID 1;
BA_ "CANzero_SDO_Group" SG_ 1492 CLU_OD_CAN2_DelayedTxMessages "CAN";
BA_ "CANzero_SDO_AccessType" SG_ 1492 CLU_OD_CAN2_DelayedTxMessages 1;
BA_ "CANzero_SDO_AccessIfOperational" SG_ 1492 CLU_OD_CAN2_DelayedTxMessages 1;
BA_ "CANzero_SDO_Group" SG_ 1492 CLU_OD_CAN2_ErrorStatus "CAN";
BA_ "CANzero_SDO_AccessType" SG_ 1492 CLU_OD_CAN2_ErrorStatus 1;
BA_ "CANzero_SDO_AccessIfOperational" SG_ 1492 CLU_OD_CAN2_ErrorStatus 1;
BA_ "CANzero_SDO_Group" SG_ 1492 CLU_OD_CAN2_DiscardedTxMessages "CAN";
BA_ "CANzero_SDO_AccessType" SG_ 1492 CLU_OD_CAN2_DiscardedTxMessages 1;
BA_ "CANzero_SDO_AccessIfOperational" SG_ 1492 CLU_OD_CAN2_DiscardedTxMessages 1;
BA_ "CANzero_SDO_Group" SG_ 1492 CLU_OD_CAN2_Status "CAN";
BA_ "CANzero_SDO_AccessType" SG_ 1492 CLU_OD_CAN2_Status 1;
BA_ "CANzero_SDO_AccessIfOperational" SG_ 1492 CLU_OD_CAN2_Status 1;
BA_ "CANzero_SDO_Group" SG_ 1492 CLU_OD_CAN2_Baudrate "CAN";
BA_ "CANzero_SDO_AccessIfOperational" SG_ 1492 CLU_OD_CAN2_Baudrate 1;
BA_ "GenSigStartValue" SG_ 1492 CLU_OD_CAN2_Baudrate 1000.0;
BA_ "CANzero_SDO_Default" SG_ 1492 CLU_OD_CAN2_Baudrate 1000;
BA_ "CANzero_SDO_Group" SG_ 1492 CLU_OD_CAN2_autoErrorReset "CAN";
BA_ "CANzero_SDO_AccessIfOperational" SG_ 1492 CLU_OD_CAN2_autoErrorReset 1;
BA_ "GenSigStartValue" SG_ 1492 CLU_OD_CAN2_autoErrorReset 1.0;
BA_ "CANzero_SDO_Default" SG_ 1492 CLU_OD_CAN2_autoErrorReset 1;
BA_ "CANzero_SDO_Group" SG_ 1492 CLU_OD_CAN2_lastErrorCode "CAN";
BA_ "CANzero_SDO_AccessType" SG_ 1492 CLU_OD_CAN2_lastErrorCode 1;
BA_ "CANzero_SDO_AccessIfOperational" SG_ 1492 CLU_OD_CAN2_lastErrorCode 1;
BA_ "CANzero_SDO_Group" SG_ 1492 CLU_OD_CAN2_RxErrCnt "CAN";
BA_ "CANzero_SDO_AccessType" SG_ 1492 CLU_OD_CAN2_RxErrCnt 1;
BA_ "CANzero_SDO_AccessIfOperational" SG_ 1492 CLU_OD_CAN2_RxErrCnt 1;
BA_ "CANzero_SDO_Group" SG_ 1492 CLU_OD_CAN2_TxErrCnt "CAN";
BA_ "CANzero_SDO_AccessType" SG_ 1492 CLU_OD_CAN2_TxErrCnt 1;
BA_ "CANzero_SDO_AccessIfOperational" SG_ 1492 CLU_OD_CAN2_TxErrCnt 1;
BA_ "CANzero_SDO_Group" SG_ 1492 CLU_OD_CAN1_DelayedTxMessages "CAN";
BA_ "CANzero_SDO_AccessType" SG_ 1492 CLU_OD_CAN1_DelayedTxMessages 1;
BA_ "CANzero_SDO_AccessIfOperational" SG_ 1492 CLU_OD_CAN1_DelayedTxMessages 1;
BA_ "CANzero_SDO_Group" SG_ 1492 CLU_OD_CAN1_ErrorStatus "CAN";
BA_ "CANzero_SDO_AccessType" SG_ 1492 CLU_OD_CAN1_ErrorStatus 1;
BA_ "CANzero_SDO_AccessIfOperational" SG_ 1492 CLU_OD_CAN1_ErrorStatus 1;
BA_ "CANzero_SDO_Group" SG_ 1492 CLU_OD_CAN1_DiscardedTxMessages "CAN";
BA_ "CANzero_SDO_AccessType" SG_ 1492 CLU_OD_CAN1_DiscardedTxMessages 1;
BA_ "CANzero_SDO_AccessIfOperational" SG_ 1492 CLU_OD_CAN1_DiscardedTxMessages 1;
BA_ "CANzero_SDO_Group" SG_ 1492 CLU_OD_CAN1_Status "CAN";
BA_ "CANzero_SDO_AccessType" SG_ 1492 CLU_OD_CAN1_Status 1;
BA_ "CANzero_SDO_AccessIfOperational" SG_ 1492 CLU_OD_CAN1_Status 1;
BA_ "CANzero_SDO_Group" SG_ 1492 CLU_OD_CAN1_Baudrate "CAN";
BA_ "CANzero_SDO_AccessIfOperational" SG_ 1492 CLU_OD_CAN1_Baudrate 1;
BA_ "GenSigStartValue" SG_ 1492 CLU_OD_CAN1_Baudrate 1000.0;
BA_ "CANzero_SDO_Default" SG_ 1492 CLU_OD_CAN1_Baudrate 1000;
BA_ "CANzero_SDO_Group" SG_ 1492 CLU_OD_CAN1_autoErrorReset "CAN";
BA_ "CANzero_SDO_AccessIfOperational" SG_ 1492 CLU_OD_CAN1_autoErrorReset 1;
BA_ "GenSigStartValue" SG_ 1492 CLU_OD_CAN1_autoErrorReset 1.0;
BA_ "CANzero_SDO_Default" SG_ 1492 CLU_OD_CAN1_autoErrorReset 1;
BA_ "CANzero_SDO_Group" SG_ 1492 CLU_OD_CAN1_lastErrorCode "CAN";
BA_ "CANzero_SDO_AccessType" SG_ 1492 CLU_OD_CAN1_lastErrorCode 1;
BA_ "CANzero_SDO_AccessIfOperational" SG_ 1492 CLU_OD_CAN1_lastErrorCode 1;
BA_ "CANzero_SDO_Group" SG_ 1492 CLU_OD_CAN1_RxErrCnt "CAN";
BA_ "CANzero_SDO_AccessType" SG_ 1492 CLU_OD_CAN1_RxErrCnt 1;
BA_ "CANzero_SDO_AccessIfOperational" SG_ 1492 CLU_OD_CAN1_RxErrCnt 1;
BA_ "CANzero_SDO_Group" SG_ 1492 CLU_OD_CAN1_TxErrCnt "CAN";
BA_ "CANzero_SDO_AccessType" SG_ 1492 CLU_OD_CAN1_TxErrCnt 1;
BA_ "CANzero_SDO_AccessIfOperational" SG_ 1492 CLU_OD_CAN1_TxErrCnt 1;
BA_ "CANzero_SDO_AccessType" SG_ 1492 CLU_OD_BuildTime 1;
BA_ "CANzero_SDO_AccessIfOperational" SG_ 1492 CLU_OD_BuildTime 1;
BA_ "CANzero_SDO_AccessType" SG_ 1492 CLU_OD_BuildDate 1;
BA_ "CANzero_SDO_AccessIfOperational" SG_ 1492 CLU_OD_BuildDate 1;
BA_ "CANzero_SDO_AccessType" SG_ 1492 CLU_OD_ChipUID2 1;
BA_ "CANzero_SDO_AccessIfOperational" SG_ 1492 CLU_OD_ChipUID2 1;
BA_ "CANzero_SDO_AccessType" SG_ 1492 CLU_OD_ChipUID1 1;
BA_ "CANzero_SDO_AccessIfOperational" SG_ 1492 CLU_OD_ChipUID1 1;
BA_ "CANzero_SDO_AccessType" SG_ 1492 CLU_OD_SdcOut 1;
BA_ "CANzero_SDO_AccessIfOperational" SG_ 1492 CLU_OD_SdcOut 1;
BA_ "CANzero_SDO_AccessType" SG_ 1492 CLU_OD_SdcIn 1;
BA_ "CANzero_SDO_AccessIfOperational" SG_ 1492 CLU_OD_SdcIn 1;
BA_ "CANzero_SDO_AccessType" SG_ 1492 CLU_OD_runtime 1;
BA_ "CANzero_SDO_AccessIfOperational" SG_ 1492 CLU_OD_runtime 1;
BA_ "CANzero_SDO_AccessType" SG_ 1492 CLU_OD_InputVoltage 1;
BA_ "CANzero_SDO_AccessIfOperational" SG_ 1492 CLU_OD_InputVoltage 1;
BA_ "CANzero_SDO_AccessType" SG_ 1492 CLU_OD_BoardTemp 1;
BA_ "CANzero_SDO_AccessIfOperational" SG_ 1492 CLU_OD_BoardTemp 1;
BA_ "GenSigStartValue" SG_ 1492 CLU_OD_BoardTemp 3000.0;
BA_ "CANzero_SDO_AccessType" SG_ 1492 CLU_OD_MemFree 1;
BA_ "CANzero_SDO_AccessIfOperational" SG_ 1492 CLU_OD_MemFree 1;
BA_ "CANzero_SDO_AccessType" SG_ 1492 CLU_OD_CpuUsage 1;
BA_ "CANzero_SDO_AccessIfOperational" SG_ 1492 CLU_OD_CpuUsage 1;
BA_ "CANzero_SDO_AccessIfOperational" SG_ 1492 CLU_OD_OdEntrySendInterval 1;
BA_ "GenSigStartValue" SG_ 1492 CLU_OD_OdEntrySendInterval 50.0;
BA_ "CANzero_SDO_Default" SG_ 1492 CLU_OD_OdEntrySendInterval 50;
BA_ "CANzero_SDO_AccessIfOperational" SG_ 1492 CLU_OD_SendOdOnBootup 1;
BA_ "CANzero_SDO_AccessIfOperational" SG_ 1492 CLU_OD_HeartbeatInterval 1;
BA_ "GenSigStartValue" SG_ 1492 CLU_OD_HeartbeatInterval 250.0;
BA_ "CANzero_SDO_Default" SG_ 1492 CLU_OD_HeartbeatInterval 250;
BA_ "CANzero_SDO_AccessType" SG_ 1492 CLU_OD_DbcVersion 1;
BA_ "CANzero_SDO_AccessIfOperational" SG_ 1492 CLU_OD_DbcVersion 1;
BA_ "CANzero_SDO_AccessType" SG_ 1492 CLU_OD_StackVersion 1;
BA_ "CANzero_SDO_AccessIfOperational" SG_ 1492 CLU_OD_StackVersion 1;
BA_ "CANzero_SDO_AccessType" SG_ 1492 CLU_OD_ProtocolVersion 1;
BA_ "CANzero_SDO_AccessIfOperational" SG_ 1492 CLU_OD_ProtocolVersion 1;
BA_ "GenSigStartValue" SG_ 1492 CLU_OD_ProtocolVersion 1.0;
BA_ "CANzero_SDO_Default" SG_ 1492 CLU_OD_ProtocolVersion 1;
BA_ "CANzero_SDO_AccessType" SG_ 1492 CLU_OD_NodeStatus 1;
BA_ "CANzero_SDO_AccessIfOperational" SG_ 1492 CLU_OD_NodeStatus 1;
BA_ "CANzero_SDO_AccessType" SG_ 1492 CLU_OD_NodeID 1;
BA_ "CANzero_SDO_AccessIfOperational" SG_ 1492 CLU_OD_NodeID 1;
VAL_ 1447 MDB3_OD_CAN2_ErrorStatus 0 "Ok" 1 "Warn" 2 "Error Passive" 3 "Bus Off" ;
VAL_ 1447 MDB3_OD_CAN2_Status 0 "Reset" 1 "Ready" 2 "Listening" 3 "Sleep_Pending" 4 "Sleep_Active" 5 "ERROR" ;
VAL_ 1447 MDB3_OD_CAN2_autoErrorReset 0 "Disabled" 1 "Enabled" ;
VAL_ 1447 MDB3_OD_CAN2_lastErrorCode 0 "No Error" 1 "Stuff Error" 2 "Form Error" 3 "Ack Error" 4 "Bit recessive Error" 5 "Bit dominant Error" 6 "CRC Error" ;
VAL_ 1447 MDB3_OD_CAN1_ErrorStatus 0 "Ok" 1 "Warn" 2 "Error Passive" 3 "Bus Off" ;
VAL_ 1447 MDB3_OD_CAN1_Status 0 "Reset" 1 "Ready" 2 "Listening" 3 "Sleep_Pending" 4 "Sleep_Active" 5 "ERROR" ;
VAL_ 1447 MDB3_OD_CAN1_autoErrorReset 0 "Disabled" 1 "Enabled" ;
VAL_ 1447 MDB3_OD_CAN1_lastErrorCode 0 "No Error" 1 "Stuff Error" 2 "Form Error" 3 "Ack Error" 4 "Bit recessive Error" 5 "Bit dominant Error" 6 "CRC Error" ;
VAL_ 1447 MDB3_OD_SendOdOnBootup 0 "Disabled" 1 "Enabled" ;
VAL_ 1447 MDB3_OD_NodeStatus 0 "Bootup" 4 "Stopped" 5 "Operational" 127 "Pre-Operational" 128 "Reset" ;
VAL_ 1447 MDB3_SDO_RespCode 5 "ERR: Out of range" 4 "ERR: No access in this state" 3 "ERR: Read only object" 2 "ERR: Write only object" 1 "ERR: Non existing object" 0 "OK" ;
VAL_ 1447 MDB3_SDO_ID 0 "Reserved" 1 "NodeID" 2 "NodeStatus" 3 "ProtocolVersion" 4 "StackVersion" 5 "DbcVersion" 16 "HeartbeatInterval" 32 "SendOdOnBootup" 33 "OdEntrySendInterval" 1040 "CpuUsage" 1041 "MemFree" 1042 "BoardTemp" 1043 "InputVoltage" 1044 "runtime" 1045 "SdcIn" 1046 "SdcOut" 1056 "ChipUID1" 1057 "ChipUID2" 1072 "BuildDate" 1073 "BuildTime" 1104 "CAN1_TxErrCnt" 1105 "CAN1_RxErrCnt" 1106 "CAN1_lastErrorCode" 1107 "CAN1_autoErrorReset" 1108 "CAN1_Baudrate" 1110 "CAN1_Status" 1111 "CAN1_DiscardedTxMessages" 1112 "CAN1_ErrorStatus" 1113 "CAN1_DelayedTxMessages" 1120 "CAN2_TxErrCnt" 1121 "CAN2_RxErrCnt" 1122 "CAN2_lastErrorCode" 1123 "CAN2_autoErrorReset" 1124 "CAN2_Baudrate" 1126 "CAN2_Status" 1127 "CAN2_DiscardedTxMessages" 1128 "CAN2_ErrorStatus" 1129 "CAN2_DelayedTxMessages" ;
VAL_ 1511 MDB3_OD_CAN2_ErrorStatus 0 "Ok" 1 "Warn" 2 "Error Passive" 3 "Bus Off" ;
VAL_ 1511 MDB3_OD_CAN2_Status 0 "Reset" 1 "Ready" 2 "Listening" 3 "Sleep_Pending" 4 "Sleep_Active" 5 "ERROR" ;
VAL_ 1511 MDB3_OD_CAN2_autoErrorReset 0 "Disabled" 1 "Enabled" ;
VAL_ 1511 MDB3_OD_CAN2_lastErrorCode 0 "No Error" 1 "Stuff Error" 2 "Form Error" 3 "Ack Error" 4 "Bit recessive Error" 5 "Bit dominant Error" 6 "CRC Error" ;
VAL_ 1511 MDB3_OD_CAN1_ErrorStatus 0 "Ok" 1 "Warn" 2 "Error Passive" 3 "Bus Off" ;
VAL_ 1511 MDB3_OD_CAN1_Status 0 "Reset" 1 "Ready" 2 "Listening" 3 "Sleep_Pending" 4 "Sleep_Active" 5 "ERROR" ;
VAL_ 1511 MDB3_OD_CAN1_autoErrorReset 0 "Disabled" 1 "Enabled" ;
VAL_ 1511 MDB3_OD_CAN1_lastErrorCode 0 "No Error" 1 "Stuff Error" 2 "Form Error" 3 "Ack Error" 4 "Bit recessive Error" 5 "Bit dominant Error" 6 "CRC Error" ;
VAL_ 1511 MDB3_OD_SendOdOnBootup 0 "Disabled" 1 "Enabled" ;
VAL_ 1511 MDB3_OD_NodeStatus 0 "Bootup" 4 "Stopped" 5 "Operational" 127 "Pre-Operational" 128 "Reset" ;
VAL_ 1511 MDB3_SDO_ID 0 "Reserved" 1 "NodeID" 2 "NodeStatus" 3 "ProtocolVersion" 4 "StackVersion" 5 "DbcVersion" 16 "HeartbeatInterval" 32 "SendOdOnBootup" 33 "OdEntrySendInterval" 1040 "CpuUsage" 1041 "MemFree" 1042 "BoardTemp" 1043 "InputVoltage" 1044 "runtime" 1045 "SdcIn" 1046 "SdcOut" 1056 "ChipUID1" 1057 "ChipUID2" 1072 "BuildDate" 1073 "BuildTime" 1104 "CAN1_TxErrCnt" 1105 "CAN1_RxErrCnt" 1106 "CAN1_lastErrorCode" 1107 "CAN1_autoErrorReset" 1108 "CAN1_Baudrate" 1110 "CAN1_Status" 1111 "CAN1_DiscardedTxMessages" 1112 "CAN1_ErrorStatus" 1113 "CAN1_DelayedTxMessages" 1120 "CAN2_TxErrCnt" 1121 "CAN2_RxErrCnt" 1122 "CAN2_lastErrorCode" 1123 "CAN2_autoErrorReset" 1124 "CAN2_Baudrate" 1126 "CAN2_Status" 1127 "CAN2_DiscardedTxMessages" 1128 "CAN2_ErrorStatus" 1129 "CAN2_DelayedTxMessages" ;
VAL_ 1575 MDB3_SDO_ID 0 "Reserved" 1 "NodeID" 2 "NodeStatus" 3 "ProtocolVersion" 4 "StackVersion" 5 "DbcVersion" 16 "HeartbeatInterval" 32 "SendOdOnBootup" 33 "OdEntrySendInterval" 1040 "CpuUsage" 1041 "MemFree" 1042 "BoardTemp" 1043 "InputVoltage" 1044 "runtime" 1045 "SdcIn" 1046 "SdcOut" 1056 "ChipUID1" 1057 "ChipUID2" 1072 "BuildDate" 1073 "BuildTime" 1104 "CAN1_TxErrCnt" 1105 "CAN1_RxErrCnt" 1106 "CAN1_lastErrorCode" 1107 "CAN1_autoErrorReset" 1108 "CAN1_Baudrate" 1110 "CAN1_Status" 1111 "CAN1_DiscardedTxMessages" 1112 "CAN1_ErrorStatus" 1113 "CAN1_DelayedTxMessages" 1120 "CAN2_TxErrCnt" 1121 "CAN2_RxErrCnt" 1122 "CAN2_lastErrorCode" 1123 "CAN2_autoErrorReset" 1124 "CAN2_Baudrate" 1126 "CAN2_Status" 1127 "CAN2_DiscardedTxMessages" 1128 "CAN2_ErrorStatus" 1129 "CAN2_DelayedTxMessages" ;
VAL_ 1831 MDB3_NodeState 0 "Bootup" 4 "Stopped" 5 "Operational" 127 "Pre-Operational" ;
VAL_ 168 MDB4_E0_OtherError 0 "Ok" 1 "ERR" ;
VAL_ 168 MDB4_W0_OtherWarning 0 "Ok" 1 "WARN" ;
VAL_ 1448 MDB4_OD_CAN2_ErrorStatus 0 "Ok" 1 "Warn" 2 "Error Passive" 3 "Bus Off" ;
VAL_ 1448 MDB4_OD_CAN2_Status 0 "Reset" 1 "Ready" 2 "Listening" 3 "Sleep_Pending" 4 "Sleep_Active" 5 "ERROR" ;
VAL_ 1448 MDB4_OD_CAN2_autoErrorReset 0 "Disabled" 1 "Enabled" ;
VAL_ 1448 MDB4_OD_CAN2_lastErrorCode 0 "No Error" 1 "Stuff Error" 2 "Form Error" 3 "Ack Error" 4 "Bit recessive Error" 5 "Bit dominant Error" 6 "CRC Error" ;
VAL_ 1448 MDB4_OD_CAN1_ErrorStatus 0 "Ok" 1 "Warn" 2 "Error Passive" 3 "Bus Off" ;
VAL_ 1448 MDB4_OD_CAN1_Status 0 "Reset" 1 "Ready" 2 "Listening" 3 "Sleep_Pending" 4 "Sleep_Active" 5 "ERROR" ;
VAL_ 1448 MDB4_OD_CAN1_autoErrorReset 0 "Disabled" 1 "Enabled" ;
VAL_ 1448 MDB4_OD_CAN1_lastErrorCode 0 "No Error" 1 "Stuff Error" 2 "Form Error" 3 "Ack Error" 4 "Bit recessive Error" 5 "Bit dominant Error" 6 "CRC Error" ;
VAL_ 1448 MDB4_OD_SendOdOnBootup 0 "Disabled" 1 "Enabled" ;
VAL_ 1448 MDB4_OD_NodeStatus 0 "Bootup" 4 "Stopped" 5 "Operational" 127 "Pre-Operational" 128 "Reset" ;
VAL_ 1448 MDB4_SDO_RespCode 5 "ERR: Out of range" 4 "ERR: No access in this state" 3 "ERR: Read only object" 2 "ERR: Write only object" 1 "ERR: Non existing object" 0 "OK" ;
VAL_ 1448 MDB4_SDO_ID 0 "Reserved" 1 "NodeID" 2 "NodeStatus" 3 "ProtocolVersion" 4 "StackVersion" 5 "DbcVersion" 16 "HeartbeatInterval" 32 "SendOdOnBootup" 33 "OdEntrySendInterval" 1040 "CpuUsage" 1041 "MemFree" 1042 "BoardTemp" 1043 "InputVoltage" 1044 "runtime" 1045 "SdcIn" 1046 "SdcOut" 1056 "ChipUID1" 1057 "ChipUID2" 1072 "BuildDate" 1073 "BuildTime" 1104 "CAN1_TxErrCnt" 1105 "CAN1_RxErrCnt" 1106 "CAN1_lastErrorCode" 1107 "CAN1_autoErrorReset" 1108 "CAN1_Baudrate" 1110 "CAN1_Status" 1111 "CAN1_DiscardedTxMessages" 1112 "CAN1_ErrorStatus" 1113 "CAN1_DelayedTxMessages" 1120 "CAN2_TxErrCnt" 1121 "CAN2_RxErrCnt" 1122 "CAN2_lastErrorCode" 1123 "CAN2_autoErrorReset" 1124 "CAN2_Baudrate" 1126 "CAN2_Status" 1127 "CAN2_DiscardedTxMessages" 1128 "CAN2_ErrorStatus" 1129 "CAN2_DelayedTxMessages" ;
VAL_ 1512 MDB4_OD_CAN2_ErrorStatus 0 "Ok" 1 "Warn" 2 "Error Passive" 3 "Bus Off" ;
VAL_ 1512 MDB4_OD_CAN2_Status 0 "Reset" 1 "Ready" 2 "Listening" 3 "Sleep_Pending" 4 "Sleep_Active" 5 "ERROR" ;
VAL_ 1512 MDB4_OD_CAN2_autoErrorReset 0 "Disabled" 1 "Enabled" ;
VAL_ 1512 MDB4_OD_CAN2_lastErrorCode 0 "No Error" 1 "Stuff Error" 2 "Form Error" 3 "Ack Error" 4 "Bit recessive Error" 5 "Bit dominant Error" 6 "CRC Error" ;
VAL_ 1512 MDB4_OD_CAN1_ErrorStatus 0 "Ok" 1 "Warn" 2 "Error Passive" 3 "Bus Off" ;
VAL_ 1512 MDB4_OD_CAN1_Status 0 "Reset" 1 "Ready" 2 "Listening" 3 "Sleep_Pending" 4 "Sleep_Active" 5 "ERROR" ;
VAL_ 1512 MDB4_OD_CAN1_autoErrorReset 0 "Disabled" 1 "Enabled" ;
VAL_ 1512 MDB4_OD_CAN1_lastErrorCode 0 "No Error" 1 "Stuff Error" 2 "Form Error" 3 "Ack Error" 4 "Bit recessive Error" 5 "Bit dominant Error" 6 "CRC Error" ;
VAL_ 1512 MDB4_OD_SendOdOnBootup 0 "Disabled" 1 "Enabled" ;
VAL_ 1512 MDB4_OD_NodeStatus 0 "Bootup" 4 "Stopped" 5 "Operational" 127 "Pre-Operational" 128 "Reset" ;
VAL_ 1512 MDB4_SDO_ID 0 "Reserved" 1 "NodeID" 2 "NodeStatus" 3 "ProtocolVersion" 4 "StackVersion" 5 "DbcVersion" 16 "HeartbeatInterval" 32 "SendOdOnBootup" 33 "OdEntrySendInterval" 1040 "CpuUsage" 1041 "MemFree" 1042 "BoardTemp" 1043 "InputVoltage" 1044 "runtime" 1045 "SdcIn" 1046 "SdcOut" 1056 "ChipUID1" 1057 "ChipUID2" 1072 "BuildDate" 1073 "BuildTime" 1104 "CAN1_TxErrCnt" 1105 "CAN1_RxErrCnt" 1106 "CAN1_lastErrorCode" 1107 "CAN1_autoErrorReset" 1108 "CAN1_Baudrate" 1110 "CAN1_Status" 1111 "CAN1_DiscardedTxMessages" 1112 "CAN1_ErrorStatus" 1113 "CAN1_DelayedTxMessages" 1120 "CAN2_TxErrCnt" 1121 "CAN2_RxErrCnt" 1122 "CAN2_lastErrorCode" 1123 "CAN2_autoErrorReset" 1124 "CAN2_Baudrate" 1126 "CAN2_Status" 1127 "CAN2_DiscardedTxMessages" 1128 "CAN2_ErrorStatus" 1129 "CAN2_DelayedTxMessages" ;
VAL_ 1576 MDB4_SDO_ID 0 "Reserved" 1 "NodeID" 2 "NodeStatus" 3 "ProtocolVersion" 4 "StackVersion" 5 "DbcVersion" 16 "HeartbeatInterval" 32 "SendOdOnBootup" 33 "OdEntrySendInterval" 1040 "CpuUsage" 1041 "MemFree" 1042 "BoardTemp" 1043 "InputVoltage" 1044 "runtime" 1045 "SdcIn" 1046 "SdcOut" 1056 "ChipUID1" 1057 "ChipUID2" 1072 "BuildDate" 1073 "BuildTime" 1104 "CAN1_TxErrCnt" 1105 "CAN1_RxErrCnt" 1106 "CAN1_lastErrorCode" 1107 "CAN1_autoErrorReset" 1108 "CAN1_Baudrate" 1110 "CAN1_Status" 1111 "CAN1_DiscardedTxMessages" 1112 "CAN1_ErrorStatus" 1113 "CAN1_DelayedTxMessages" 1120 "CAN2_TxErrCnt" 1121 "CAN2_RxErrCnt" 1122 "CAN2_lastErrorCode" 1123 "CAN2_autoErrorReset" 1124 "CAN2_Baudrate" 1126 "CAN2_Status" 1127 "CAN2_DiscardedTxMessages" 1128 "CAN2_ErrorStatus" 1129 "CAN2_DelayedTxMessages" ;
VAL_ 1832 MDB4_NodeState 0 "Bootup" 4 "Stopped" 5 "Operational" 127 "Pre-Operational" ;
VAL_ 169 MDB5_E0_OtherError 0 "Ok" 1 "ERR" ;
VAL_ 169 MDB5_W0_OtherWarning 0 "Ok" 1 "WARN" ;
VAL_ 1449 MDB5_OD_CAN2_ErrorStatus 0 "Ok" 1 "Warn" 2 "Error Passive" 3 "Bus Off" ;
VAL_ 1449 MDB5_OD_CAN2_Status 0 "Reset" 1 "Ready" 2 "Listening" 3 "Sleep_Pending" 4 "Sleep_Active" 5 "ERROR" ;
VAL_ 1449 MDB5_OD_CAN2_autoErrorReset 0 "Disabled" 1 "Enabled" ;
VAL_ 1449 MDB5_OD_CAN2_lastErrorCode 0 "No Error" 1 "Stuff Error" 2 "Form Error" 3 "Ack Error" 4 "Bit recessive Error" 5 "Bit dominant Error" 6 "CRC Error" ;
VAL_ 1449 MDB5_OD_CAN1_ErrorStatus 0 "Ok" 1 "Warn" 2 "Error Passive" 3 "Bus Off" ;
VAL_ 1449 MDB5_OD_CAN1_Status 0 "Reset" 1 "Ready" 2 "Listening" 3 "Sleep_Pending" 4 "Sleep_Active" 5 "ERROR" ;
VAL_ 1449 MDB5_OD_CAN1_autoErrorReset 0 "Disabled" 1 "Enabled" ;
VAL_ 1449 MDB5_OD_CAN1_lastErrorCode 0 "No Error" 1 "Stuff Error" 2 "Form Error" 3 "Ack Error" 4 "Bit recessive Error" 5 "Bit dominant Error" 6 "CRC Error" ;
VAL_ 1449 MDB5_OD_SendOdOnBootup 0 "Disabled" 1 "Enabled" ;
VAL_ 1449 MDB5_OD_NodeStatus 0 "Bootup" 4 "Stopped" 5 "Operational" 127 "Pre-Operational" 128 "Reset" ;
VAL_ 1449 MDB5_SDO_RespCode 5 "ERR: Out of range" 4 "ERR: No access in this state" 3 "ERR: Read only object" 2 "ERR: Write only object" 1 "ERR: Non existing object" 0 "OK" ;
VAL_ 1449 MDB5_SDO_ID 0 "Reserved" 1 "NodeID" 2 "NodeStatus" 3 "ProtocolVersion" 4 "StackVersion" 5 "DbcVersion" 16 "HeartbeatInterval" 32 "SendOdOnBootup" 33 "OdEntrySendInterval" 1040 "CpuUsage" 1041 "MemFree" 1042 "BoardTemp" 1043 "InputVoltage" 1044 "runtime" 1045 "SdcIn" 1046 "SdcOut" 1056 "ChipUID1" 1057 "ChipUID2" 1072 "BuildDate" 1073 "BuildTime" 1104 "CAN1_TxErrCnt" 1105 "CAN1_RxErrCnt" 1106 "CAN1_lastErrorCode" 1107 "CAN1_autoErrorReset" 1108 "CAN1_Baudrate" 1110 "CAN1_Status" 1111 "CAN1_DiscardedTxMessages" 1112 "CAN1_ErrorStatus" 1113 "CAN1_DelayedTxMessages" 1120 "CAN2_TxErrCnt" 1121 "CAN2_RxErrCnt" 1122 "CAN2_lastErrorCode" 1123 "CAN2_autoErrorReset" 1124 "CAN2_Baudrate" 1126 "CAN2_Status" 1127 "CAN2_DiscardedTxMessages" 1128 "CAN2_ErrorStatus" 1129 "CAN2_DelayedTxMessages" ;
VAL_ 1513 MDB5_OD_CAN2_ErrorStatus 0 "Ok" 1 "Warn" 2 "Error Passive" 3 "Bus Off" ;
VAL_ 1513 MDB5_OD_CAN2_Status 0 "Reset" 1 "Ready" 2 "Listening" 3 "Sleep_Pending" 4 "Sleep_Active" 5 "ERROR" ;
VAL_ 1513 MDB5_OD_CAN2_autoErrorReset 0 "Disabled" 1 "Enabled" ;
VAL_ 1513 MDB5_OD_CAN2_lastErrorCode 0 "No Error" 1 "Stuff Error" 2 "Form Error" 3 "Ack Error" 4 "Bit recessive Error" 5 "Bit dominant Error" 6 "CRC Error" ;
VAL_ 1513 MDB5_OD_CAN1_ErrorStatus 0 "Ok" 1 "Warn" 2 "Error Passive" 3 "Bus Off" ;
VAL_ 1513 MDB5_OD_CAN1_Status 0 "Reset" 1 "Ready" 2 "Listening" 3 "Sleep_Pending" 4 "Sleep_Active" 5 "ERROR" ;
VAL_ 1513 MDB5_OD_CAN1_autoErrorReset 0 "Disabled" 1 "Enabled" ;
VAL_ 1513 MDB5_OD_CAN1_lastErrorCode 0 "No Error" 1 "Stuff Error" 2 "Form Error" 3 "Ack Error" 4 "Bit recessive Error" 5 "Bit dominant Error" 6 "CRC Error" ;
VAL_ 1513 MDB5_OD_SendOdOnBootup 0 "Disabled" 1 "Enabled" ;
VAL_ 1513 MDB5_OD_NodeStatus 0 "Bootup" 4 "Stopped" 5 "Operational" 127 "Pre-Operational" 128 "Reset" ;
VAL_ 1513 MDB5_SDO_ID 0 "Reserved" 1 "NodeID" 2 "NodeStatus" 3 "ProtocolVersion" 4 "StackVersion" 5 "DbcVersion" 16 "HeartbeatInterval" 32 "SendOdOnBootup" 33 "OdEntrySendInterval" 1040 "CpuUsage" 1041 "MemFree" 1042 "BoardTemp" 1043 "InputVoltage" 1044 "runtime" 1045 "SdcIn" 1046 "SdcOut" 1056 "ChipUID1" 1057 "ChipUID2" 1072 "BuildDate" 1073 "BuildTime" 1104 "CAN1_TxErrCnt" 1105 "CAN1_RxErrCnt" 1106 "CAN1_lastErrorCode" 1107 "CAN1_autoErrorReset" 1108 "CAN1_Baudrate" 1110 "CAN1_Status" 1111 "CAN1_DiscardedTxMessages" 1112 "CAN1_ErrorStatus" 1113 "CAN1_DelayedTxMessages" 1120 "CAN2_TxErrCnt" 1121 "CAN2_RxErrCnt" 1122 "CAN2_lastErrorCode" 1123 "CAN2_autoErrorReset" 1124 "CAN2_Baudrate" 1126 "CAN2_Status" 1127 "CAN2_DiscardedTxMessages" 1128 "CAN2_ErrorStatus" 1129 "CAN2_DelayedTxMessages" ;
VAL_ 1577 MDB5_SDO_ID 0 "Reserved" 1 "NodeID" 2 "NodeStatus" 3 "ProtocolVersion" 4 "StackVersion" 5 "DbcVersion" 16 "HeartbeatInterval" 32 "SendOdOnBootup" 33 "OdEntrySendInterval" 1040 "CpuUsage" 1041 "MemFree" 1042 "BoardTemp" 1043 "InputVoltage" 1044 "runtime" 1045 "SdcIn" 1046 "SdcOut" 1056 "ChipUID1" 1057 "ChipUID2" 1072 "BuildDate" 1073 "BuildTime" 1104 "CAN1_TxErrCnt" 1105 "CAN1_RxErrCnt" 1106 "CAN1_lastErrorCode" 1107 "CAN1_autoErrorReset" 1108 "CAN1_Baudrate" 1110 "CAN1_Status" 1111 "CAN1_DiscardedTxMessages" 1112 "CAN1_ErrorStatus" 1113 "CAN1_DelayedTxMessages" 1120 "CAN2_TxErrCnt" 1121 "CAN2_RxErrCnt" 1122 "CAN2_lastErrorCode" 1123 "CAN2_autoErrorReset" 1124 "CAN2_Baudrate" 1126 "CAN2_Status" 1127 "CAN2_DiscardedTxMessages" 1128 "CAN2_ErrorStatus" 1129 "CAN2_DelayedTxMessages" ;
VAL_ 1833 MDB5_NodeState 0 "Bootup" 4 "Stopped" 5 "Operational" 127 "Pre-Operational" ;
VAL_ 177 MDB6_E0_OtherError 0 "Ok" 1 "ERR" ;
VAL_ 177 MDB6_W0_OtherWarning 0 "Ok" 1 "WARN" ;
VAL_ 1457 MDB6_OD_CAN2_ErrorStatus 0 "Ok" 1 "Warn" 2 "Error Passive" 3 "Bus Off" ;
VAL_ 1457 MDB6_OD_CAN2_Status 0 "Reset" 1 "Ready" 2 "Listening" 3 "Sleep_Pending" 4 "Sleep_Active" 5 "ERROR" ;
VAL_ 1457 MDB6_OD_CAN2_autoErrorReset 0 "Disabled" 1 "Enabled" ;
VAL_ 1457 MDB6_OD_CAN2_lastErrorCode 0 "No Error" 1 "Stuff Error" 2 "Form Error" 3 "Ack Error" 4 "Bit recessive Error" 5 "Bit dominant Error" 6 "CRC Error" ;
VAL_ 1457 MDB6_OD_CAN1_ErrorStatus 0 "Ok" 1 "Warn" 2 "Error Passive" 3 "Bus Off" ;
VAL_ 1457 MDB6_OD_CAN1_Status 0 "Reset" 1 "Ready" 2 "Listening" 3 "Sleep_Pending" 4 "Sleep_Active" 5 "ERROR" ;
VAL_ 1457 MDB6_OD_CAN1_autoErrorReset 0 "Disabled" 1 "Enabled" ;
VAL_ 1457 MDB6_OD_CAN1_lastErrorCode 0 "No Error" 1 "Stuff Error" 2 "Form Error" 3 "Ack Error" 4 "Bit recessive Error" 5 "Bit dominant Error" 6 "CRC Error" ;
VAL_ 1457 MDB6_OD_SendOdOnBootup 0 "Disabled" 1 "Enabled" ;
VAL_ 1457 MDB6_OD_NodeStatus 0 "Bootup" 4 "Stopped" 5 "Operational" 127 "Pre-Operational" 128 "Reset" ;
VAL_ 1457 MDB6_SDO_RespCode 5 "ERR: Out of range" 4 "ERR: No access in this state" 3 "ERR: Read only object" 2 "ERR: Write only object" 1 "ERR: Non existing object" 0 "OK" ;
VAL_ 1457 MDB6_SDO_ID 0 "Reserved" 1 "NodeID" 2 "NodeStatus" 3 "ProtocolVersion" 4 "StackVersion" 5 "DbcVersion" 16 "HeartbeatInterval" 32 "SendOdOnBootup" 33 "OdEntrySendInterval" 1040 "CpuUsage" 1041 "MemFree" 1042 "BoardTemp" 1043 "InputVoltage" 1044 "runtime" 1045 "SdcIn" 1046 "SdcOut" 1056 "ChipUID1" 1057 "ChipUID2" 1072 "BuildDate" 1073 "BuildTime" 1104 "CAN1_TxErrCnt" 1105 "CAN1_RxErrCnt" 1106 "CAN1_lastErrorCode" 1107 "CAN1_autoErrorReset" 1108 "CAN1_Baudrate" 1110 "CAN1_Status" 1111 "CAN1_DiscardedTxMessages" 1112 "CAN1_ErrorStatus" 1113 "CAN1_DelayedTxMessages" 1120 "CAN2_TxErrCnt" 1121 "CAN2_RxErrCnt" 1122 "CAN2_lastErrorCode" 1123 "CAN2_autoErrorReset" 1124 "CAN2_Baudrate" 1126 "CAN2_Status" 1127 "CAN2_DiscardedTxMessages" 1128 "CAN2_ErrorStatus" 1129 "CAN2_DelayedTxMessages" ;
VAL_ 1521 MDB6_OD_CAN2_ErrorStatus 0 "Ok" 1 "Warn" 2 "Error Passive" 3 "Bus Off" ;
VAL_ 1521 MDB6_OD_CAN2_Status 0 "Reset" 1 "Ready" 2 "Listening" 3 "Sleep_Pending" 4 "Sleep_Active" 5 "ERROR" ;
VAL_ 1521 MDB6_OD_CAN2_autoErrorReset 0 "Disabled" 1 "Enabled" ;
VAL_ 1521 MDB6_OD_CAN2_lastErrorCode 0 "No Error" 1 "Stuff Error" 2 "Form Error" 3 "Ack Error" 4 "Bit recessive Error" 5 "Bit dominant Error" 6 "CRC Error" ;
VAL_ 1521 MDB6_OD_CAN1_ErrorStatus 0 "Ok" 1 "Warn" 2 "Error Passive" 3 "Bus Off" ;
VAL_ 1521 MDB6_OD_CAN1_Status 0 "Reset" 1 "Ready" 2 "Listening" 3 "Sleep_Pending" 4 "Sleep_Active" 5 "ERROR" ;
VAL_ 1521 MDB6_OD_CAN1_autoErrorReset 0 "Disabled" 1 "Enabled" ;
VAL_ 1521 MDB6_OD_CAN1_lastErrorCode 0 "No Error" 1 "Stuff Error" 2 "Form Error" 3 "Ack Error" 4 "Bit recessive Error" 5 "Bit dominant Error" 6 "CRC Error" ;
VAL_ 1521 MDB6_OD_SendOdOnBootup 0 "Disabled" 1 "Enabled" ;
VAL_ 1521 MDB6_OD_NodeStatus 0 "Bootup" 4 "Stopped" 5 "Operational" 127 "Pre-Operational" 128 "Reset" ;
VAL_ 1521 MDB6_SDO_ID 0 "Reserved" 1 "NodeID" 2 "NodeStatus" 3 "ProtocolVersion" 4 "StackVersion" 5 "DbcVersion" 16 "HeartbeatInterval" 32 "SendOdOnBootup" 33 "OdEntrySendInterval" 1040 "CpuUsage" 1041 "MemFree" 1042 "BoardTemp" 1043 "InputVoltage" 1044 "runtime" 1045 "SdcIn" 1046 "SdcOut" 1056 "ChipUID1" 1057 "ChipUID2" 1072 "BuildDate" 1073 "BuildTime" 1104 "CAN1_TxErrCnt" 1105 "CAN1_RxErrCnt" 1106 "CAN1_lastErrorCode" 1107 "CAN1_autoErrorReset" 1108 "CAN1_Baudrate" 1110 "CAN1_Status" 1111 "CAN1_DiscardedTxMessages" 1112 "CAN1_ErrorStatus" 1113 "CAN1_DelayedTxMessages" 1120 "CAN2_TxErrCnt" 1121 "CAN2_RxErrCnt" 1122 "CAN2_lastErrorCode" 1123 "CAN2_autoErrorReset" 1124 "CAN2_Baudrate" 1126 "CAN2_Status" 1127 "CAN2_DiscardedTxMessages" 1128 "CAN2_ErrorStatus" 1129 "CAN2_DelayedTxMessages" ;
VAL_ 1585 MDB6_SDO_ID 0 "Reserved" 1 "NodeID" 2 "NodeStatus" 3 "ProtocolVersion" 4 "StackVersion" 5 "DbcVersion" 16 "HeartbeatInterval" 32 "SendOdOnBootup" 33 "OdEntrySendInterval" 1040 "CpuUsage" 1041 "MemFree" 1042 "BoardTemp" 1043 "InputVoltage" 1044 "runtime" 1045 "SdcIn" 1046 "SdcOut" 1056 "ChipUID1" 1057 "ChipUID2" 1072 "BuildDate" 1073 "BuildTime" 1104 "CAN1_TxErrCnt" 1105 "CAN1_RxErrCnt" 1106 "CAN1_lastErrorCode" 1107 "CAN1_autoErrorReset" 1108 "CAN1_Baudrate" 1110 "CAN1_Status" 1111 "CAN1_DiscardedTxMessages" 1112 "CAN1_ErrorStatus" 1113 "CAN1_DelayedTxMessages" 1120 "CAN2_TxErrCnt" 1121 "CAN2_RxErrCnt" 1122 "CAN2_lastErrorCode" 1123 "CAN2_autoErrorReset" 1124 "CAN2_Baudrate" 1126 "CAN2_Status" 1127 "CAN2_DiscardedTxMessages" 1128 "CAN2_ErrorStatus" 1129 "CAN2_DelayedTxMessages" ;
VAL_ 1841 MDB6_NodeState 0 "Bootup" 4 "Stopped" 5 "Operational" 127 "Pre-Operational" ;
VAL_ 178 Track_E0_OtherError 0 "Ok" 1 "ERR" ;
VAL_ 178 Track_W0_OtherWarning 0 "Ok" 1 "WARN" ;
VAL_ 1458 Track_OD_PistonStatus 0 "Ready" 1 "Extended" ;
VAL_ 1458 Track_OD_CAN2_ErrorStatus 0 "Ok" 1 "Warn" 2 "Error Passive" 3 "Bus Off" ;
VAL_ 1458 Track_OD_CAN2_Status 0 "Reset" 1 "Ready" 2 "Listening" 3 "Sleep_Pending" 4 "Sleep_Active" 5 "ERROR" ;
VAL_ 1458 Track_OD_CAN2_autoErrorReset 0 "Disabled" 1 "Enabled" ;
VAL_ 1458 Track_OD_CAN2_lastErrorCode 0 "No Error" 1 "Stuff Error" 2 "Form Error" 3 "Ack Error" 4 "Bit recessive Error" 5 "Bit dominant Error" 6 "CRC Error" ;
VAL_ 1458 Track_OD_CAN1_ErrorStatus 0 "Ok" 1 "Warn" 2 "Error Passive" 3 "Bus Off" ;
VAL_ 1458 Track_OD_CAN1_Status 0 "Reset" 1 "Ready" 2 "Listening" 3 "Sleep_Pending" 4 "Sleep_Active" 5 "ERROR" ;
VAL_ 1458 Track_OD_CAN1_autoErrorReset 0 "Disabled" 1 "Enabled" ;
VAL_ 1458 Track_OD_CAN1_lastErrorCode 0 "No Error" 1 "Stuff Error" 2 "Form Error" 3 "Ack Error" 4 "Bit recessive Error" 5 "Bit dominant Error" 6 "CRC Error" ;
VAL_ 1458 Track_OD_SendOdOnBootup 0 "Disabled" 1 "Enabled" ;
VAL_ 1458 Track_OD_NodeStatus 0 "Bootup" 4 "Stopped" 5 "Operational" 127 "Pre-Operational" 128 "Reset" ;
VAL_ 1458 Track_SDO_RespCode 5 "ERR: Out of range" 4 "ERR: No access in this state" 3 "ERR: Read only object" 2 "ERR: Write only object" 1 "ERR: Non existing object" 0 "OK" ;
VAL_ 1458 Track_SDO_ID 0 "Reserved" 1 "NodeID" 2 "NodeStatus" 3 "ProtocolVersion" 4 "StackVersion" 5 "DbcVersion" 16 "HeartbeatInterval" 32 "SendOdOnBootup" 33 "OdEntrySendInterval" 1040 "CpuUsage" 1041 "MemFree" 1042 "BoardTemp" 1043 "InputVoltage" 1044 "runtime" 1045 "SdcIn" 1046 "SdcOut" 1056 "ChipUID1" 1057 "ChipUID2" 1072 "BuildDate" 1073 "BuildTime" 1104 "CAN1_TxErrCnt" 1105 "CAN1_RxErrCnt" 1106 "CAN1_lastErrorCode" 1107 "CAN1_autoErrorReset" 1108 "CAN1_Baudrate" 1110 "CAN1_Status" 1111 "CAN1_DiscardedTxMessages" 1112 "CAN1_ErrorStatus" 1113 "CAN1_DelayedTxMessages" 1120 "CAN2_TxErrCnt" 1121 "CAN2_RxErrCnt" 1122 "CAN2_lastErrorCode" 1123 "CAN2_autoErrorReset" 1124 "CAN2_Baudrate" 1126 "CAN2_Status" 1127 "CAN2_DiscardedTxMessages" 1128 "CAN2_ErrorStatus" 1129 "CAN2_DelayedTxMessages" 2304 "PistonStatus" 2816 "PropulsionPressure" 2560 "PropulsionDistance" ;
VAL_ 1522 Track_OD_PistonStatus 0 "Ready" 1 "Extended" ;
VAL_ 1522 Track_OD_CAN2_ErrorStatus 0 "Ok" 1 "Warn" 2 "Error Passive" 3 "Bus Off" ;
VAL_ 1522 Track_OD_CAN2_Status 0 "Reset" 1 "Ready" 2 "Listening" 3 "Sleep_Pending" 4 "Sleep_Active" 5 "ERROR" ;
VAL_ 1522 Track_OD_CAN2_autoErrorReset 0 "Disabled" 1 "Enabled" ;
VAL_ 1522 Track_OD_CAN2_lastErrorCode 0 "No Error" 1 "Stuff Error" 2 "Form Error" 3 "Ack Error" 4 "Bit recessive Error" 5 "Bit dominant Error" 6 "CRC Error" ;
VAL_ 1522 Track_OD_CAN1_ErrorStatus 0 "Ok" 1 "Warn" 2 "Error Passive" 3 "Bus Off" ;
VAL_ 1522 Track_OD_CAN1_Status 0 "Reset" 1 "Ready" 2 "Listening" 3 "Sleep_Pending" 4 "Sleep_Active" 5 "ERROR" ;
VAL_ 1522 Track_OD_CAN1_autoErrorReset 0 "Disabled" 1 "Enabled" ;
VAL_ 1522 Track_OD_CAN1_lastErrorCode 0 "No Error" 1 "Stuff Error" 2 "Form Error" 3 "Ack Error" 4 "Bit recessive Error" 5 "Bit dominant Error" 6 "CRC Error" ;
VAL_ 1522 Track_OD_SendOdOnBootup 0 "Disabled" 1 "Enabled" ;
VAL_ 1522 Track_OD_NodeStatus 0 "Bootup" 4 "Stopped" 5 "Operational" 127 "Pre-Operational" 128 "Reset" ;
VAL_ 1522 Track_SDO_ID 0 "Reserved" 1 "NodeID" 2 "NodeStatus" 3 "ProtocolVersion" 4 "StackVersion" 5 "DbcVersion" 16 "HeartbeatInterval" 32 "SendOdOnBootup" 33 "OdEntrySendInterval" 1040 "CpuUsage" 1041 "MemFree" 1042 "BoardTemp" 1043 "InputVoltage" 1044 "runtime" 1045 "SdcIn" 1046 "SdcOut" 1056 "ChipUID1" 1057 "ChipUID2" 1072 "BuildDate" 1073 "BuildTime" 1104 "CAN1_TxErrCnt" 1105 "CAN1_RxErrCnt" 1106 "CAN1_lastErrorCode" 1107 "CAN1_autoErrorReset" 1108 "CAN1_Baudrate" 1110 "CAN1_Status" 1111 "CAN1_DiscardedTxMessages" 1112 "CAN1_ErrorStatus" 1113 "CAN1_DelayedTxMessages" 1120 "CAN2_TxErrCnt" 1121 "CAN2_RxErrCnt" 1122 "CAN2_lastErrorCode" 1123 "CAN2_autoErrorReset" 1124 "CAN2_Baudrate" 1126 "CAN2_Status" 1127 "CAN2_DiscardedTxMessages" 1128 "CAN2_ErrorStatus" 1129 "CAN2_DelayedTxMessages" 2304 "PistonStatus" 2816 "PropulsionPressure" 2560 "PropulsionDistance" ;
VAL_ 1586 Track_SDO_ID 0 "Reserved" 1 "NodeID" 2 "NodeStatus" 3 "ProtocolVersion" 4 "StackVersion" 5 "DbcVersion" 16 "HeartbeatInterval" 32 "SendOdOnBootup" 33 "OdEntrySendInterval" 1040 "CpuUsage" 1041 "MemFree" 1042 "BoardTemp" 1043 "InputVoltage" 1044 "runtime" 1045 "SdcIn" 1046 "SdcOut" 1056 "ChipUID1" 1057 "ChipUID2" 1072 "BuildDate" 1073 "BuildTime" 1104 "CAN1_TxErrCnt" 1105 "CAN1_RxErrCnt" 1106 "CAN1_lastErrorCode" 1107 "CAN1_autoErrorReset" 1108 "CAN1_Baudrate" 1110 "CAN1_Status" 1111 "CAN1_DiscardedTxMessages" 1112 "CAN1_ErrorStatus" 1113 "CAN1_DelayedTxMessages" 1120 "CAN2_TxErrCnt" 1121 "CAN2_RxErrCnt" 1122 "CAN2_lastErrorCode" 1123 "CAN2_autoErrorReset" 1124 "CAN2_Baudrate" 1126 "CAN2_Status" 1127 "CAN2_DiscardedTxMessages" 1128 "CAN2_ErrorStatus" 1129 "CAN2_DelayedTxMessages" 2304 "PistonStatus" 2816 "PropulsionPressure" 2560 "PropulsionDistance" ;
VAL_ 1842 Track_NodeState 0 "Bootup" 4 "Stopped" 5 "Operational" 127 "Pre-Operational" ;
VAL_ 148 CLU_E0_OtherError 0 "Ok" 1 "ERR" ;
VAL_ 148 CLU_W0_OtherWarning 0 "Ok" 1 "WARN" ;
VAL_ 1428 CLU_OD_CAN2_ErrorStatus 0 "Ok" 1 "Warn" 2 "Error Passive" 3 "Bus Off" ;
VAL_ 1428 CLU_OD_CAN2_Status 0 "Reset" 1 "Ready" 2 "Listening" 3 "Sleep_Pending" 4 "Sleep_Active" 5 "ERROR" ;
VAL_ 1428 CLU_OD_CAN2_autoErrorReset 0 "Disabled" 1 "Enabled" ;
VAL_ 1428 CLU_OD_CAN2_lastErrorCode 0 "No Error" 1 "Stuff Error" 2 "Form Error" 3 "Ack Error" 4 "Bit recessive Error" 5 "Bit dominant Error" 6 "CRC Error" ;
VAL_ 1428 CLU_OD_CAN1_ErrorStatus 0 "Ok" 1 "Warn" 2 "Error Passive" 3 "Bus Off" ;
VAL_ 1428 CLU_OD_CAN1_Status 0 "Reset" 1 "Ready" 2 "Listening" 3 "Sleep_Pending" 4 "Sleep_Active" 5 "ERROR" ;
VAL_ 1428 CLU_OD_CAN1_autoErrorReset 0 "Disabled" 1 "Enabled" ;
VAL_ 1428 CLU_OD_CAN1_lastErrorCode 0 "No Error" 1 "Stuff Error" 2 "Form Error" 3 "Ack Error" 4 "Bit recessive Error" 5 "Bit dominant Error" 6 "CRC Error" ;
VAL_ 1428 CLU_OD_SendOdOnBootup 0 "Disabled" 1 "Enabled" ;
VAL_ 1428 CLU_OD_NodeStatus 0 "Bootup" 4 "Stopped" 5 "Operational" 127 "Pre-Operational" 128 "Reset" ;
VAL_ 1428 CLU_SDO_RespCode 5 "ERR: Out of range" 4 "ERR: No access in this state" 3 "ERR: Read only object" 2 "ERR: Write only object" 1 "ERR: Non existing object" 0 "OK" ;
VAL_ 1428 CLU_SDO_ID 0 "Reserved" 1 "NodeID" 2 "NodeStatus" 3 "ProtocolVersion" 4 "StackVersion" 5 "DbcVersion" 16 "HeartbeatInterval" 32 "SendOdOnBootup" 33 "OdEntrySendInterval" 1040 "CpuUsage" 1041 "MemFree" 1042 "BoardTemp" 1043 "InputVoltage" 1044 "runtime" 1045 "SdcIn" 1046 "SdcOut" 1056 "ChipUID1" 1057 "ChipUID2" 1072 "BuildDate" 1073 "BuildTime" 1104 "CAN1_TxErrCnt" 1105 "CAN1_RxErrCnt" 1106 "CAN1_lastErrorCode" 1107 "CAN1_autoErrorReset" 1108 "CAN1_Baudrate" 1110 "CAN1_Status" 1111 "CAN1_DiscardedTxMessages" 1112 "CAN1_ErrorStatus" 1113 "CAN1_DelayedTxMessages" 1120 "CAN2_TxErrCnt" 1121 "CAN2_RxErrCnt" 1122 "CAN2_lastErrorCode" 1123 "CAN2_autoErrorReset" 1124 "CAN2_Baudrate" 1126 "CAN2_Status" 1127 "CAN2_DiscardedTxMessages" 1128 "CAN2_ErrorStatus" 1129 "CAN2_DelayedTxMessages" ;
VAL_ 1492 CLU_OD_CAN2_ErrorStatus 0 "Ok" 1 "Warn" 2 "Error Passive" 3 "Bus Off" ;
VAL_ 1492 CLU_OD_CAN2_Status 0 "Reset" 1 "Ready" 2 "Listening" 3 "Sleep_Pending" 4 "Sleep_Active" 5 "ERROR" ;
VAL_ 1492 CLU_OD_CAN2_autoErrorReset 0 "Disabled" 1 "Enabled" ;
VAL_ 1492 CLU_OD_CAN2_lastErrorCode 0 "No Error" 1 "Stuff Error" 2 "Form Error" 3 "Ack Error" 4 "Bit recessive Error" 5 "Bit dominant Error" 6 "CRC Error" ;
VAL_ 1492 CLU_OD_CAN1_ErrorStatus 0 "Ok" 1 "Warn" 2 "Error Passive" 3 "Bus Off" ;
VAL_ 1492 CLU_OD_CAN1_Status 0 "Reset" 1 "Ready" 2 "Listening" 3 "Sleep_Pending" 4 "Sleep_Active" 5 "ERROR" ;
VAL_ 1492 CLU_OD_CAN1_autoErrorReset 0 "Disabled" 1 "Enabled" ;
VAL_ 1492 CLU_OD_CAN1_lastErrorCode 0 "No Error" 1 "Stuff Error" 2 "Form Error" 3 "Ack Error" 4 "Bit recessive Error" 5 "Bit dominant Error" 6 "CRC Error" ;
VAL_ 1492 CLU_OD_SendOdOnBootup 0 "Disabled" 1 "Enabled" ;
VAL_ 1492 CLU_OD_NodeStatus 0 "Bootup" 4 "Stopped" 5 "Operational" 127 "Pre-Operational" 128 "Reset" ;
VAL_ 1492 CLU_SDO_ID 0 "Reserved" 1 "NodeID" 2 "NodeStatus" 3 "ProtocolVersion" 4 "StackVersion" 5 "DbcVersion" 16 "HeartbeatInterval" 32 "SendOdOnBootup" 33 "OdEntrySendInterval" 1040 "CpuUsage" 1041 "MemFree" 1042 "BoardTemp" 1043 "InputVoltage" 1044 "runtime" 1045 "SdcIn" 1046 "SdcOut" 1056 "ChipUID1" 1057 "ChipUID2" 1072 "BuildDate" 1073 "BuildTime" 1104 "CAN1_TxErrCnt" 1105 "CAN1_RxErrCnt" 1106 "CAN1_lastErrorCode" 1107 "CAN1_autoErrorReset" 1108 "CAN1_Baudrate" 1110 "CAN1_Status" 1111 "CAN1_DiscardedTxMessages" 1112 "CAN1_ErrorStatus" 1113 "CAN1_DelayedTxMessages" 1120 "CAN2_TxErrCnt" 1121 "CAN2_RxErrCnt" 1122 "CAN2_lastErrorCode" 1123 "CAN2_autoErrorReset" 1124 "CAN2_Baudrate" 1126 "CAN2_Status" 1127 "CAN2_DiscardedTxMessages" 1128 "CAN2_ErrorStatus" 1129 "CAN2_DelayedTxMessages" ;
VAL_ 1556 CLU_SDO_ID 0 "Reserved" 1 "NodeID" 2 "NodeStatus" 3 "ProtocolVersion" 4 "StackVersion" 5 "DbcVersion" 16 "HeartbeatInterval" 32 "SendOdOnBootup" 33 "OdEntrySendInterval" 1040 "CpuUsage" 1041 "MemFree" 1042 "BoardTemp" 1043 "InputVoltage" 1044 "runtime" 1045 "SdcIn" 1046 "SdcOut" 1056 "ChipUID1" 1057 "ChipUID2" 1072 "BuildDate" 1073 "BuildTime" 1104 "CAN1_TxErrCnt" 1105 "CAN1_RxErrCnt" 1106 "CAN1_lastErrorCode" 1107 "CAN1_autoErrorReset" 1108 "CAN1_Baudrate" 1110 "CAN1_Status" 1111 "CAN1_DiscardedTxMessages" 1112 "CAN1_ErrorStatus" 1113 "CAN1_DelayedTxMessages" 1120 "CAN2_TxErrCnt" 1121 "CAN2_RxErrCnt" 1122 "CAN2_lastErrorCode" 1123 "CAN2_autoErrorReset" 1124 "CAN2_Baudrate" 1126 "CAN2_Status" 1127 "CAN2_DiscardedTxMessages" 1128 "CAN2_ErrorStatus" 1129 "CAN2_DelayedTxMessages" ;
VAL_ 1812 CLU_NodeState 0 "Bootup" 4 "Stopped" 5 "Operational" 127 "Pre-Operational" ;
