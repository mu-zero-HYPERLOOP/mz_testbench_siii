/*@!Encoding:1252*/
includes
{
  
}

variables
{
  
}

on message CAN1.* //  React to all messages that are received by chip CAN1
{
  message CAN2.* m;
  if(this.DIR==RX)        // if it is a received frame
  {
   if(this.CAN==1)
   {
    m=this;
    output(m);      // send it to the other channel
   }
  }
}

on message CAN2.*           
{
 message CAN1.* m;
 if(this.DIR==RX)        // if it is a received frame
 {
  if(this.CAN==2)
  {
   m=this;
   output(m);      // send it to the other channel
  }
 }
}

on message CAN3.* //  React to all messages that are received by chip CAN1
{
  message CAN4.* m;
  if(this.DIR==RX)        // if it is a received frame
  {
   if(this.CAN==3)
   {
    m=this;
    output(m);      // send it to the other channel
   }
  }
}

on message CAN4.*           
{
 message CAN3.* m;
 if(this.DIR==RX)        // if it is a received frame
 {
  if(this.CAN==4)
  {
   m=this;
   output(m);      // send it to the other channel
  }
 }
}